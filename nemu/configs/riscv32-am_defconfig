## npc/configs/rv64_xv6_defconfig
```kconfig
# xv6-riscv 实际启动配置：RV64IMA + Sv39 + CLINT + PLIC + UART。
# 上游 xv6 的 acquire() 需要 A 扩展（amoswap.w.aq），因此 RISCV_A 必须打开。
# ICache 打开、DCache 关闭，用于在最小配置下验证 A/Sv39 启动。
CONFIG_XLEN=64
CONFIG_RISCV_M=y
CONFIG_RISCV_A=y
CONFIG_HAS_S=y
CONFIG_HAS_U=y
CONFIG_HAS_MMU=y
CONFIG_HAS_TLB=y

CONFIG_MMU_PROFILE_BALANCED=y
CONFIG_MMU_GEOMETRY_STANDARD=y
CONFIG_MMU_GEOMETRY_MODE="standard"
CONFIG_MMU_CUSTOM_SATP_MODE=10
CONFIG_MMU_PAGE_SIZE_BYTES=4096
CONFIG_MMU_LEVELS=3
CONFIG_MMU_PTE_SIZE_BYTES=8
CONFIG_MMU_PAGE_TABLE_SIZE_BYTES=4096
CONFIG_MMU_PTE_RISCV64=y
CONFIG_MMU_PTE_FORMAT="riscv64"
CONFIG_MMU_SUPERPAGE=y
CONFIG_MMU_AD_FAULT=y
CONFIG_MMU_AD_MODE="fault"
CONFIG_MMU_CACHE_PIPT=y
CONFIG_MMU_CACHE_MODE="pipt"
CONFIG_MMU_PTW_DEDICATED=y
CONFIG_MMU_PTW_PATH="dedicated"
CONFIG_MMU_PTW_INDEPENDENT=y
CONFIG_MMU_PTW_ARCH="independent"
CONFIG_MMU_PTW_OUTSTANDING=2
CONFIG_MMU_PTW_BUS_OUTSTANDING=1
CONFIG_MMU_PTW_IN_ORDER=y
CONFIG_MMU_PTW_ORDER="in_order"
CONFIG_MMU_PTW_CACHE=n

CONFIG_TLB_SPLIT=y
CONFIG_TLB_ORGANIZATION="split"
CONFIG_TLB_STORAGE_REG=y
CONFIG_TLB_STORAGE="reg"
CONFIG_TLB_REPLACE_PLRU=y
CONFIG_TLB_REPLACEMENT="plru"
CONFIG_TLB_ASID_BITS=16
CONFIG_TLB_GLOBAL=y
CONFIG_ITLB_ENTRIES=16
CONFIG_ITLB_WAYS=2
CONFIG_DTLB_ENTRIES=32
CONFIG_DTLB_WAYS=4
CONFIG_TLB_SUPERPAGE=y
CONFIG_TLB_MISS_QUEUE_FOLLOW=y
CONFIG_TLB_MISS_QUEUE_MODE="follow_tlb"
CONFIG_ITLB_MISS_QUEUE_ENTRIES=4
CONFIG_DTLB_MISS_QUEUE_ENTRIES=4
CONFIG_TLB_REFILL_PORTS=1

CONFIG_HAS_S_TIMER_IRQ=y
CONFIG_HAS_S_EXTERNAL_IRQ=y
CONFIG_TIMER_CLINT_MTIP=y
CONFIG_TIMER_PATH="clint_mtip"
CONFIG_PLIC_SOURCES=32
CONFIG_PLIC_PRIORITY_BITS=3
CONFIG_PLIC_MAX_PRIORITY=7
CONFIG_PLIC_BASE=0x0c000000
CONFIG_HAS_PMP=n

CONFIG_CSR_MISSING_ILLEGAL=y
CONFIG_CSR_MISSING_MODE="illegal"
CONFIG_CSR_VIEW_BOUND=y
CONFIG_CSR_VIEW_MODE="bound"
CONFIG_CSR_FIELD_DEFAULT_READ="normal"
CONFIG_CSR_FIELD_DEFAULT_WRITE="normal"

CONFIG_HAS_CSR_MSTATUS=y
CONFIG_HAS_CSR_MISA=y
CONFIG_HAS_CSR_MTVEC=y
CONFIG_HAS_CSR_MEPC=y
CONFIG_HAS_CSR_MCAUSE=y
CONFIG_HAS_CSR_MTVAL=y
CONFIG_HAS_CSR_MSCRATCH=y
CONFIG_HAS_CSR_MIE=y
CONFIG_HAS_CSR_MIP=y
CONFIG_HAS_CSR_MEDELEG=y
CONFIG_HAS_CSR_MIDELEG=y
CONFIG_HAS_CSR_MCOUNTEREN=y
CONFIG_HAS_CSR_MCOUNTINHIBIT=y
CONFIG_HAS_CSR_MCYCLE=y
CONFIG_HAS_CSR_MINSTRET=y
CONFIG_HAS_CSR_SSTATUS=y
CONFIG_HAS_CSR_SIE=y
CONFIG_HAS_CSR_SIP=y
CONFIG_HAS_CSR_STVEC=y
CONFIG_HAS_CSR_SSCRATCH=y
CONFIG_HAS_CSR_SEPC=y
CONFIG_HAS_CSR_SCAUSE=y
CONFIG_HAS_CSR_STVAL=y
CONFIG_HAS_CSR_SATP=y
CONFIG_HAS_CSR_SCOUNTEREN=y

# xv6 启动/调试：保留 SDB，并打开 DiffTest（--diff 时才加载 REF）。
# ftrace 会把 UART 逐字符输出与调用日志交错并显著拖慢启动，故默认关闭；
# 需要定位时再单独打开 CONFIG_TRACE/FTRACE/IRINGBUF。
# ICache 打开、DCache 关闭：先用最小配置验证 A/Sv39；如需验证 DCache，
# 把 CONFIG_DCACHE 改为 y 后重新生成 RTL 即可。
CONFIG_ICACHE=y
CONFIG_DCACHE=n
CONFIG_SDB=y
CONFIG_TRACE=n
CONFIG_FTRACE=n
CONFIG_IRINGBUF=n
CONFIG_ITRACE=n
CONFIG_MTRACE=n
CONFIG_DIFFTEST=y
CONFIG_LOG_TO_FILE=n
CONFIG_PERF_STATS=n
CONFIG_PERF_SAVE=n
```

## npc/csrc/Kconfig
```kconfig
menu "C++ 配置"

  menu "工具链"

  choice
    prompt "编译器"
    default CC_GPP
  config CC_GPP
    bool "g++"
  config CC_CLANG
    bool "clang++"
  config CC_ICPX
    bool "icpx (Intel)"
  endchoice

  config CC
    string
    default "g++" if CC_GPP
    default "clang++" if CC_CLANG
    default "icpx" if CC_ICPX
    default "g++"

  choice
    prompt "C++标准库"
    default STDLIB_LIBSTDCXX
    help
      选择C++标准库实现
      Clang支持在libstdc++与libc++之间自由切换
      GCC的-fmodules实现硬编码了libstdc++的模块映射器路径
      即使手动指向libc++头文件，GCC仍会将标准库include
      重定向到libstdc++的bits/stdc++.h模块基础设施
      因此选择libc++时此选项仅对Clang生效
      本人补充：日你妈理查德·斯托曼，浪费了我一个下午的时间
  config STDLIB_LIBSTDCXX
    bool "libstdc++（GNU）"
  config STDLIB_LIBCXX
    bool "libc++（LLVM）"
    depends on CC_CLANG || CC_ICPX
  endchoice

  config STDLIB_FLAG
    string
    default "-stdlib=libstdc++" if STDLIB_LIBSTDCXX
    default "-stdlib=libc++" if STDLIB_LIBCXX
    default "-stdlib=libstdc++"

  config LIB_HARDENING
    bool "标准库硬化 (Standard Library Hardening)"
    default n
    help
      将标准库中部分前置条件违规从UB转为运行时检查（P3471）
      libstdc++（GNU）：单级，启用后加 -D_GLIBCXX_ASSERTIONS
      libc++（LLVM）：多挡位，启用后还需选择硬化级别

  choice
    prompt "libc++硬化级别"
    default LIB_HARDENING_MODE_FAST
    depends on LIB_HARDENING && STDLIB_LIBCXX
    help
      FAST：仅检查输入区间与元素访问，开销最小，生产推荐
      EXTENSIVE：追加空指针/重叠区间/非法释放/参数域等检查
      DEBUG：全部检查，含语义要求与内部不变量，适合开发调试
  config LIB_HARDENING_MODE_FAST
    bool "FAST（生产推荐）"
  config LIB_HARDENING_MODE_EXTENSIVE
    bool "EXTENSIVE"
  config LIB_HARDENING_MODE_DEBUG
    bool "DEBUG（开发调试）"
  endchoice

  config LIB_HARDENING_MODE
    string
    default "_LIBCPP_HARDENING_MODE_FAST" if LIB_HARDENING_MODE_FAST
    default "_LIBCPP_HARDENING_MODE_EXTENSIVE" if LIB_HARDENING_MODE_EXTENSIVE
    default "_LIBCPP_HARDENING_MODE_DEBUG" if LIB_HARDENING_MODE_DEBUG
    default "_LIBCPP_HARDENING_MODE_FAST"

  config CC_ICPX_NOSTDINCXX
    bool "icpx: 跳过Intel内置C++头路径 (-nostdinc++)"
    depends on CC_ICPX && STDLIB_LIBCXX
    help
      傻逼Intel自己的include路径里夹带了一堆自己的私货，他居然包
      含了自己的 float和limits和math头文件，而且排在 libc++ 路
      径前面，然后libc++的 include的next的机制被Intel自己的头文
      件截胡，直接就崩了，卧槽，脑子有坑啊，Intel那个目录的存在纯
      粹是硬插在include搜索最前面，除了提供Fortran和他死掉的ICC的
      兼容的头文件之外屁用没有

  choice
    prompt "C库"
    default LIBC_GLIBC
    help
      C运行库实现，位于C++标准库下层，提供printf/malloc/pthread等
      musl：Arch的libstdc++和libc++均基于glibc编译，运行时依赖
      glibc特有符号（__vfprintf_chk、__isoc23_*等），musl不提供
      需要Alpine Linux等基于musl构建整套C++工具链的发行版才能用
      LLVM libc：未完成，无Arch包，不可用
      当前仅glibc可用
  config LIBC_GLIBC
    bool "glibc（GNU）"
  endchoice

  choice
    prompt "链接器"
    default LD_DEFAULT
    help
      GCC和Clang均支持切换链接器
  config LD_DEFAULT
    bool "ld（GNU）"
  config LD_GOLD
    bool "gold（GNU）"
    help
      GNU gold链接器，比ld快2-4倍
      GCC/Clang通过-fuse-ld=gold使用
  config LD_LLD
    bool "lld（LLVM）"
    help
      LLVM链接器，比ld快5-10倍
  config LD_MOLD
    bool "mold"
    help
      最快的链接器，比ld快10-20倍
  endchoice

  config LD_FLAG
    string
    default "" if LD_DEFAULT
    default "-fuse-ld=gold" if LD_GOLD
    default "-fuse-ld=lld" if LD_LLD
    default "-fuse-ld=mold" if LD_MOLD
    default ""

  endmenu

  menu "语言标准"

  choice
    prompt "用户C++语言标准"
    default USER_CXX_STD_CXX26
     help
       设置csrc目录中用户C++源码使用的语言标准
       用户源码依赖std::print等特性，最低要求C++26
   config USER_CXX_STD_CXX26
     bool "C++26"
   config USER_CXX_STD_CXX23
     bool "C++23"
  endchoice

  config USER_CXX_STD
     string
     default "c++26" if USER_CXX_STD_CXX26
     default "c++23" if USER_CXX_STD_CXX23
     default "c++26"

  choice
    prompt "Verilator生成代码语言标准"
    default VERILATOR_CXX_STD_CXX20
    help
      设置Verilator运行库、预编译头和生成模型使用的语言标准
      Verilator生成代码不依赖高版本特性，可使用较低标准
  config VERILATOR_CXX_STD_CXX17
    bool "C++17"
  config VERILATOR_CXX_STD_CXX20
    bool "C++20"
  config VERILATOR_CXX_STD_CXX23
    bool "C++23"
  config VERILATOR_CXX_STD_CXX26
    bool "C++26"
  endchoice

  config VERILATOR_CXX_STD
    string
    default "c++17" if VERILATOR_CXX_STD_CXX17
    default "c++20" if VERILATOR_CXX_STD_CXX20
    default "c++23" if VERILATOR_CXX_STD_CXX23
    default "c++26" if VERILATOR_CXX_STD_CXX26
    default "c++20"

  endmenu

  menu "编译选项"

    menu "优化"

    menu "性能优化"

    choice
      prompt "优化级别"
      default CC_O3
    config CC_O0
      bool "O0"
    config CC_O1
      bool "O1"
    config CC_O2
      bool "O2"
    config CC_O3
      bool "O3"
    config CC_OFAST
      bool "Ofast"
      help
        等同于-O3加上-ffast-math
        放宽IEEE浮点标准合规性换取速度
        可能导致浮点计算结果与标准不一致
    endchoice

    config CC_OPT
      string
      default "-O0" if CC_O0
      default "-O1" if CC_O1
      default "-O2" if CC_O2
      default "-O3" if CC_O3
      default "-Ofast" if CC_OFAST
      default "-O3"

    config CC_LTO
      bool "启用链接时优化-flto"
      default n

    choice
      prompt "PGO配置引导优化"
      default PGO_OFF
      help
        Profile-Guided Optimization，基于实际运行数据优化
    config PGO_OFF
      bool "关闭"
    config PGO_GENERATE
      bool "手动：生成profile数据"
      help
        添加-fprofile-generate，编译后运行产生profile文件
        之后切到"使用"选项重新编译
    config PGO_USE
      bool "手动：使用profile数据优化"
      help
        添加-fprofile-use，读取之前运行产生的profile文件优化
        使用前不要make clean，否则profile数据丢失
    config PGO_AUTO
      bool "自动（一步到位）"
      help
        使用make pgo自动完成全部流程：
          make pgo file=镜像文件.bin
        内部自动执行：
          1. 以-fprofile-generate编译插桩版本
          2. 运行指定的镜像文件收集热点数据
          3. 以-fprofile-use重新编译，应用profile优化
          4. 运行最终优化后的程序
        注意：必须通过file=指定要运行的镜像文件
    endchoice

    choice
      prompt "架构优化-march"
      default MARCH_OFF
    config MARCH_OFF
      bool "不指定"
    config MARCH_NATIVE
      bool "native（本机CPU）"
    config MARCH_CUSTOM
      bool "手动指定"
    endchoice

    config MARCH_CUSTOM_VALUE
      string "架构名称"
      default "x86-64-v3"
      depends on MARCH_CUSTOM
      help
        输入GCC/Clang支持的架构名，例如：
        alderlake, raptorlake, znver4, skylake, x86-64-v3

    config CC_IPA_PTA
      bool "跨过程指针分析-fipa-pta"
      default n
      depends on CC_GPP
      help
        允许编译器跨函数分析指针别名，发现更多优化机会
        会显著增加编译时间（仅GCC支持）

    config CC_PREFETCH
      bool "软件预取大数组-fprefetch-loop-arrays"
      default n
      depends on CC_GPP
      help
        在循环中插入prefetch指令提前加载数据到缓存
        对遍历大数组的场景有效，对小数据量可能反而变慢（仅GCC支持）

    config CC_PIPE
      bool "使用管道加速编译-pipe"
      default n
      help
        编译阶段间用管道代替临时文件，减少磁盘IO

    config CC_SPLIT_DWARF
      bool "拆分调试信息加速链接-gsplit-dwarf"
      default n
      help
        将调试信息拆分到.dwo文件，减少链接器处理量
        需配合-g使用

    endmenu

    menu "大小优化"

    config CC_GC_SECTIONS
      bool "删除未使用代码和数据-ffunction-sections -fdata-sections"
      default n
      help
        将每个函数和数据放入独立section
        链接时通过--gc-sections丢弃未引用的section

    config CC_STRIP
      bool "剥离符号表-s"
      default n
      help
        链接时删除所有符号信息，减小二进制体积
        启用后无法用gdb调试

    config CC_VISIBILITY_HIDDEN
      bool "默认隐藏符号-fvisibility=hidden"
      default n
      help
        所有符号默认不导出，减少动态链接开销
        对可执行文件无副作用

    endmenu

    endmenu

    menu "警告"

    config CC_WALL
      bool "启用额外警告-Wall -Wextra"
      default n

    config CC_WERROR
      bool "将警告视为错误-Werror"
      default n

    config CC_PEDANTIC
      bool "严格ISO C++合规警告-Wpedantic"
      default n

    config CC_WCONVERSION
      bool "隐式类型转换警告-Wconversion"
      default n

    config CC_COLOR
      bool "强制彩色编译输出-fdiagnostics-color=always"
      default n

    endmenu

    menu "调试与分析"

    config CC_DEBUG
      bool "生成调试信息-g"
      default n

    config CC_NO_OMIT_FP
      bool "保留帧指针-fno-omit-frame-pointer"
      default n

    config CC_ASAN
      bool "启用ASan地址错误检测-fsanitize=address"
      default n

    config CC_UBSAN
      bool "启用UBSan未定义行为检测-fsanitize=undefined"
      default n

    config CC_TSAN
      bool "启用TSan线程竞争检测-fsanitize=thread"
      default n
      help
        检测数据竞争，不能与ASan同时使用

    config CC_COVERAGE
      bool "启用代码覆盖率--coverage"
      default n
      help
        编译后运行程序会生成.gcda/.gcno文件
        用gcov/lcov/genhtml生成覆盖率报告

    config CC_GPROF
      bool "启用gprof性能分析-pg"
      default n
      help
        运行后生成gmon.out，用gprof分析热点函数

    config CC_TIME_REPORT
      bool "显示编译各阶段耗时-ftime-report"
      default n

    config BUILD_TIMESTAMP
      bool "嵌入构建时间戳"
      default n
      help
        将编译时间嵌入二进制，可在运行时打印版本信息

    endmenu

  endmenu

endmenu
```

## npc/csrc/Kconfig.verilator
```kconfig
menu "Verilator 仿真"

  menu "构建与并行"

    config BUILD_THREADS
      int "构建线程数，0 = 使用全部核心"
      default 0
      help
        设置Verilator并行构建的线程数
        0表示使用所有可用核心
        超过系统核心数的值将被限制为系统核心数

    config SIM_THREADS
      int "仿真线程数，0 = 全部核心，1 = 单线程"
      default 1
      help
        设置Verilator运行仿真时使用的线程数
        0表示使用所有可用核心
        1表示单线程，这是默认值，也是最稳妥的选择
        超过系统核心数的值将被限制为系统核心数
        由于存在线程同步开销，多线程仿真不一定更快

    config OUTPUT_SPLIT
      int "输出文件拆分大小（行数），0 = 不拆分"
      default 20000
      help
        设置Verilator的--output-split参数
        将生成的C++文件按行数拆分成多个小文件
        有助于并行编译加速，建议值20000
        0表示不拆分

  endmenu

  menu "波形追踪"

    choice
      prompt "波形追踪"
      default TRACE_NONE
    config TRACE_NONE
      bool "不生成波形"
    config TRACE_VCD
      bool "VCD --trace"
    config TRACE_FST
      bool "FST --trace-fst"
    endchoice

    config TRACE_DEPTH
      int "波形追踪深度，0 = 全部层级"
      default 0
      depends on !TRACE_NONE
      help
        设置Verilator波形追踪的--trace-depth层级
        0表示追踪所有层级

    config TRACE_FILE
      string "波形输出文件路径"
      default "oscillogram/waveform.vcd" if TRACE_VCD
      default "oscillogram/waveform.fst" if TRACE_FST
      depends on !TRACE_NONE
      help
        波形文件的输出路径，相对于npc目录

  endmenu

  menu "仿真行为"

    choice
      prompt "Verilator优化级别"
      default VERILATOR_O3
    config VERILATOR_O0
      bool "O0"
    config VERILATOR_O1
      bool "O1"
    config VERILATOR_O2
      bool "O2"
    config VERILATOR_O3
      bool "O3"
    endchoice

    config VERILATOR_OPT
      string
      default "-O0" if VERILATOR_O0
      default "-O1" if VERILATOR_O1
      default "-O2" if VERILATOR_O2
      default "-O3" if VERILATOR_O3
      default "-O3"

    config PROF_CFUNCS
      bool "启用性能分析--prof-cfuncs"
      default n

    config AUTOFLUSH
      bool "启用自动刷新--autoflush"
      default y
      help
        每个周期结束后自动刷新输出流
        禁用此项可能提升性能，但如果仿真崩溃，波形可能不完整

    config ASSERT
      bool "启用SystemVerilog断言--assert"
      default n
      help
        启用RTL设计中的SVA断言
        为提高性能，默认使用--noassert

    choice
      prompt "X赋值模式--x-assign"
      default X_ASSIGN_FAST
    config X_ASSIGN_FAST
      bool "fast"
    config X_ASSIGN_0
      bool "0"
    config X_ASSIGN_1
      bool "1"
    config X_ASSIGN_UNIQUE
      bool "unique"
    endchoice

    choice
      prompt "X初始值模式--x-initial"
      default X_INITIAL_FAST
    config X_INITIAL_FAST
      bool "fast"
    config X_INITIAL_0
      bool "0"
    config X_INITIAL_1
      bool "1"
    config X_INITIAL_UNIQUE
      bool "unique"
    endchoice

    config COVERAGE
      bool "启用RTL覆盖率统计--coverage"
      default n

  endmenu

endmenu
```
