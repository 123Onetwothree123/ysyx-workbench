## npc/configs/rv64_custom_large_defconfig
```kconfig
CONFIG_XLEN=64
CONFIG_RISCV_M=y
CONFIG_HAS_S=y
CONFIG_HAS_U=y
CONFIG_HAS_MMU=y
CONFIG_HAS_TLB=y

# RV64 CUSTOM 大页示例：2MiB 基础页 + 5 级 + 每级 256 项（8 位索引），
# 有效 VA=21+5*8=61 位。satp MODE=10 是显式 CUSTOM 扩展；PTE 采用
# 标准 64 位布局。注意：2MiB/5 级若配 4KiB 页表（9 位索引）会得到
# 66 位 VA，超过 64 位，配置校验会明确拒绝；必须像这里一样减小每级
# 页表项数。2MiB 页配 44 位 PPN 时物理地址需要 65 位，因此 PTE/satp
# 的 PPN 最高位必须为 0（RTL walk 会检查并报页错误）。
# 配置层允许这些自由参数；未合入大页 RTL 的树会在 mmu-profile/
# elaboration 阶段按旧的 1..4 级/1MiB 能力明确拒绝。
CONFIG_MMU_PROFILE_CUSTOM=y
CONFIG_MMU_GEOMETRY_CUSTOM=y
CONFIG_MMU_GEOMETRY_MODE="custom"
CONFIG_MMU_CUSTOM_SATP_MODE=10
CONFIG_MMU_PAGE_SIZE_BYTES=2097152
CONFIG_MMU_LEVELS=5
CONFIG_MMU_PTE_SIZE_BYTES=8
CONFIG_MMU_PAGE_TABLE_SIZE_BYTES=2048
CONFIG_MMU_PTE_CUSTOM=y
CONFIG_MMU_PTE_FORMAT="custom"
CONFIG_MMU_PTE_PPN_LOW=10
CONFIG_MMU_PTE_PPN_HIGH=53
CONFIG_MMU_SUPERPAGE=y
CONFIG_MMU_AD_FAULT=y
CONFIG_MMU_AD_MODE="fault"
CONFIG_MMU_CACHE_PIPT=y
CONFIG_MMU_CACHE_MODE="pipt"
CONFIG_MMU_PTW_DEDICATED=y
CONFIG_MMU_PTW_PATH="dedicated"
CONFIG_MMU_PTW_INDEPENDENT=y
CONFIG_MMU_PTW_ARCH="independent"
CONFIG_MMU_PTW_OUTSTANDING=2
CONFIG_MMU_PTW_BUS_OUTSTANDING=1
CONFIG_MMU_PTW_IN_ORDER=y
CONFIG_MMU_PTW_ORDER="in_order"
CONFIG_MMU_PTW_CACHE=n

CONFIG_TLB_SPLIT=y
CONFIG_TLB_ORGANIZATION="split"
CONFIG_TLB_STORAGE_REG=y
CONFIG_TLB_STORAGE="reg"
CONFIG_TLB_REPLACE_PLRU=y
CONFIG_TLB_REPLACEMENT="plru"
CONFIG_TLB_ASID_BITS=16
CONFIG_TLB_GLOBAL=y
CONFIG_ITLB_ENTRIES=16
CONFIG_ITLB_WAYS=2
CONFIG_DTLB_ENTRIES=32
CONFIG_DTLB_WAYS=4
CONFIG_TLB_SUPERPAGE=y
CONFIG_TLB_MISS_QUEUE_FOLLOW=y
CONFIG_TLB_MISS_QUEUE_MODE="follow_tlb"
CONFIG_ITLB_MISS_QUEUE_ENTRIES=4
CONFIG_DTLB_MISS_QUEUE_ENTRIES=4
CONFIG_TLB_REFILL_PORTS=1

CONFIG_HAS_S_TIMER_IRQ=y
CONFIG_HAS_S_EXTERNAL_IRQ=y
CONFIG_TIMER_CLINT_MTIP=y
CONFIG_TIMER_PATH="clint_mtip"
CONFIG_PLIC_SOURCES=32
CONFIG_PLIC_PRIORITY_BITS=3
CONFIG_PLIC_MAX_PRIORITY=7
CONFIG_PLIC_BASE=0x0c000000
CONFIG_HAS_PMP=n

CONFIG_CSR_MISSING_ILLEGAL=y
CONFIG_CSR_MISSING_MODE="illegal"
CONFIG_CSR_VIEW_BOUND=y
CONFIG_CSR_VIEW_MODE="bound"
CONFIG_CSR_FIELD_DEFAULT_READ="normal"
CONFIG_CSR_FIELD_DEFAULT_WRITE="normal"

CONFIG_HAS_CSR_MSTATUS=y
CONFIG_HAS_CSR_MISA=y
CONFIG_HAS_CSR_MTVEC=y
CONFIG_HAS_CSR_MEPC=y
CONFIG_HAS_CSR_MCAUSE=y
CONFIG_HAS_CSR_MTVAL=y
CONFIG_HAS_CSR_MSCRATCH=y
CONFIG_HAS_CSR_MIE=y
CONFIG_HAS_CSR_MIP=y
CONFIG_HAS_CSR_MEDELEG=y
CONFIG_HAS_CSR_MIDELEG=y
CONFIG_HAS_CSR_MCOUNTEREN=y
CONFIG_HAS_CSR_MCOUNTINHIBIT=y
CONFIG_HAS_CSR_MCYCLE=y
CONFIG_HAS_CSR_MINSTRET=y
CONFIG_HAS_CSR_SSTATUS=y
CONFIG_HAS_CSR_SIE=y
CONFIG_HAS_CSR_SIP=y
CONFIG_HAS_CSR_STVEC=y
CONFIG_HAS_CSR_SSCRATCH=y
CONFIG_HAS_CSR_SEPC=y
CONFIG_HAS_CSR_SCAUSE=y
CONFIG_HAS_CSR_STVAL=y
CONFIG_HAS_CSR_SATP=y
CONFIG_HAS_CSR_SCOUNTEREN=y
```

## npc/configs/rv64_linux_defconfig
```kconfig
# NPC 标准 RV64GC Linux 启动配置。
#
# 地址布局（全部由 Kconfig 生成，脚本不得硬编码）：
#   0x80000000  SBI 固件（2 MiB 预留）
#   0x80200000  Linux Image（SBI_NEXT_ADDR，S 模式入口）
#   0x82000000  initramfs（可关闭）
#   0x83f00000  DTB（SBI_FDT_ADDR，64 KiB 保留到 0x84000000）
#   0x84000000  RAM 结束（64 MiB）
#
# Image 和 initramfs 由用户自行提供；本配置只负责生成 DTB 和打包，
# 不会下载、编译或运行 Linux。首次使用前请把 Image / initramfs.cpio
# 放到 ysyx-workbench 根目录，或修改下面两个路径。
CONFIG_XLEN=64
CONFIG_RISCV_M=y
CONFIG_RISCV_A=y
CONFIG_RISCV_C=y
CONFIG_RISCV_F=y
CONFIG_RISCV_D=y
CONFIG_FPU_IMPL_HARDFLOAT=y
CONFIG_FPU_FLEN=64
CONFIG_FPU_PIPELINE=0
CONFIG_FPU_FMA=y
CONFIG_FPU_DIVSQRT=y
CONFIG_FPU_ROUNDING=y
CONFIG_FPU_FLAGS=y
CONFIG_FPU_HARDFLOAT_RECODE=y
# CONFIG_FPU_HARDFLOAT_TININESS_BEFORE_ROUNDING is not set
# CONFIG_FPU_FUDIAN_SHARED_DIVSQRT is not set

CONFIG_HAS_S=y
CONFIG_HAS_U=y
CONFIG_HAS_MMU=y
CONFIG_HAS_TLB=y

CONFIG_MMU_PROFILE_BALANCED=y
CONFIG_MMU_GEOMETRY_STANDARD=y
CONFIG_MMU_GEOMETRY_MODE="standard"
CONFIG_MMU_CUSTOM_SATP_MODE=10
CONFIG_MMU_PAGE_SIZE_BYTES=4096
CONFIG_MMU_LEVELS=3
CONFIG_MMU_PTE_SIZE_BYTES=8
CONFIG_MMU_PAGE_TABLE_SIZE_BYTES=4096
CONFIG_MMU_PTE_RISCV64=y
CONFIG_MMU_PTE_FORMAT="riscv64"
CONFIG_MMU_SUPERPAGE=y
CONFIG_MMU_AD_FAULT=y
CONFIG_MMU_AD_MODE="fault"
CONFIG_MMU_CACHE_PIPT=y
CONFIG_MMU_CACHE_MODE="pipt"
CONFIG_MMU_PTW_DEDICATED=y
CONFIG_MMU_PTW_PATH="dedicated"
CONFIG_MMU_PTW_INDEPENDENT=y
CONFIG_MMU_PTW_ARCH="independent"
CONFIG_MMU_PTW_OUTSTANDING=2
CONFIG_MMU_PTW_BUS_OUTSTANDING=1
CONFIG_MMU_PTW_IN_ORDER=y
CONFIG_MMU_PTW_ORDER="in_order"
CONFIG_MMU_PTW_CACHE=n

CONFIG_TLB_SPLIT=y
CONFIG_TLB_ORGANIZATION="split"
CONFIG_TLB_STORAGE_REG=y
CONFIG_TLB_STORAGE="reg"
CONFIG_TLB_REPLACE_PLRU=y
CONFIG_TLB_REPLACEMENT="plru"
CONFIG_TLB_ASID_BITS=16
CONFIG_TLB_GLOBAL=y
CONFIG_ITLB_ENTRIES=16
CONFIG_ITLB_WAYS=2
CONFIG_DTLB_ENTRIES=32
CONFIG_DTLB_WAYS=4
CONFIG_TLB_SUPERPAGE=y
CONFIG_TLB_MISS_QUEUE_FOLLOW=y
CONFIG_TLB_MISS_QUEUE_MODE="follow_tlb"
CONFIG_ITLB_MISS_QUEUE_ENTRIES=4
CONFIG_DTLB_MISS_QUEUE_ENTRIES=4
CONFIG_TLB_REFILL_PORTS=1

CONFIG_HAS_S_TIMER_IRQ=y
CONFIG_HAS_S_EXTERNAL_IRQ=y
CONFIG_TIMER_CLINT_MTIP=y
CONFIG_TIMER_PATH="clint_mtip"
CONFIG_PLIC_SOURCES=32
CONFIG_PLIC_PRIORITY_BITS=3
CONFIG_PLIC_MAX_PRIORITY=7
CONFIG_PLIC_BASE=0x0c000000
CONFIG_HAS_PMP=y
CONFIG_PMP_ENTRIES=16

CONFIG_CSR_MISSING_ILLEGAL=y
CONFIG_CSR_MISSING_MODE="illegal"
CONFIG_CSR_VIEW_BOUND=y
CONFIG_CSR_VIEW_MODE="bound"
CONFIG_CSR_FIELD_DEFAULT_READ="normal"
CONFIG_CSR_FIELD_DEFAULT_WRITE="normal"

CONFIG_HAS_CSR_MSTATUS=y
CONFIG_HAS_CSR_MISA=y
CONFIG_HAS_CSR_MTVEC=y
CONFIG_HAS_CSR_MEPC=y
CONFIG_HAS_CSR_MCAUSE=y
CONFIG_HAS_CSR_MTVAL=y
CONFIG_HAS_CSR_MSCRATCH=y
CONFIG_HAS_CSR_MIE=y
CONFIG_HAS_CSR_MIP=y
CONFIG_HAS_CSR_MEDELEG=y
CONFIG_HAS_CSR_MIDELEG=y
CONFIG_HAS_CSR_MCOUNTEREN=y
CONFIG_HAS_CSR_MCOUNTINHIBIT=y
CONFIG_HAS_CSR_MCYCLE=y
CONFIG_HAS_CSR_MINSTRET=y
CONFIG_HAS_CSR_SSTATUS=y
CONFIG_HAS_CSR_SIE=y
CONFIG_HAS_CSR_SIP=y
CONFIG_HAS_CSR_STVEC=y
CONFIG_HAS_CSR_SSCRATCH=y
CONFIG_HAS_CSR_SEPC=y
CONFIG_HAS_CSR_SCAUSE=y
CONFIG_HAS_CSR_STVAL=y
CONFIG_HAS_CSR_SATP=y
CONFIG_HAS_CSR_SCOUNTEREN=y

# 仿真/调试：与 rv64_sbi_fdt_defconfig 保持一致，保留 SDB 以便 --batch。
CONFIG_ICACHE=y
CONFIG_DCACHE=n
CONFIG_SDB=y
CONFIG_TRACE=n
CONFIG_FTRACE=n
CONFIG_IRINGBUF=n
CONFIG_ITRACE=n
CONFIG_MTRACE=n
CONFIG_DIFFTEST=n
CONFIG_LOG_TO_FILE=n
CONFIG_PERF_STATS=n
CONFIG_PERF_SAVE=n

# mtime 每个 CPU 周期 +1；DTB timebase 与 OpenSBI mtime_freq 都取 450MHz。
CONFIG_SYNTH_FREQ=450

# M 模式 SBI 固件：OpenSBI NPC 平台。
CONFIG_SBI_ENABLE=y
CONFIG_SBI_IMPL_OPENSBI=y
CONFIG_SBI_IMPL="opensbi"
CONFIG_SBI_PLATFORM="npc"
CONFIG_SBI_FW_BASE=0x80000000
CONFIG_SBI_FW_SIZE=0x00200000
CONFIG_SBI_NEXT_ADDR=0x80200000
CONFIG_SBI_BUILD_JOBS=0

# 向 S 模式 Linux 传递 DTB：地址复用 SBI_FDT_ADDR。
CONFIG_SBI_FDT_ENABLE=y
CONFIG_SBI_FDT_PATH="dts/npc.dts"
CONFIG_SBI_FDT_ADDR=0x83f00000

# Linux 启动镜像：只打包用户提供的文件，不下载/编译 Linux。
CONFIG_LINUX_BOOT_ENABLE=y
CONFIG_LINUX_IMAGE_PATH="Image"
CONFIG_LINUX_BOOTARGS="console=ttyS0,115200 earlycon=sbi"
CONFIG_LINUX_INITRAMFS_ENABLE=y
CONFIG_LINUX_INITRAMFS_PATH="initramfs.cpio"
CONFIG_LINUX_INITRAMFS_ADDR=0x82000000
```

## npc/configs/rv64_nanos_gc_defconfig
```kconfig
# Nanos-lite + Navy-apps 的 RV64GC/lp64d direct-NPC 配置。
#
# 与 rv64_mmu_defconfig 的区别：
#   * 打开 A/C/F/D 与 Berkeley HardFloat 后端，供 Navy 用户程序执行
#     RV64IMAFDC 指令；
#   * 时钟中断使用 direct_stip，让没有 M 模式 SBI 的 Nanos-lite 内核
#     直接收到 S 模式 STIP（scause=5），实现用户进程抢占；
#   * ICache/DCache 都打开，DCache line 为 32B，满足 F/D 的 8B 访问。
#
# direct-NPC 的 RAM 固定为 0x80000000 起 64MiB（NPC_RAM_SIZE=0x04000000），
# 地址布局由 npc/Makefile 与 RTL/PMA 共同保证，不在 Kconfig 里重复配置。
CONFIG_XLEN=64
CONFIG_RISCV_M=y
CONFIG_RISCV_A=y
CONFIG_RISCV_C=y
CONFIG_RISCV_F=y
CONFIG_RISCV_D=y
CONFIG_FPU_IMPL_HARDFLOAT=y
CONFIG_FPU_FLEN=64
CONFIG_FPU_PIPELINE=0
CONFIG_FPU_FMA=y
CONFIG_FPU_DIVSQRT=y
CONFIG_FPU_ROUNDING=y
CONFIG_FPU_FLAGS=y
CONFIG_FPU_HARDFLOAT_RECODE=y
# CONFIG_FPU_HARDFLOAT_TININESS_BEFORE_ROUNDING is not set
# CONFIG_FPU_FUDIAN_SHARED_DIVSQRT is not set

CONFIG_HAS_S=y
CONFIG_HAS_U=y
CONFIG_HAS_MMU=y
CONFIG_HAS_TLB=y

CONFIG_MMU_PROFILE_BALANCED=y
CONFIG_MMU_GEOMETRY_STANDARD=y
CONFIG_MMU_GEOMETRY_MODE="standard"
CONFIG_MMU_CUSTOM_SATP_MODE=10
CONFIG_MMU_PAGE_SIZE_BYTES=4096
CONFIG_MMU_LEVELS=3
CONFIG_MMU_PTE_SIZE_BYTES=8
CONFIG_MMU_PAGE_TABLE_SIZE_BYTES=4096
CONFIG_MMU_PTE_RISCV64=y
CONFIG_MMU_PTE_FORMAT="riscv64"
CONFIG_MMU_SUPERPAGE=y
CONFIG_MMU_AD_FAULT=y
CONFIG_MMU_AD_MODE="fault"
CONFIG_MMU_CACHE_PIPT=y
CONFIG_MMU_CACHE_MODE="pipt"
CONFIG_MMU_PTW_DEDICATED=y
CONFIG_MMU_PTW_PATH="dedicated"
CONFIG_MMU_PTW_INDEPENDENT=y
CONFIG_MMU_PTW_ARCH="independent"
CONFIG_MMU_PTW_OUTSTANDING=2
CONFIG_MMU_PTW_BUS_OUTSTANDING=1
CONFIG_MMU_PTW_IN_ORDER=y
CONFIG_MMU_PTW_ORDER="in_order"
CONFIG_MMU_PTW_CACHE=n

CONFIG_TLB_SPLIT=y
CONFIG_TLB_ORGANIZATION="split"
CONFIG_TLB_STORAGE_REG=y
CONFIG_TLB_STORAGE="reg"
CONFIG_TLB_REPLACE_PLRU=y
CONFIG_TLB_REPLACEMENT="plru"
CONFIG_TLB_ASID_BITS=16
CONFIG_TLB_GLOBAL=y
CONFIG_ITLB_ENTRIES=16
CONFIG_ITLB_WAYS=2
CONFIG_DTLB_ENTRIES=32
CONFIG_DTLB_WAYS=4
CONFIG_TLB_SUPERPAGE=y
CONFIG_TLB_MISS_QUEUE_FOLLOW=y
CONFIG_TLB_MISS_QUEUE_MODE="follow_tlb"
CONFIG_ITLB_MISS_QUEUE_ENTRIES=4
CONFIG_DTLB_MISS_QUEUE_ENTRIES=4
CONFIG_TLB_REFILL_PORTS=1

CONFIG_HAS_S_TIMER_IRQ=y
CONFIG_HAS_S_EXTERNAL_IRQ=y
# Nanos-lite 直接运行在 S 模式，没有 M 模式 SBI 把 MTIP 转成 STIP；
# direct_stip 让 CLINT 到期事件直接置 mip.STIP，经 mideleg 委托给 S 模式。
CONFIG_TIMER_DIRECT_STIP=y
CONFIG_TIMER_PATH="direct_stip"
CONFIG_PLIC_SOURCES=32
CONFIG_PLIC_PRIORITY_BITS=3
CONFIG_PLIC_MAX_PRIORITY=7
CONFIG_PLIC_BASE=0x0c000000
CONFIG_HAS_PMP=n

CONFIG_CSR_MISSING_ILLEGAL=y
CONFIG_CSR_MISSING_MODE="illegal"
CONFIG_CSR_VIEW_BOUND=y
CONFIG_CSR_VIEW_MODE="bound"
CONFIG_CSR_FIELD_DEFAULT_READ="normal"
CONFIG_CSR_FIELD_DEFAULT_WRITE="normal"

CONFIG_HAS_CSR_MSTATUS=y
CONFIG_HAS_CSR_MISA=y
CONFIG_HAS_CSR_MTVEC=y
CONFIG_HAS_CSR_MEPC=y
CONFIG_HAS_CSR_MCAUSE=y
CONFIG_HAS_CSR_MTVAL=y
CONFIG_HAS_CSR_MSCRATCH=y
CONFIG_HAS_CSR_MIE=y
CONFIG_HAS_CSR_MIP=y
CONFIG_HAS_CSR_MEDELEG=y
CONFIG_HAS_CSR_MIDELEG=y
CONFIG_HAS_CSR_MCOUNTEREN=y
CONFIG_HAS_CSR_MCOUNTINHIBIT=y
CONFIG_HAS_CSR_MCYCLE=y
CONFIG_HAS_CSR_MINSTRET=y
CONFIG_HAS_CSR_SSTATUS=y
CONFIG_HAS_CSR_SIE=y
CONFIG_HAS_CSR_SIP=y
CONFIG_HAS_CSR_STVEC=y
CONFIG_HAS_CSR_SSCRATCH=y
CONFIG_HAS_CSR_SEPC=y
CONFIG_HAS_CSR_SCAUSE=y
CONFIG_HAS_CSR_STVAL=y
CONFIG_HAS_CSR_SATP=y
CONFIG_HAS_CSR_SCOUNTEREN=y

# Nanos 不打开 SDB：批处理运行不需要交互命令，减少仿真开销。
# ftrace/iringbuf 默认关闭，避免 UART 逐字符输出被调试日志拖慢。
CONFIG_ICACHE=y
CONFIG_DCACHE=y
CONFIG_CACHE_BLOCK_SIZE_LOG2=5
CONFIG_CACHE_INDEX_BITS=6
CONFIG_ICACHE_BLOCK_SIZE_LOG2=5
CONFIG_ICACHE_INDEX_BITS=6
CONFIG_DCACHE_BLOCK_SIZE_LOG2=5
CONFIG_DCACHE_INDEX_BITS=6
CONFIG_ICACHE_STORAGE_REG=y
CONFIG_DCACHE_STORAGE_REG=y
CONFIG_SDB=n
CONFIG_TRACE=n
CONFIG_FTRACE=n
CONFIG_IRINGBUF=n
CONFIG_ITRACE=n
CONFIG_MTRACE=n
CONFIG_DIFFTEST=n
CONFIG_LOG_TO_FILE=n
CONFIG_PERF_STATS=n
CONFIG_PERF_SAVE=n
```

## npc/configs/rv64_sbi_fdt_defconfig
```kconfig
# OpenSBI on NPC 的启动配置：RV64IMA + Sv39 + PMP + CLINT/PLIC/UART。
# OpenSBI 的 _start 使用 amoswap.w，故 RISCV_A 必须打开；
# 固件本身按无 F/D 的 rv64ima_zicsr_zifencei 编译（见构建脚本）。
# SBI_ENABLE 默认在通用 Kconfig 中为 n，本 defconfig 显式打开。
CONFIG_XLEN=64
CONFIG_RISCV_M=y
CONFIG_RISCV_A=y
# 固件按 rv64ima_zicsr_zifencei 编译，显式关闭 G 扩展的其余部分。
CONFIG_RISCV_C=n
CONFIG_RISCV_F=n
CONFIG_RISCV_D=n
CONFIG_HAS_S=y
CONFIG_HAS_U=y
CONFIG_HAS_MMU=y
CONFIG_HAS_TLB=y

CONFIG_MMU_PROFILE_BALANCED=y
CONFIG_MMU_GEOMETRY_STANDARD=y
CONFIG_MMU_GEOMETRY_MODE="standard"
CONFIG_MMU_CUSTOM_SATP_MODE=10
CONFIG_MMU_PAGE_SIZE_BYTES=4096
CONFIG_MMU_LEVELS=3
CONFIG_MMU_PTE_SIZE_BYTES=8
CONFIG_MMU_PAGE_TABLE_SIZE_BYTES=4096
CONFIG_MMU_PTE_RISCV64=y
CONFIG_MMU_PTE_FORMAT="riscv64"
CONFIG_MMU_SUPERPAGE=y
CONFIG_MMU_AD_FAULT=y
CONFIG_MMU_AD_MODE="fault"
CONFIG_MMU_CACHE_PIPT=y
CONFIG_MMU_CACHE_MODE="pipt"
CONFIG_MMU_PTW_DEDICATED=y
CONFIG_MMU_PTW_PATH="dedicated"
CONFIG_MMU_PTW_INDEPENDENT=y
CONFIG_MMU_PTW_ARCH="independent"
CONFIG_MMU_PTW_OUTSTANDING=2
CONFIG_MMU_PTW_BUS_OUTSTANDING=1
CONFIG_MMU_PTW_IN_ORDER=y
CONFIG_MMU_PTW_ORDER="in_order"
CONFIG_MMU_PTW_CACHE=n

CONFIG_TLB_SPLIT=y
CONFIG_TLB_ORGANIZATION="split"
CONFIG_TLB_STORAGE_REG=y
CONFIG_TLB_STORAGE="reg"
CONFIG_TLB_REPLACE_PLRU=y
CONFIG_TLB_REPLACEMENT="plru"
CONFIG_TLB_ASID_BITS=16
CONFIG_TLB_GLOBAL=y
CONFIG_ITLB_ENTRIES=16
CONFIG_ITLB_WAYS=2
CONFIG_DTLB_ENTRIES=32
CONFIG_DTLB_WAYS=4
CONFIG_TLB_SUPERPAGE=y
CONFIG_TLB_MISS_QUEUE_FOLLOW=y
CONFIG_TLB_MISS_QUEUE_MODE="follow_tlb"
CONFIG_ITLB_MISS_QUEUE_ENTRIES=4
CONFIG_DTLB_MISS_QUEUE_ENTRIES=4
CONFIG_TLB_REFILL_PORTS=1

CONFIG_HAS_S_TIMER_IRQ=y
CONFIG_HAS_S_EXTERNAL_IRQ=y
CONFIG_TIMER_CLINT_MTIP=y
CONFIG_TIMER_PATH="clint_mtip"
CONFIG_PLIC_SOURCES=32
CONFIG_PLIC_PRIORITY_BITS=3
CONFIG_PLIC_MAX_PRIORITY=7
CONFIG_PLIC_BASE=0x0c000000
CONFIG_HAS_PMP=y
CONFIG_PMP_ENTRIES=16

CONFIG_CSR_MISSING_ILLEGAL=y
CONFIG_CSR_MISSING_MODE="illegal"
CONFIG_CSR_VIEW_BOUND=y
CONFIG_CSR_VIEW_MODE="bound"
CONFIG_CSR_FIELD_DEFAULT_READ="normal"
CONFIG_CSR_FIELD_DEFAULT_WRITE="normal"

CONFIG_HAS_CSR_MSTATUS=y
CONFIG_HAS_CSR_MISA=y
CONFIG_HAS_CSR_MTVEC=y
CONFIG_HAS_CSR_MEPC=y
CONFIG_HAS_CSR_MCAUSE=y
CONFIG_HAS_CSR_MTVAL=y
CONFIG_HAS_CSR_MSCRATCH=y
CONFIG_HAS_CSR_MIE=y
CONFIG_HAS_CSR_MIP=y
CONFIG_HAS_CSR_MEDELEG=y
CONFIG_HAS_CSR_MIDELEG=y
CONFIG_HAS_CSR_MCOUNTEREN=y
CONFIG_HAS_CSR_MCOUNTINHIBIT=y
CONFIG_HAS_CSR_MCYCLE=y
CONFIG_HAS_CSR_MINSTRET=y
CONFIG_HAS_CSR_SSTATUS=y
CONFIG_HAS_CSR_SIE=y
CONFIG_HAS_CSR_SIP=y
CONFIG_HAS_CSR_STVEC=y
CONFIG_HAS_CSR_SSCRATCH=y
CONFIG_HAS_CSR_SEPC=y
CONFIG_HAS_CSR_SCAUSE=y
CONFIG_HAS_CSR_STVAL=y
CONFIG_HAS_CSR_SATP=y
CONFIG_HAS_CSR_SCOUNTEREN=y

# SBI 启动/调试：保留 SDB（--batch 需要），DiffTest 关闭以缩小构建。
# ftrace 会把 UART 逐字符输出与调用日志交错并显著拖慢启动，故默认关闭；
# 需要定位时再单独打开 CONFIG_TRACE/FTRACE/IRINGBUF。
# ICache 打开、DCache 关闭：沿用 xv6 已验证的最小组合；
# SBI 固件本身不依赖 D-cache。
CONFIG_ICACHE=y
CONFIG_DCACHE=n
CONFIG_SDB=y
CONFIG_TRACE=n
CONFIG_FTRACE=n
CONFIG_IRINGBUF=n
CONFIG_ITRACE=n
CONFIG_MTRACE=n
CONFIG_DIFFTEST=n
CONFIG_LOG_TO_FILE=n
CONFIG_PERF_STATS=n
CONFIG_PERF_SAVE=n

# M 模式 SBI 固件：OpenSBI NPC 平台。
# 默认布局：0x80000000 + 2 MiB 固件区，S 模式 next-stage 在 0x80200000。
CONFIG_SBI_ENABLE=y
CONFIG_SBI_IMPL_OPENSBI=y
CONFIG_SBI_IMPL="opensbi"
CONFIG_SBI_PLATFORM="npc"
CONFIG_SBI_FW_BASE=0x80000000
CONFIG_SBI_FW_SIZE=0x00200000
CONFIG_SBI_NEXT_ADDR=0x80200000
CONFIG_SBI_BUILD_JOBS=0

# 向 S 模式 next-stage 传递 DTB：Linux 需要 a1 指向有效的 FDT。
# 默认 0x80f00000 位于 0x80200000 next-stage 之后约 13 MiB；
# 若内核镜像更大，请同时调整 SBI_FDT_ADDR/SBI_NEXT_ADDR。
CONFIG_SBI_FDT_ENABLE=y
CONFIG_SBI_FDT_PATH="dts/npc.dts"
CONFIG_SBI_FDT_ADDR=0x80f00000
```
