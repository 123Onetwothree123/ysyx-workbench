## nemu/configs/riscv32-am_defconfig
```kconfig
CONFIG_TARGET_AM=y
# CONFIG_TRACE is not set
#CONFIG_MSIZE=0x2000000
#原本的0x2000000内存不够，跑GUI马里奥爆内存了
CONFIG_MSIZE=0x0x8000000
CONFIG_DEVICE=y
```

## nemu/configs/riscv64-fd-diff_defconfig
```kconfig
# RV64 NEMU DiffTest DUT：RV64IMAFDC，用于检查 freg/fcsr 可选 ABI
CONFIG_ISA_riscv=y
CONFIG_RV64=y
CONFIG_RISCV_A=y
CONFIG_RISCV_C=y
CONFIG_RISCV_F=y
CONFIG_RISCV_D=y
CONFIG_TARGET_NATIVE_ELF=y
CONFIG_MSIZE=0x8000000
CONFIG_DEVICE=y
CONFIG_DIFFTEST=y
# CONFIG_TRACE is not set
# CONFIG_ITRACE is not set
# CONFIG_IRINGBUF is not set
# CONFIG_MTRACE is not set
# CONFIG_ReadELF is not set
# CONFIG_FTRACE is not set
# CONFIG_DTRACE is not set
# CONFIG_ETRACE is not set
# CONFIG_BTRACE is not set
```

## nemu/configs/riscv64-fd-ref_defconfig
```kconfig
# RV64 NEMU DiffTest 参考库：RV64IMAFDC
CONFIG_ISA_riscv=y
CONFIG_RV64=y
CONFIG_RISCV_A=y
CONFIG_RISCV_C=y
CONFIG_RISCV_F=y
CONFIG_RISCV_D=y
CONFIG_TARGET_SHARE=y
CONFIG_MSIZE=0x8000000
# CONFIG_TRACE is not set
# CONFIG_DIFFTEST is not set
```

## nemu/configs/riscv64-rvc_defconfig
```kconfig
# RV64 NEMU 独立运行配置：RV64IMAC，用于 RVC 定向测试
CONFIG_ISA_riscv=y
CONFIG_RV64=y
CONFIG_RISCV_A=y
CONFIG_RISCV_C=y
CONFIG_TARGET_NATIVE_ELF=y
CONFIG_MSIZE=0x8000000
CONFIG_DEVICE=y
CONFIG_TRACE=y
CONFIG_ITRACE=y
CONFIG_IRINGBUF=y
# CONFIG_MTRACE is not set
CONFIG_ReadELF=y
CONFIG_FTRACE=y
# CONFIG_DTRACE is not set
# CONFIG_ETRACE is not set
# CONFIG_BTRACE is not set
# CONFIG_DIFFTEST is not set
```

## nemu/configs/riscv64-xv6-trace_defconfig
```kconfig
# RV64 xv6 golden trace 构建：只在 usertrap / userret 附近写 ITRACE
CONFIG_ISA_riscv=y
CONFIG_RV64=y
CONFIG_RISCV_A=y
CONFIG_TARGET_NATIVE_ELF=y
CONFIG_MSIZE=0x8000000
CONFIG_DEVICE=y
CONFIG_HAS_RISCV_XV6=y
# CONFIG_HAS_SERIAL is not set
# CONFIG_HAS_TIMER is not set
# CONFIG_HAS_KEYBOARD is not set
# CONFIG_HAS_VGA is not set
# CONFIG_HAS_AUDIO is not set
# CONFIG_HAS_DISK is not set
CONFIG_TRACE=y
CONFIG_TRACE_START=0
CONFIG_TRACE_END=2000000000
CONFIG_ITRACE=y
# xv6-riscv PLATFORM=nemu 的固定地址：
#   prepare_return/usertrap = 0x80003634..0x80003900
#   trampoline 运行时映射在 0x3ffffff000，userret 偏移 0xb0
CONFIG_ITRACE_COND="(cpu.pc>=0x80003600&&cpu.pc<=0x80003900)||(cpu.pc>=0x3ffffff000&&cpu.pc<=0x3ffffff200)"
CONFIG_IRINGBUF=y
CONFIG_IRINGBUF_SIZE=4096
CONFIG_ReadELF=y
# CONFIG_FTRACE is not set
# CONFIG_MTRACE is not set
# CONFIG_DTRACE is not set
# CONFIG_ETRACE is not set
# CONFIG_BTRACE is not set
# CONFIG_WATCHPOINT is not set
# CONFIG_DIFFTEST is not set
```

## nemu/configs/riscv64-xv6_defconfig
```kconfig
# RV64 NEMU 独立运行 xv6-riscv（RV64IMA + CLINT/PLIC/16550）
CONFIG_ISA_riscv=y
CONFIG_RV64=y
CONFIG_RISCV_A=y
CONFIG_TARGET_NATIVE_ELF=y
CONFIG_MSIZE=0x8000000
CONFIG_DEVICE=y
CONFIG_HAS_RISCV_XV6=y
# 只保留 xv6 平台设备，避免 SDL/VGA/键鼠/音频/磁盘依赖
# CONFIG_HAS_SERIAL is not set
# CONFIG_HAS_TIMER is not set
# CONFIG_HAS_KEYBOARD is not set
# CONFIG_HAS_VGA is not set
# CONFIG_HAS_AUDIO is not set
# CONFIG_HAS_DISK is not set
# 保留 TRACE 以启用 ftrace；expr/watchpoint 的逐指令日志已移除，
# 不会像旧版本那样把单步输出淹没。
CONFIG_TRACE=y
CONFIG_TRACE_START=0
CONFIG_TRACE_END=2000000000
# xv6 启动指令量大，逐条 ITRACE 会拖慢并占满磁盘
# CONFIG_ITRACE is not set
CONFIG_WATCHPOINT=y
CONFIG_IRINGBUF=y
CONFIG_IRINGBUF_SIZE=4096
# 用于 --elf 和 ftrace 符号解析
CONFIG_ReadELF=y
CONFIG_FTRACE=y
# CONFIG_MTRACE is not set
# CONFIG_DTRACE is not set
# CONFIG_ETRACE is not set
# CONFIG_BTRACE is not set
# CONFIG_DIFFTEST is not set
```

## nemu/configs/riscv64_defconfig
```kconfig
# RV64 原生 NEMU 参考模型（RV64IM + M/S/U + Sv39/Sv48）
CONFIG_ISA_riscv=y
CONFIG_RV64=y
CONFIG_RISCV_A=y
CONFIG_TARGET_NATIVE_ELF=y
CONFIG_MSIZE=0x8000000
CONFIG_DEVICE=y
CONFIG_TRACE=y
CONFIG_ITRACE=y
CONFIG_IRINGBUF=y
# CONFIG_MTRACE is not set
CONFIG_ReadELF=y
CONFIG_FTRACE=y
# CONFIG_DTRACE is not set
# CONFIG_ETRACE is not set
# CONFIG_BTRACE is not set
# CONFIG_DIFFTEST is not set
```

## nemu/src/isa/riscv32/Kconfig
```kconfig
menu "ISA-dependent Options for riscv"

config RV64
  bool "64-bit RISC-V architecture"
  default n

config RVE
  bool "Use E extension"
  default n

config RISCV_F
  bool "F extension (single-precision floating point)"
  default n
  depends on !TARGET_AM && !RVE
  help
    实现 RV32/RV64 的 F 扩展：FLW/FSW、FMV、FADD/SUB/MUL/DIV/
    SQRT、FMIN/MAX、FSGNJ、FEQ/FLT/FLE、FCLASS、FCVT 和 FMA。
    浮点运算由仓库内 tools/softfloat 的 Berkeley SoftFloat 完成，
    严格执行 RISC-V 的舍入模式、canonical NaN 与 fflags 语义。
    默认关闭，避免改变现有整数参考模型和 DiffTest 状态布局。

config RISCV_D
  bool "D extension (double-precision floating point)"
  default n
  depends on RISCV_F && !TARGET_AM
  help
    实现 RV32/RV64 的 D 扩展：FLD/FSD、D 精度算术/比较/转换/FMA，
    以及 RV64 的 FMV.X.D/FMV.D.X。D 依赖 F。打开后 f 寄存器按
    FLEN=64 保存，单精度结果使用标准 NaN boxing。

config RISCV_A
  bool "A extension (LR/SC and AMO)"
  default y
  help
    实现 RV32/RV64 的 LR/SC 与 AMO 指令。xv6-riscv 的
    spinlock 需要 AMOSWAP.W；其余 AMO 也一并实现，供 DiffTest
    与编译器原子模式使用。

config RISCV_C
  bool "C extension (compressed 16-bit instructions)"
  default n
  help
    实现 RV32C/RV64C 压缩指令扩展：取指长度可在 16/32 位之间
    变化，PC 允许 2 字节对齐，misa.C 置位。默认关闭，避免改变
    现有 RV32/RV64 参考模型的 IALIGN=32 行为。
    开启后仍只接受合法的 C 编码；保留/非法编码按非法指令陷入。

# 兼容外部脚本常用的 CONFIG_RVC 名称。真正的菜单项是 RISCV_C，
# 这个隐藏符号只负责在 autoconf.h 中同时生成 CONFIG_RVC。
config RVC
  bool
  default y if RISCV_C
endmenu
```

## npc/Kconfig
```kconfig
mainmenu "NPC配置菜单"

# 顶层只做主题分组；具体选项在 kconfig/ 下的子文件里。
# 重排只移动 menu，不改变 CONFIG_* 符号名、默认值或依赖关系。

source "kconfig/Kconfig.hardware"   # CPU 与平台
source "kconfig/Kconfig.soc"        # SoC 与外设

menu "运行时与调试"
  source "kconfig/Kconfig.debug"    # 调试、追踪与性能
  source "kconfig/Kconfig.log"      # 日志
endmenu

menu "固件与启动"
  source "kconfig/Kconfig.sbi"
  source "kconfig/Kconfig.linux"
  source "kconfig/Kconfig.rootfs"
endmenu

source "kconfig/Kconfig.fpga"      # FPGA 部署

menu "构建与仿真"
  source "kconfig/Kconfig.cpp"      # 编译器与构建选项
  if !(FPGA_ENABLE && FPGA_SIM_EXCLUSIVE)
    source "kconfig/Kconfig.verilator"
  endif
  if FPGA_ENABLE && FPGA_SIM_EXCLUSIVE
    comment "FPGA 互斥模式：Verilator 仿真选项已关闭"
  endif
  source "kconfig/Kconfig.synth"
endmenu
```

## npc/configs/mmu_default_defconfig
```kconfig
CONFIG_HAS_S=y
CONFIG_HAS_U=y
CONFIG_HAS_MMU=y
CONFIG_HAS_TLB=y

CONFIG_MMU_PROFILE_BALANCED=y
CONFIG_MMU_PROFILE="balanced"
CONFIG_MMU_PAGE_SIZE_BYTES=4096
CONFIG_MMU_LEVELS=2
CONFIG_MMU_PTE_SIZE_BYTES=4
CONFIG_MMU_PAGE_TABLE_SIZE_BYTES=4096
CONFIG_MMU_PTE_RISCV32=y
CONFIG_MMU_PTE_FORMAT="riscv32"
CONFIG_MMU_SUPERPAGE=n
CONFIG_MMU_AD_FAULT=y
CONFIG_MMU_AD_MODE="fault"
CONFIG_MMU_CACHE_PIPT=y
CONFIG_MMU_CACHE_MODE="pipt"
CONFIG_MMU_PTW_DEDICATED=y
CONFIG_MMU_PTW_PATH="dedicated"
CONFIG_MMU_PTW_INDEPENDENT=y
CONFIG_MMU_PTW_ARCH="independent"
CONFIG_MMU_PTW_OUTSTANDING=2
CONFIG_MMU_PTW_IN_ORDER=y
CONFIG_MMU_PTW_ORDER="in_order"
CONFIG_MMU_PTW_CACHE=n

CONFIG_TLB_SPLIT=y
CONFIG_TLB_ORGANIZATION="split"
CONFIG_TLB_STORAGE_REG=y
CONFIG_TLB_STORAGE="reg"
CONFIG_TLB_REPLACE_PLRU=y
CONFIG_TLB_REPLACEMENT="plru"
CONFIG_TLB_ASID_BITS=9
CONFIG_TLB_GLOBAL=y
CONFIG_ITLB_ENTRIES=16
CONFIG_ITLB_WAYS=2
CONFIG_DTLB_ENTRIES=32
CONFIG_DTLB_WAYS=4
CONFIG_TLB_SUPERPAGE=n
CONFIG_TLB_MISS_QUEUE_FOLLOW=y
CONFIG_TLB_MISS_QUEUE_MODE="follow_tlb"
CONFIG_ITLB_MISS_QUEUE_ENTRIES=4
CONFIG_DTLB_MISS_QUEUE_ENTRIES=4
CONFIG_TLB_REFILL_PORTS=1

CONFIG_HAS_S_TIMER_IRQ=y
CONFIG_HAS_S_EXTERNAL_IRQ=y
CONFIG_TIMER_CLINT_MTIP=y
CONFIG_TIMER_PATH="clint_mtip"
CONFIG_PLIC_SOURCES=32
CONFIG_PLIC_PRIORITY_BITS=3
CONFIG_PLIC_MAX_PRIORITY=7
CONFIG_PLIC_BASE=0x0c000000
CONFIG_HAS_PMP=n

CONFIG_CSR_MISSING_ILLEGAL=y
CONFIG_CSR_MISSING_MODE="illegal"
CONFIG_CSR_VIEW_BOUND=y
CONFIG_CSR_VIEW_MODE="bound"
CONFIG_CSR_FIELD_DEFAULT_READ="normal"
CONFIG_CSR_FIELD_DEFAULT_WRITE="normal"

CONFIG_HAS_CSR_MSTATUS=y
CONFIG_HAS_CSR_MISA=y
CONFIG_HAS_CSR_MTVEC=y
CONFIG_HAS_CSR_MEPC=y
CONFIG_HAS_CSR_MCAUSE=y
CONFIG_HAS_CSR_MTVAL=y
CONFIG_HAS_CSR_MSCRATCH=y
CONFIG_HAS_CSR_MIE=y
CONFIG_HAS_CSR_MIP=y
CONFIG_HAS_CSR_MEDELEG=y
CONFIG_HAS_CSR_MIDELEG=y
CONFIG_HAS_CSR_MCOUNTEREN=y
CONFIG_HAS_CSR_MCOUNTINHIBIT=y
CONFIG_HAS_CSR_MCYCLE=y
CONFIG_HAS_CSR_MINSTRET=y
CONFIG_HAS_CSR_SSTATUS=y
CONFIG_HAS_CSR_SIE=y
CONFIG_HAS_CSR_SIP=y
CONFIG_HAS_CSR_STVEC=y
CONFIG_HAS_CSR_SSCRATCH=y
CONFIG_HAS_CSR_SEPC=y
CONFIG_HAS_CSR_SCAUSE=y
CONFIG_HAS_CSR_STVAL=y
CONFIG_HAS_CSR_SATP=y
CONFIG_HAS_CSR_SCOUNTEREN=y
```

## npc/configs/rv32_f_defconfig
```kconfig
# RV32F + Berkeley HardFloat 短回归：RV32IMACF，无 MMU，FLEN=32。
CONFIG_XLEN=32
CONFIG_RISCV_M=y
CONFIG_RISCV_C=y
CONFIG_RISCV_F=y
CONFIG_FPU_IMPL_HARDFLOAT=y
CONFIG_FPU_FLEN=32
CONFIG_FPU_PIPELINE=0
CONFIG_FPU_FMA=y
CONFIG_FPU_DIVSQRT=y
CONFIG_FPU_ROUNDING=y
CONFIG_FPU_FLAGS=y
CONFIG_FPU_HARDFLOAT_RECODE=y
# CONFIG_FPU_HARDFLOAT_TININESS_BEFORE_ROUNDING is not set
# CONFIG_FPU_FUDIAN_SHARED_DIVSQRT is not set

CONFIG_HAS_S=y
CONFIG_HAS_U=y
# 保持无 MMU 的裸机回归基线，不跟随 RV64 Linux 的默认 MMU 配置。
CONFIG_HAS_MMU=n
CONFIG_HAS_TLB=n
CONFIG_CSR_MISSING_ILLEGAL=y
CONFIG_CSR_VIEW_BOUND=y
CONFIG_CSR_FIELD_DEFAULT_READ="normal"
CONFIG_CSR_FIELD_DEFAULT_WRITE="normal"
CONFIG_HAS_CSR_MSTATUS=y
CONFIG_HAS_CSR_MISA=y
CONFIG_HAS_CSR_MTVEC=y
CONFIG_HAS_CSR_MEPC=y
CONFIG_HAS_CSR_MCAUSE=y
CONFIG_HAS_CSR_MTVAL=y
CONFIG_HAS_CSR_MSCRATCH=y
CONFIG_HAS_CSR_MIE=y
CONFIG_HAS_CSR_MIP=y
CONFIG_HAS_CSR_MEDELEG=y
CONFIG_HAS_CSR_MIDELEG=y
CONFIG_HAS_CSR_MCOUNTEREN=y
CONFIG_HAS_CSR_MCOUNTINHIBIT=y
CONFIG_HAS_CSR_MCYCLE=y
CONFIG_HAS_CSR_MINSTRET=y
CONFIG_HAS_CSR_SSTATUS=y
CONFIG_HAS_CSR_STVEC=y
CONFIG_HAS_CSR_SSCRATCH=y
CONFIG_HAS_CSR_SEPC=y
CONFIG_HAS_CSR_SCAUSE=y
CONFIG_HAS_CSR_STVAL=y
CONFIG_HAS_CSR_SCOUNTEREN=y

CONFIG_ICACHE=y
CONFIG_DCACHE=y
CONFIG_CACHE_BLOCK_SIZE_LOG2=4
CONFIG_CACHE_INDEX_BITS=4
CONFIG_ICACHE_STORAGE_REG=y
CONFIG_DCACHE_STORAGE_REG=y
CONFIG_SDB=n
CONFIG_TRACE=y
CONFIG_DIFFTEST=y
CONFIG_LOG_TO_FILE=n
CONFIG_PERF_STATS=n
CONFIG_PERF_SAVE=n
```

## npc/configs/rv32_noc_defconfig
```kconfig
# RV32 无 C 扩展负向回归：验证压缩编码在 RISCV_C=n 时明确触发
# illegal instruction(cause=2)，而不是被当作 32 位指令执行。
CONFIG_XLEN=32
CONFIG_RISCV_M=y
CONFIG_RISCV_A=n
CONFIG_RISCV_C=n
CONFIG_ICACHE=y
CONFIG_DCACHE=y
CONFIG_CACHE_BLOCK_SIZE_LOG2=4
CONFIG_CACHE_INDEX_BITS=4
CONFIG_ICACHE_STORAGE_REG=y
CONFIG_DCACHE_STORAGE_REG=y
CONFIG_SDB=n
CONFIG_TRACE=y
CONFIG_DIFFTEST=n
CONFIG_LOG_TO_FILE=n
CONFIG_PERF_STATS=n
CONFIG_PERF_SAVE=n
```

## npc/configs/rv64_c_defconfig
```kconfig
# RV64C 裸机回归：RV64IMAC，无 MMU，ICache/DCache 打开。
# 用于 csrc/Test/rvc-test 的 RV64 C.ADDIW/C.LD/C.SD 与 16/32 位混合取指验证。
CONFIG_XLEN=64
CONFIG_RISCV_M=y
CONFIG_RISCV_C=y
# 保持 RV64IMAC 裸机基线：不启用 F/D，也不生成 MMU。
CONFIG_RISCV_F=n
CONFIG_RISCV_D=n

# Trap/CSR：M 模式基础 + S 模式 sepc/stval 委托测试。
CONFIG_HAS_S=y
CONFIG_HAS_U=y
CONFIG_HAS_MMU=n
CONFIG_HAS_TLB=n
CONFIG_CSR_MISSING_ILLEGAL=y
CONFIG_CSR_VIEW_BOUND=y
CONFIG_CSR_FIELD_DEFAULT_READ="normal"
CONFIG_CSR_FIELD_DEFAULT_WRITE="normal"
CONFIG_HAS_CSR_MSTATUS=y
CONFIG_HAS_CSR_MISA=y
CONFIG_HAS_CSR_MTVEC=y
CONFIG_HAS_CSR_MEPC=y
CONFIG_HAS_CSR_MCAUSE=y
CONFIG_HAS_CSR_MTVAL=y
CONFIG_HAS_CSR_MSCRATCH=y
CONFIG_HAS_CSR_MIE=y
CONFIG_HAS_CSR_MIP=y
CONFIG_HAS_CSR_MEDELEG=y
CONFIG_HAS_CSR_MIDELEG=y
CONFIG_HAS_CSR_MCOUNTEREN=y
CONFIG_HAS_CSR_MCOUNTINHIBIT=y
CONFIG_HAS_CSR_MCYCLE=y
CONFIG_HAS_CSR_MINSTRET=y
CONFIG_HAS_CSR_SSTATUS=y
CONFIG_HAS_CSR_STVEC=y
CONFIG_HAS_CSR_SSCRATCH=y
CONFIG_HAS_CSR_SEPC=y
CONFIG_HAS_CSR_SCAUSE=y
CONFIG_HAS_CSR_STVAL=y
CONFIG_HAS_CSR_SCOUNTEREN=y

CONFIG_ICACHE=y
CONFIG_DCACHE=y
CONFIG_CACHE_BLOCK_SIZE_LOG2=4
CONFIG_CACHE_INDEX_BITS=4
CONFIG_ICACHE_STORAGE_REG=y
CONFIG_DCACHE_STORAGE_REG=y
CONFIG_SDB=n
CONFIG_TRACE=y
CONFIG_DIFFTEST=y
CONFIG_LOG_TO_FILE=n
CONFIG_PERF_STATS=n
CONFIG_PERF_SAVE=n
```

## npc/configs/rv64_custom_deep_defconfig
```kconfig
CONFIG_XLEN=64
CONFIG_RISCV_M=y
CONFIG_HAS_S=y
CONFIG_HAS_U=y
CONFIG_HAS_MMU=y
CONFIG_HAS_TLB=y

# RV64 CUSTOM 深页表示例：4KiB 基础页 + 5 级 + 每级 512 项（9 位索引），
# 有效 VA=12+5*9=57 位。satp MODE=11 是显式 CUSTOM 扩展。
# 6 级 × 9 位索引会得到 66 位 VA，超过 64 位；需要 6 级时必须减小
# 每级页表项数（例如 2048B 页表/8B PTE = 8 位索引 → 60 位 VA）。
# 配置层允许这些自由参数；未合入大页 RTL 的树会在
# elaboration 阶段按旧的 1..4 级能力明确拒绝。
CONFIG_MMU_PROFILE_CUSTOM=y
CONFIG_MMU_GEOMETRY_CUSTOM=y
CONFIG_MMU_GEOMETRY_MODE="custom"
CONFIG_MMU_CUSTOM_SATP_MODE=11
CONFIG_MMU_PAGE_SIZE_BYTES=4096
CONFIG_MMU_LEVELS=5
CONFIG_MMU_PTE_SIZE_BYTES=8
CONFIG_MMU_PAGE_TABLE_SIZE_BYTES=4096
CONFIG_MMU_PTE_CUSTOM=y
CONFIG_MMU_PTE_FORMAT="custom"
CONFIG_MMU_PTE_PPN_LOW=10
CONFIG_MMU_PTE_PPN_HIGH=53
CONFIG_MMU_SUPERPAGE=y
CONFIG_MMU_AD_FAULT=y
CONFIG_MMU_AD_MODE="fault"
CONFIG_MMU_CACHE_PIPT=y
CONFIG_MMU_CACHE_MODE="pipt"
CONFIG_MMU_PTW_DEDICATED=y
CONFIG_MMU_PTW_PATH="dedicated"
CONFIG_MMU_PTW_INDEPENDENT=y
CONFIG_MMU_PTW_ARCH="independent"
CONFIG_MMU_PTW_OUTSTANDING=2
CONFIG_MMU_PTW_BUS_OUTSTANDING=1
CONFIG_MMU_PTW_IN_ORDER=y
CONFIG_MMU_PTW_ORDER="in_order"
CONFIG_MMU_PTW_CACHE=n

CONFIG_TLB_SPLIT=y
CONFIG_TLB_ORGANIZATION="split"
CONFIG_TLB_STORAGE_REG=y
CONFIG_TLB_STORAGE="reg"
CONFIG_TLB_REPLACE_PLRU=y
CONFIG_TLB_REPLACEMENT="plru"
CONFIG_TLB_ASID_BITS=16
CONFIG_TLB_GLOBAL=y
CONFIG_ITLB_ENTRIES=16
CONFIG_ITLB_WAYS=2
CONFIG_DTLB_ENTRIES=32
CONFIG_DTLB_WAYS=4
CONFIG_TLB_SUPERPAGE=y
CONFIG_TLB_MISS_QUEUE_FOLLOW=y
CONFIG_TLB_MISS_QUEUE_MODE="follow_tlb"
CONFIG_ITLB_MISS_QUEUE_ENTRIES=4
CONFIG_DTLB_MISS_QUEUE_ENTRIES=4
CONFIG_TLB_REFILL_PORTS=1

CONFIG_HAS_S_TIMER_IRQ=y
CONFIG_HAS_S_EXTERNAL_IRQ=y
CONFIG_TIMER_CLINT_MTIP=y
CONFIG_TIMER_PATH="clint_mtip"
CONFIG_PLIC_SOURCES=32
CONFIG_PLIC_PRIORITY_BITS=3
CONFIG_PLIC_MAX_PRIORITY=7
CONFIG_PLIC_BASE=0x0c000000
CONFIG_HAS_PMP=n

CONFIG_CSR_MISSING_ILLEGAL=y
CONFIG_CSR_MISSING_MODE="illegal"
CONFIG_CSR_VIEW_BOUND=y
CONFIG_CSR_VIEW_MODE="bound"
CONFIG_CSR_FIELD_DEFAULT_READ="normal"
CONFIG_CSR_FIELD_DEFAULT_WRITE="normal"

CONFIG_HAS_CSR_MSTATUS=y
CONFIG_HAS_CSR_MISA=y
CONFIG_HAS_CSR_MTVEC=y
CONFIG_HAS_CSR_MEPC=y
CONFIG_HAS_CSR_MCAUSE=y
CONFIG_HAS_CSR_MTVAL=y
CONFIG_HAS_CSR_MSCRATCH=y
CONFIG_HAS_CSR_MIE=y
CONFIG_HAS_CSR_MIP=y
CONFIG_HAS_CSR_MEDELEG=y
CONFIG_HAS_CSR_MIDELEG=y
CONFIG_HAS_CSR_MCOUNTEREN=y
CONFIG_HAS_CSR_MCOUNTINHIBIT=y
CONFIG_HAS_CSR_MCYCLE=y
CONFIG_HAS_CSR_MINSTRET=y
CONFIG_HAS_CSR_SSTATUS=y
CONFIG_HAS_CSR_SIE=y
CONFIG_HAS_CSR_SIP=y
CONFIG_HAS_CSR_STVEC=y
CONFIG_HAS_CSR_SSCRATCH=y
CONFIG_HAS_CSR_SEPC=y
CONFIG_HAS_CSR_SCAUSE=y
CONFIG_HAS_CSR_STVAL=y
CONFIG_HAS_CSR_SATP=y
CONFIG_HAS_CSR_SCOUNTEREN=y
```
