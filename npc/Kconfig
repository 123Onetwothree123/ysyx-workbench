## npc/csrc/Test/Kconfig
```kconfig
mainmenu "NPC 测试选择"

choice
	prompt "默认测试层级"
	default TEST_TIER_FUNCTIONAL
	help
	  选择默认执行的测试层级；命令行 --tier 会覆盖这里。

config TEST_TIER_FUNCTIONAL
	bool "功能测试 functional"
config TEST_TIER_PERFORMANCE
	bool "性能测试 performance"
config TEST_TIER_ALL
	bool "全部 all"
endchoice

config TEST_TAG
	string "标签过滤 tag"
	default ""
	help
	  只跑带该 tag 的测试，空表示不过滤。
	  这里填英文 tag，例如 software、scala、bench。

config TEST_NAME
	string "名字过滤 name"
	default ""
	help
	  只跑名字包含该子串的测试，空表示不过滤。
	  这里填英文测试名片段，例如 PLIC、printf。

menu "目标平台"

choice
	prompt "ARCH"
	default TEST_ARCH_FOLLOW
	help
	  跟随模式下由 xlen.mk 按 CONFIG_XLEN 推导，和当前 NPC 配置一致。
	  自定义时填 abstract-machine/scripts/<ARCH>.mk 的文件名。

config TEST_ARCH_FOLLOW
	bool "跟随 NPC 配置 (CONFIG_XLEN)"
config TEST_ARCH_CUSTOM
	bool "自定义"
endchoice

config TEST_ARCH_CUSTOM_VALUE
	string "自定义 ARCH"
	depends on TEST_ARCH_CUSTOM
	default ""
	help
	  必须对应 abstract-machine/scripts/ 下的某个 .mk，例如 riscv64gc-npc。
	  运行时会按该目录校验，拼错会直接报错。

endmenu

config TEST_TIMEOUT_SCALE
	int "超时倍数 timeout scale"
	range 1 100
	default 1
	help
	  所有测试超时时间乘以该倍数。

config TEST_RETRY
	int "失败重试次数 retry (-1 = 沿用注册表)"
	range -1 10
	default -1
	help
	  失败后重试次数，-1 表示不覆盖注册表里的 retry。
	  命令行 --retry 会覆盖这里。
```

## npc/kconfig/Kconfig.sim
```kconfig
menu "仿真后端"

  choice
    prompt "RTL 仿真器"
    default SIM_BACKEND_VERILATOR
    help
      Verilator：完整的 ysyxSoC/direct-NPC 仿真流程。
      GSIM：OpenXiangShan 的 chirrtl 仿真器，直接消费 direct-NPC
      SimTop 的 CHIRRTL，由 make gsim 生成并编译 C++ harness。
      GSIM 生成的仿真模型运行时固定单线程，--threads 只并行建模阶段。
      后端选择只使用 SIM_BACKEND_VERILATOR/GSIM 两个 bool 符号，
      Makefile 不读取派生字符串。
    config SIM_BACKEND_VERILATOR
      bool "Verilator"
    config SIM_BACKEND_GSIM
      bool "GSIM（chirrtl）"
  endchoice

  config BUILD_THREADS
    int "构建线程数，0 = 使用全部核心"
    default 0
    help
      设置并行构建线程数
      0表示使用所有可用核心
      超过系统核心数的值将被限制为系统核心数
      当前用于Verilator生成模型的并行编译，以及GSIM C++模型
      的逐文件并行编译；GSIM建模阶段另由GSIM_THREADS控制

  if SIM_BACKEND_GSIM
    comment "GSIM 默认使用 clang++ 编译生成代码，CONFIG_CC 不适用于 GSIM"
    comment "GSIM 要求 CACHE_PADDING 按 SoC RAM 字宽对齐：32 位 4 字节，64 位 8 字节"
    comment "GSIM 不读取 LOG_* 配置，harness 直接写 stdout/stderr"

    config GSIM_COMMAND
      string "gsim 可执行文件"
      default "gsim"
      help
        GSIM 编译器路径。默认从 PATH 查找 gsim。

    config GSIM_CXX
      string "GSIM C++ 编译器"
      default "clang++"
      help
        GSIM 生成的 C++ 使用 _BitInt，GCC 尚不支持，默认使用
        clang++。此选项只影响 GSIM harness 和生成模型的编译，
        “编译器与构建选项”中的 CONFIG_CC 不适用于 GSIM。
        CONFIG_USER_CXX_STD、CONFIG_CC_OPT、警告选项、sanitizer、
        CONFIG_STDLIB_FLAG、CONFIG_LD_FLAG 和 CONFIG_BUILD_THREADS
        仍会传给 GSIM 的 C++ 构建。警告选项只作用于 harness，
        GSIM 生成的 C++ 不保证 warning-clean。

    config GSIM_THREADS
      int "GSIM 建模线程数，0 = 使用全部核心"
      default 0
      help
        传给gsim --threads，只影响CHIRRTL解析和C++生成阶段
        0表示使用所有可用核心
        超过系统核心数的值将被限制为系统核心数
        GSIM生成的仿真模型运行时固定单线程

    config GSIM_EXTRA_ARGS
      string "gsim 额外参数"
      default ""
      help
        追加到 gsim 命令行的参数，例如 --log-level=1。
  endif

endmenu
```

## npc/kconfig/Kconfig.soc
```kconfig
menu "SoC 与外设"

  menu "中断控制器 (PLIC)"
    config PLIC_SOURCES
      int "PLIC 中断源数量"
      default 32
      range 2 1024
      depends on HAS_S_EXTERNAL_IRQ
      help
        source 0 保留，实际可用 source 1..PLIC_SOURCES-1。
        DTB 的 riscv,ndev 和 OpenSBI 的 num_src 会自动取
        PLIC_SOURCES-1，不需要另外配置。
    config PLIC_PRIORITY_BITS
      int "PLIC 优先级位宽"
      default 3
      range 1 8
      depends on HAS_S_EXTERNAL_IRQ
    config PLIC_MAX_PRIORITY
      int "PLIC 最大优先级"
      default 7
      depends on HAS_S_EXTERNAL_IRQ
    config PLIC_BASE
      hex "PLIC MMIO 基地址"
      default 0x0c000000
      depends on HAS_S_EXTERNAL_IRQ
    config PLIC_SIZE
      hex "PLIC MMIO 窗口大小"
      default 0x00300000
      depends on HAS_S_EXTERNAL_IRQ
      help
        PLIC 地址窗口大小。必须覆盖实际使用的 context 寄存器：
          0x200000 + 0x1000 * context 数
        当前实现使用 M context 0 和 S context 1，最小 0x202000。
        ysyxSoC 的片上 SRAM 从 0x0f000000 开始，因此默认 3MiB
        （0x00300000）正好止于 SRAM 之前。该值会同步到 CPU Xbar、
        PMA、DTB 和 OpenSBI 平台。

  endmenu

  menu "PMA 物理地址映射"

    # 这里只改CPU PMA、C++SoC模型、DTB和OpenSBI；ysyxSoC的实际
    # 器件地址由ysyxSoC/src/Top.scala决定，换板时需要同步修改。
    # SoC构建可运行SIM_TOP=soc make kconfig-contract-check检查两侧一致。

    choice SOC_MEMORY_MAP
      prompt "ysyxSoC 内存映射"
      default SOC_MEMORY_MAP_ACT
      help
        选择 full-SoC 的 PSRAM/SDRAM 地址布局。CPU 的 PMA、C++ SoC
        模型、DTB 和 ysyxSoC 的 AXI/APB 地址集必须使用同一张映射。

        ACT 是历史测试布局：PSRAM 4 MiB @0x80000000，SDRAM 32 MiB
        @0xa0000000。Linux 布局把 SDRAM 放到 0x80000000 并扩到
        128 MiB，PSRAM 移到 0xb0000000。该项目前只同步 CPU PMA、
        C++ SoC 模型和 ysyxSoC 的 AXI/APB 地址集，供后续 FPGA
        Linux 使用；仿真侧 128 MiB SDRAM 模型/控制器仍需单独扩展，
        默认 ACT 映射不受影响。

      config SOC_MEMORY_MAP_ACT
        bool "ACT/测试映射（PSRAM 4 MiB @0x80000000，SDRAM 32 MiB @0xa0000000）"

      config SOC_MEMORY_MAP_LINUX
        bool "Linux/FPGA 128 MiB 映射（预留；仿真 SDRAM 模型未扩展）"
    endchoice

    config PMA_SOC_RESET_ADDR
      hex "SoC 复位入口地址"
      default PMA_MROM_BASE
      help
        必须落在可执行 PMA 区域；默认跟随 MROM 基地址。

    config PMA_CLINT_BASE
      hex "CLINT 基地址"
      default 0x02000000
    config PMA_CLINT_SIZE
      hex "CLINT 窗口大小"
      default 0x00010000

    config PMA_SRAM_BASE
      hex "SRAM 基地址"
      default 0x0f000000
    config PMA_SRAM_SIZE
      hex "SRAM 大小"
      default 0x00008000

    config PMA_UART_BASE
      hex "UART 基地址"
      default 0x10000000
    config PMA_UART_SIZE
      hex "UART 窗口大小"
      default 0x00001000

    config PMA_SPI_BASE
      hex "SPI 基地址"
      default 0x10001000
    config PMA_SPI_SIZE
      hex "SPI 窗口大小"
      default 0x00001000

    config PMA_GPIO_BASE
      hex "GPIO 基地址"
      default 0x10002000
    config PMA_GPIO_SIZE
      hex "GPIO 窗口大小"
      default 0x00000010

    config PMA_KEYBOARD_BASE
      hex "键盘基地址"
      default 0x10011000
    config PMA_KEYBOARD_SIZE
      hex "键盘窗口大小"
      default 0x00000008

    config PMA_VGA_BASE
      hex "VGA 基地址"
      default 0x21000000
    config PMA_VGA_SIZE
      hex "VGA 窗口大小"
      default 0x00200000

    config PMA_MROM_BASE
      hex "MROM 基地址"
      default 0x20000000
    config PMA_MROM_SIZE
      hex "MROM 大小"
      default 0x00001000

    config PMA_FLASH_BASE
      hex "XIP Flash 基地址"
      default 0x30000000
    config PMA_FLASH_SIZE
      hex "XIP Flash 窗口大小"
      default 0x10000000

    config PMA_PSRAM_BASE
      hex "PSRAM 基地址"
      default 0xb0000000 if SOC_MEMORY_MAP_LINUX
      default 0x80000000
    config PMA_PSRAM_SIZE
      hex "PSRAM 大小"
      default 0x00400000

    config PMA_SDRAM_BASE
      hex "SDRAM 基地址"
      default 0x80000000 if SOC_MEMORY_MAP_LINUX
      default 0xa0000000
    config PMA_SDRAM_SIZE
      hex "SDRAM 大小"
      default 0x08000000 if SOC_MEMORY_MAP_LINUX
      default 0x02000000

    config PMA_CHIPLINK_MMIO_BASE
      hex "ChipLink MMIO 基地址"
      default 0x40000000
    config PMA_CHIPLINK_MMIO_SIZE
      hex "ChipLink MMIO 窗口大小"
      default 0x40000000

    config PMA_CHIPLINK_MEM_BASE
      hex "ChipLink 内存基地址"
      default 0xc0000000
    config PMA_CHIPLINK_MEM_SIZE
      hex "ChipLink 内存窗口大小"
      default 0x40000000

  endmenu

  menu "CPU 内部总线"

    config INTERNAL_BUS_WIDTH_FOLLOW_CPU
      bool "内部 AXI fabric 数据宽度跟随 CPU XLEN"
      default y
      help
        y: RV32 为 32 位，RV64 为 64 位。
        n: 使用 INTERNAL_BUS_WIDTH。
        只影响 CPU 内部 fabric，外部 ysyxSoC 宽度仍由 SOC_XLEN 决定。

    config INTERNAL_BUS_WIDTH
      int "内部 AXI fabric 数据宽度"
      depends on !INTERNAL_BUS_WIDTH_FOLLOW_CPU
      default 64 if XLEN=64
      default 32
      range 32 64
      help
        仅 FOLLOW=n 时生效，只允许 32 或 64。
        非法值由配置契约检查阶段拒绝。

  endmenu

  menu "ysyxSoC 接口"

    config CHIPLINK
      bool "启用 ChipLink 外部存储/中断接口"
      default n
      help
        打开 ysyxSoC 的 ChipLink master/slave 与 DMA 代理。
        该值写入 typed JSON 的 soc.chiplink，由 SoC elaboration 消费；
        CPU 侧 PMA/DMA 一致性设置仍由 Makefile 从同一值派生。

    config SDRAM_USE_AXI
      bool "SDRAM 使用 AXI 数据通路"
      default y
      help
        选择 ysyxSoC 的 SDRAM 控制器接在 32 位 AXI xbar 上；关闭时
        使用 APB SDRAM 路径。该值写入 typed JSON 的
        soc.sdram_use_axi，由 SoC 拓扑选择直接消费。

    config SOC_XLEN_FOLLOW_CPU
      bool "SoC CPU 侧接口位宽跟随 CPU XLEN"
      default n
      help
        控制 ysyxSoC CPU 侧接口的 XLEN/数据宽度是否跟随 CPU 的 XLEN。
        n（默认）: 使用 SOC_XLEN，CPU 与 SoC 位宽相互独立。
        y: EffectiveSocXLEN = XLEN。
        注意 follow 只是让 SoC 接口跟随 CPU，并不是强制 CPU 与 SoC
        同宽；关闭后仍可自由组合 32/64，例如 64 位 CPU 搭配 32 位
        SoC，或 32 位 CPU 搭配 64 位 SoC。

    config SOC_XLEN
      int "ysyxSoC CPU 侧接口 XLEN"
      depends on !SOC_XLEN_FOLLOW_CPU
      default 64 if XLEN=64
      default 32
      # Kconfig 的 int/range 不能表达离散集合；32/64 由配置契约校验
      # 在配置阶段检查，elaboration 也会再次校验。
      range 32 64
      help
        ysyxSoC CPU 侧接口的 XLEN/数据宽度，仅当
        SOC_XLEN_FOLLOW_CPU=n 时可见并生效，只允许 32 或 64；
        XLEN=64 时默认 64，XLEN=32 时默认 32。
        33..63 会在 make defconfig/menuconfig 后的配置契约检查阶段
        被明确拒绝，不会静默生成。
        32 位 ysyxSoC 可以搭配 64 位 CPU：CPU 内部仍使用 64 位地址，
        但经 SoC 边界的访问必须位于低 4GiB，更高地址在 Xbar 内返回
        DECERR。64 位 SoC 接口已经由 AXI4Downsizer 接入 32 位
        xbar/外设，配置会写入 typed JSON 的 soc.soc_xlen，由
        ysyxSoC elaboration 直接消费。
        注意：direct-NPC 的 riscv32e_npc_SimTop 与 riscv32e_npc_AXIRAM
        使用同一 EffectiveSocXLEN，32/64 位都直接同宽连接；
        host 初始化的 ram_init_data 也随该宽度变化。
        修改后需重新 make verilog 或 make build/ysyx_26030103。

    config APB_XLEN_FOLLOW_SOC
      bool "APB 总线宽度跟随 SoC XLEN"
      default y
      help
        y: EffectiveApbXLEN = EffectiveSocXLEN。
        n: 使用 APB_XLEN。

    config APB_XLEN
      int "APB 总线宽度"
      depends on !APB_XLEN_FOLLOW_SOC
      default 64 if SOC_XLEN_FOLLOW_CPU && XLEN=64
      default 64 if !SOC_XLEN_FOLLOW_CPU && SOC_XLEN=64
      default 32
      range 32 64
      help
        仅当 APB_XLEN_FOLLOW_SOC=n 时生效，只允许 32 或 64。
        默认按 EffectiveSocXLEN 投影，33..63 由配置派生阶段拒绝。

    menu "外设数据宽度"

      config UART_XLEN_FOLLOW_APB
        bool "UART 数据宽度跟随 APB"
        default y
        help
          y: UART_XLEN = EffectiveApbXLEN。
          n: 使用 UART_XLEN。

      config UART_XLEN
        int "UART 数据宽度"
        depends on !UART_XLEN_FOLLOW_APB
        default 32
        range 32 64

      config GPIO_XLEN_FOLLOW_APB
        bool "GPIO 数据宽度跟随 APB"
        default y
        help
          y: GPIO_XLEN = EffectiveApbXLEN。
          n: 使用 GPIO_XLEN。

      config GPIO_XLEN
        int "GPIO 数据宽度"
        depends on !GPIO_XLEN_FOLLOW_APB
        default 32
        range 32 64

      config KEYBOARD_XLEN_FOLLOW_APB
        bool "KEYBOARD 数据宽度跟随 APB"
        default y
        help
          y: KEYBOARD_XLEN = EffectiveApbXLEN。
          n: 使用 KEYBOARD_XLEN。

      config KEYBOARD_XLEN
        int "KEYBOARD 数据宽度"
        depends on !KEYBOARD_XLEN_FOLLOW_APB
        default 32
        range 32 64

      config VGA_XLEN_FOLLOW_APB
        bool "VGA 数据宽度跟随 APB"
        default y
        help
          y: VGA_XLEN = EffectiveApbXLEN。
          n: 使用 VGA_XLEN。

      config VGA_XLEN
        int "VGA 数据宽度"
        depends on !VGA_XLEN_FOLLOW_APB
        default 32
        range 32 64

      config SPI_XLEN_FOLLOW_APB
        bool "SPI 数据宽度跟随 APB"
        default y
        help
          y: SPI_XLEN = EffectiveApbXLEN。
          n: 使用 SPI_XLEN。

      config SPI_XLEN
        int "SPI 数据宽度"
        depends on !SPI_XLEN_FOLLOW_APB
        default 32
        range 32 64

      config PSRAM_XLEN_FOLLOW_APB
        bool "PSRAM 数据宽度跟随 APB"
        default y
        help
          y: PSRAM_XLEN = EffectiveApbXLEN。
          n: 使用 PSRAM_XLEN。

      config PSRAM_XLEN
        int "PSRAM 数据宽度"
        depends on !PSRAM_XLEN_FOLLOW_APB
        default 32
        range 32 64

      config SDRAM_XLEN_FOLLOW_APB
        bool "SDRAM 数据宽度跟随 APB"
        default y
        help
          y: SDRAM_XLEN = EffectiveApbXLEN。
          n: 使用 SDRAM_XLEN。

      config SDRAM_XLEN
        int "SDRAM 数据宽度"
        depends on !SDRAM_XLEN_FOLLOW_APB
        default 32
        range 32 64

      config MROM_XLEN_FOLLOW_APB
        bool "MROM 数据宽度跟随 APB"
        default y
        help
          y: MROM_XLEN = EffectiveApbXLEN。
          n: 使用 MROM_XLEN。

      config MROM_XLEN
        int "MROM 数据宽度"
        depends on !MROM_XLEN_FOLLOW_APB
        default 32
        range 32 64

      config SRAM_XLEN_FOLLOW_APB
        bool "SRAM 数据宽度跟随 APB"
        default y
        help
          y: SRAM_XLEN = EffectiveApbXLEN。
          n: 使用 SRAM_XLEN。

      config SRAM_XLEN
        int "SRAM 数据宽度"
        depends on !SRAM_XLEN_FOLLOW_APB
        default 32
        range 32 64

    endmenu

  endmenu

  menu "SoC 总线延迟模型"

    config SYNTH_FREQ
      int "综合目标频率 (MHz)"
      default 450
      range 1 10000
      help
        综合器尝试达到的目标频率。设置越高，综合器可能使用更多
        面积换取更低的逻辑延迟。受限于工艺库和寄存器堆/加法器/SRAM等
        关键部件的最大工作频率。
        该值同时作为 APB/AXI 延迟模型的 CPU 频率传入 RTL，
        修改后需重新 make verilog。

    config APB_DEVICE_FREQ
      int "APB设备频率 (MHz)"
      default 100
      range 1 10000
      help
        APB总线上外设（如SDRAM控制器）的运行频率。
        用于APB延迟模块计算频率比校准访存延迟；该值进入 typed JSON
        的 soc.apb.device_freq_mhz，由 ysyxSoC 统一读取。

    config APB_DELAY_SCALE
      int "APB延迟缩放因子 S"
      default 64
      range 1 1048576
      help
        APB延迟模块中频率比累加的放大系数。

    config AXI_DEVICE_FREQ
      int "AXI设备频率 (MHz)"
      default 100
      range 1 10000
      help
        AXI总线上外设（如SDRAM控制器）的运行频率。
        用于AXI延迟模块计算频率比校准访存延迟。

    config AXI_DELAY_SCALE
      int "AXI延迟缩放因子 S"
      default 64
      range 1 1048576
      help
        AXI延迟模块中频率比累加的放大系数。

  endmenu

  menu "外设 / NVBoard"

    config NVBOARD
      bool "启用 NVBoard (LED/数码管/拨码开关可视化)"
      default n
      help
        链接 NVBoard，把 ysyxSoCFull 的 GPIO 引脚绑定到虚拟板卡的
        LED/数码管/拨码开关。需要 SDL2 (libsdl2-dev libsdl2-image-dev
        libsdl2-ttf-dev)，且 nvboard.a 要与本工程的 C++ 标准库 ABI 一致。
        仅支持 SIM_TOP=soc；direct-NPC 顶层没有这些外设引脚，构建时会
        明确拒绝该组合。

    config NVBOARD_NXDC
      string "NVBoard 约束文件(.nxdc)路径"
      depends on NVBOARD
      default "csrc/nvboard/gpio.nxdc"
      help
        描述 RTL 引脚到 NVBoard 组件的绑定关系

    config NVBOARD_UPDATE_INTERVAL
      int "每多少周期刷新一次 NVBoard GUI"
      depends on NVBOARD
      default 100
      range 1 1000000
      help
        每周期都刷新太慢，隔 N 个周期调用一次 nvboard_update 折中

  endmenu

endmenu
```
