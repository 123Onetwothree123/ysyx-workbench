## npc/kconfig/Kconfig.debug
```kconfig
menu "调试、追踪与性能"

  config SDB
    bool "启用SDB调试器"
    default y

  config PERF_DIC_ARCH_COUNTER
    bool "数字集成电路计算机体系结构性能计数器"
    default y
    help
      实现相关的体系结构性能计数器。可通过仿真、FPGA、MMIO
      或流片后的片内调试接口采集，不属于 RISC-V 标准 PMU。
      当前 Verilator 后端在仿真结束时输出动态指令数、周期数、
      IPC 以及下方各分组计数器。
      具体计数器的分组与单计数器选择见下方细分菜单：
      未开启的计数器在RTL顶层输出常量，综合展平后不会产生硬件；
      当前 C++ 采集后端也不再逐拍采样，对应 CSV 列恒为 0。

  menu "数字集成电路计算机体系结构性能计数器：细分"

    config PERF_DIC_ARCH_COUNTER_BASIC
      bool "基础吞吐组：取指交付/执行完成/读写完成"
      depends on PERF_DIC_ARCH_COUNTER
      default y
      help
        组总开关：关闭时本组下所有单计数器同时关闭。
        单计数器开关见本组子菜单"基础吞吐：单计数器"。

    config PERF_DIC_ARCH_COUNTER_OPCLASS
      bool "指令类型与执行活跃组：ALU/访存/CSR/分支/JAL/JALR"
      depends on PERF_DIC_ARCH_COUNTER
      default y
      help
        组总开关：关闭时本组下所有单计数器同时关闭。
        单计数器开关见本组子菜单"指令类型与执行活跃：单计数器"。

    config PERF_DIC_ARCH_COUNTER_MDU
      bool "乘除法组：请求/完成/操作码/活动与等待"
      depends on PERF_DIC_ARCH_COUNTER
      default y
      help
        组总开关。仅在RISCV_M开启时有意义；单计数器见本组子菜单。

    config PERF_DIC_ARCH_COUNTER_IFU_STALL
      bool "取指停顿组：流水/总线/AR/R/重定向/空闲"
      depends on PERF_DIC_ARCH_COUNTER
      default y
      help
        组总开关；单计数器见本组子菜单。

    config PERF_DIC_ARCH_COUNTER_ICACHE
      bool "指令缓存组：命中/缺失"
      depends on PERF_DIC_ARCH_COUNTER
      default y
      help
        组总开关；单计数器见本组子菜单。关闭后CSV的ICache命中/
        缺失/平均缺失服务周期/AMAT列恒为0。

    config PERF_DIC_ARCH_COUNTER_DCACHE
      bool "数据缓存组：命中/缺失/回填请求/回填响应"
      depends on PERF_DIC_ARCH_COUNTER
      default y
      help
        组总开关；单计数器见本组子菜单。DCache本身未开启时这些列恒为0。

    config PERF_DIC_ARCH_COUNTER_EXU_STALL
      bool "执行级停顿组：下游等待/空转/等待槽"
      depends on PERF_DIC_ARCH_COUNTER
      default y
      help
        组总开关；单计数器见本组子菜单。

    config PERF_DIC_ARCH_COUNTER_LSU
      bool "访存级组：活跃状态与读写停顿"
      depends on PERF_DIC_ARCH_COUNTER
      default y
      help
        组总开关；单计数器见本组子菜单。

    config PERF_DIC_ARCH_COUNTER_IDU_STALL
      bool "译码级RAW停顿组：总数/load-use/其它"
      depends on PERF_DIC_ARCH_COUNTER
      default y
      help
        组总开关；单计数器见本组子菜单。

    config PERF_DIC_ARCH_COUNTER_TRAP
      bool "异常组：提交次数"
      depends on PERF_DIC_ARCH_COUNTER
      default y
      help
        组总开关；单计数器见本组子菜单。

    config PERF_DIC_ARCH_COUNTER_BRANCH_PRED
      bool "分支预测组：BTB/JAL-BTB/RAS 命中与误预测"
      depends on PERF_DIC_ARCH_COUNTER
      default y
      help
        组总开关；单计数器见本组子菜单。

    config PERF_DIC_ARCH_COUNTER_MMU
      bool "MMU/TLB 组：ITLB/DTLB 命中缺失与回填"
      depends on PERF_DIC_ARCH_COUNTER
      default y
      help
        组总开关；单计数器见本组子菜单。HAS_MMU=n 时这些列恒为 0。

    config PERF_DIC_ARCH_COUNTER_FPU
      bool "FPU 组：请求与完成"
      depends on PERF_DIC_ARCH_COUNTER
      default y
      help
        组总开关；单计数器见本组子菜单。RISCV_F=n 时这些列恒为 0。

    config PERF_DIC_ARCH_COUNTER_AXI
      bool "AXI 组：AR/AW/R/W/B 握手"
      depends on PERF_DIC_ARCH_COUNTER
      default y
      help
        组总开关；单计数器见本组子菜单。

    config PERF_DIC_ARCH_COUNTER_INST_MIX
      bool "指令细分：load/store/AMO"
      depends on PERF_DIC_ARCH_COUNTER
      default y
      help
        组总开关；单计数器见本组子菜单。

    config PERF_DIC_ARCH_COUNTER_CACHE_DETAIL
      bool "缓存细节组：回填、行填充与写直达更新"
      depends on PERF_DIC_ARCH_COUNTER
      default y
      help
        组总开关；单计数器见本组子菜单。

    config PERF_DIC_ARCH_COUNTER_INTERRUPT
      bool "中断组：定时器/外部中断、PLIC 与延迟"
      depends on PERF_DIC_ARCH_COUNTER
      default y
      help
        组总开关；单计数器见本组子菜单。

    config PERF_DIC_ARCH_COUNTER_WBUF
      bool "写缓冲组：满/排空"
      depends on PERF_DIC_ARCH_COUNTER
      default y
      help
        组总开关；单计数器见本组子菜单。

    config PERF_DIC_ARCH_COUNTER_CSR
      bool "CSR 组：读/写"
      depends on PERF_DIC_ARCH_COUNTER
      default y
      help
        组总开关；单计数器见本组子菜单。

    config PERF_DIC_ARCH_COUNTER_MDU_DETAIL
      bool "MDU 细节组：乘除活跃、除法迭代与提前结束"
      depends on PERF_DIC_ARCH_COUNTER
      default y
      help
        组总开关；单计数器见本组子菜单。RISCV_M=n 时这些列恒为 0。

    config PERF_DIC_ARCH_COUNTER_QUEUE
      bool "队列/气泡组：发射、退休占用与气泡周期"
      depends on PERF_DIC_ARCH_COUNTER
      default y
      help
        组总开关；单计数器见本组子菜单。

    menu "基础吞吐：单计数器"
      depends on PERF_DIC_ARCH_COUNTER_BASIC

      config PERF_DIC_ARCH_COUNTER_IFU_FETCH
        bool "取指响应交付（不含冲刷拍丢弃；冲刷前已交付的错路取指仍计入，perf_ifu_fetch）"
        default y

      config PERF_DIC_ARCH_COUNTER_EXU_DONE
        bool "EXU输出握手（perf_exu_done）"
        default y

      config PERF_DIC_ARCH_COUNTER_LSU_LOAD
        bool "LSU读完成（perf_lsu_load）"
        default y

      config PERF_DIC_ARCH_COUNTER_LSU_STORE
        bool "LSU写完成（perf_lsu_store）"
        default y
    endmenu

    menu "指令类型与执行活跃：单计数器"
      depends on PERF_DIC_ARCH_COUNTER_OPCLASS

      config PERF_DIC_ARCH_COUNTER_ALU_OP
        bool "ALU：计数与活跃周期（perf_alu_op）"
        default y

      config PERF_DIC_ARCH_COUNTER_MEM_OP
        bool "访存：计数与活跃周期（perf_mem_op）"
        default y

      config PERF_DIC_ARCH_COUNTER_CSR_OP
        bool "CSR：计数与活跃周期（perf_csr_op）"
        default y

      config PERF_DIC_ARCH_COUNTER_BRANCH_OP
        bool "分支与跳转总数、条件分支与活跃周期（perf_branch_op）"
        default y

      config PERF_DIC_ARCH_COUNTER_JAL_OP
        bool "JAL计数（perf_jal_op）"
        default y

      config PERF_DIC_ARCH_COUNTER_JALR_OP
        bool "JALR计数（perf_jalr_op）"
        default y

      config PERF_DIC_ARCH_COUNTER_EXECUTION_ACTIVE
        bool "EXU执行活跃周期（perf_execution_active）"
        default y
    endmenu

    menu "乘除法：单计数器"
      depends on PERF_DIC_ARCH_COUNTER_MDU

      config PERF_DIC_ARCH_COUNTER_MDU_REQ
        bool "MDU请求（perf_mdu_req）"
        default y

      config PERF_DIC_ARCH_COUNTER_MDU_DONE
        bool "MDU完成（perf_mdu_done）"
        default y

      config PERF_DIC_ARCH_COUNTER_MDU_OP
        bool "各操作码明细（perf_mdu_op，依赖MDU完成开关）"
        depends on PERF_DIC_ARCH_COUNTER_MDU_DONE
        default y

      config PERF_DIC_ARCH_COUNTER_MDU_ACTIVE
        bool "MDU发射/在途活动周期（perf_mdu_active）"
        default y

      config PERF_DIC_ARCH_COUNTER_MDU_WAIT
        bool "MDU等待结果周期（perf_mdu_wait）"
        default y
    endmenu

    menu "取指停顿：单计数器"
      depends on PERF_DIC_ARCH_COUNTER_IFU_STALL

      config PERF_DIC_ARCH_COUNTER_IFU_STALL_PIPELINE
        bool "响应有效但下游未接受（perf_ifu_stall_pipeline）"
        default y

      config PERF_DIC_ARCH_COUNTER_IFU_STALL_AXI
        bool "refill AR/R 合计（perf_ifu_stall_axi）"
        default y

      config PERF_DIC_ARCH_COUNTER_IFU_STALL_AR
        bool "refill AR请求状态（perf_ifu_stall_ar）"
        default y

      config PERF_DIC_ARCH_COUNTER_IFU_STALL_R
        bool "refill R响应状态（perf_ifu_stall_r）"
        default y

      config PERF_DIC_ARCH_COUNTER_IFU_STALL_REDIRECT
        bool "控制流重定向事件：分支误预测/fence.i/异常/mret（perf_ifu_stall_redirect）"
        default y

      config PERF_DIC_ARCH_COUNTER_IFU_STALL_IDLE
        bool "IFU空闲：重定向/异常停发拍（周期数，与redirect事件数口径不同；perf_ifu_stall_idle）"
        default y
    endmenu

    menu "指令缓存：单计数器"
      depends on PERF_DIC_ARCH_COUNTER_ICACHE

      config PERF_DIC_ARCH_COUNTER_ICACHE_HIT
        bool "ICache命中（perf_icache_hit）"
        default y

      config PERF_DIC_ARCH_COUNTER_ICACHE_MISS
        bool "ICache缺失（仅可缓存取指未命中，perf_icache_miss）"
        default y
    endmenu

    menu "数据缓存：单计数器"
      depends on PERF_DIC_ARCH_COUNTER_DCACHE

      config PERF_DIC_ARCH_COUNTER_DCACHE_HIT
        bool "DCache命中（perf_dcache_hit）"
        default y

      config PERF_DIC_ARCH_COUNTER_DCACHE_MISS
        bool "DCache缺失（perf_dcache_miss）"
        default y

      config PERF_DIC_ARCH_COUNTER_DCACHE_REFILL_REQ
        bool "回填AR状态（perf_dcache_refill_req）"
        default y

      config PERF_DIC_ARCH_COUNTER_DCACHE_REFILL_RESP
        bool "回填R状态（perf_dcache_refill_resp）"
        default y
    endmenu

    menu "执行级停顿：单计数器"
      depends on PERF_DIC_ARCH_COUNTER_EXU_STALL

      config PERF_DIC_ARCH_COUNTER_EXU_STALL_LSU
        bool "EXU下游/顺序等待（perf_exu_stall_lsu）"
        default y

      config PERF_DIC_ARCH_COUNTER_EXU_IDLE_NOINPUT
        bool "EXU空转等输入（perf_exu_idle_noinput）"
        default y

      config PERF_DIC_ARCH_COUNTER_MEM_WAITSLOT
        bool "EX/MEM等待槽占用（perf_mem_waitslot）"
        default y
    endmenu

    menu "访存级：单计数器"
      depends on PERF_DIC_ARCH_COUNTER_LSU

      config PERF_DIC_ARCH_COUNTER_LSU_ACTIVE
        bool "LSU活跃（perf_lsu_active）"
        default y

      config PERF_DIC_ARCH_COUNTER_LSU_LOAD_ACTIVE
        bool "LSU读活跃（perf_lsu_load_active）"
        default y

      config PERF_DIC_ARCH_COUNTER_LSU_STORE_ACTIVE
        bool "LSU写活跃（perf_lsu_store_active）"
        default y

      config PERF_DIC_ARCH_COUNTER_LSU_STALL_READ_AR
        bool "LSU读请求状态（perf_lsu_stall_read_ar）"
        default y

      config PERF_DIC_ARCH_COUNTER_LSU_STALL_READ_R
        bool "LSU读响应状态（perf_lsu_stall_read_r）"
        default y

      config PERF_DIC_ARCH_COUNTER_LSU_STALL_WRITE_REQ
        bool "写缓冲无空位（perf_lsu_stall_write_req）"
        default y

      config PERF_DIC_ARCH_COUNTER_LSU_STALL_WRITE_B
        bool "写响应在途（perf_lsu_stall_write_b）"
        default y
    endmenu

    menu "译码级RAW停顿：单计数器"
      depends on PERF_DIC_ARCH_COUNTER_IDU_STALL

      config PERF_DIC_ARCH_COUNTER_IDU_STALL_RAW
        bool "RAW阻塞合计（perf_idu_stall_raw）"
        default y

      config PERF_DIC_ARCH_COUNTER_IDU_STALL_RAW_LOADUSE
        bool "load-use阻塞（perf_idu_stall_raw_loaduse）"
        default y

      config PERF_DIC_ARCH_COUNTER_IDU_STALL_RAW_ALU
        bool "非load未就绪依赖（perf_idu_stall_raw_alu）"
        default y
    endmenu

    menu "异常：单计数器"
      depends on PERF_DIC_ARCH_COUNTER_TRAP

      config PERF_DIC_ARCH_COUNTER_TRAP_COUNT
        bool "异常提交次数（perf_trap）"
        default y
    endmenu

    menu "分支预测：单计数器"
      depends on PERF_DIC_ARCH_COUNTER_BRANCH_PRED

      config PERF_DIC_ARCH_COUNTER_BTB_HIT
        bool "分支BTB命中（perf_btb_hit）"
        default y

      config PERF_DIC_ARCH_COUNTER_BTB_MISS
        bool "分支BTB缺失（perf_btb_miss）"
        default y

      config PERF_DIC_ARCH_COUNTER_JAL_BTB_HIT
        bool "JAL/Call/Ret BTB命中（perf_jal_btb_hit）"
        default y

      config PERF_DIC_ARCH_COUNTER_RAS_HIT
        bool "RAS返回预测命中（perf_ras_hit）"
        default y

      config PERF_DIC_ARCH_COUNTER_BRANCH_MISPREDICT
        bool "分支/跳转误预测（perf_branch_mispredict）"
        default y

      config PERF_DIC_ARCH_COUNTER_BRANCH_TAKEN
        bool "条件分支 taken（perf_branch_taken）"
        default y

      config PERF_DIC_ARCH_COUNTER_BRANCH_NOT_TAKEN
        bool "条件分支 not-taken（perf_branch_not_taken）"
        default y

      config PERF_DIC_ARCH_COUNTER_RAS_MISS
        bool "RET 预测但 RAS 为空（perf_ras_miss）"
        default y

      config PERF_DIC_ARCH_COUNTER_REDIRECT_BRANCH
        bool "分支/跳转误预测重定向（perf_redirect_branch）"
        default y

      config PERF_DIC_ARCH_COUNTER_REDIRECT_FENCE_I
        bool "fence.i/sfence.vma 重定向（perf_redirect_fence_i）"
        default y

      config PERF_DIC_ARCH_COUNTER_REDIRECT_TRAP
        bool "异常进入 trap（perf_redirect_trap）"
        default y

      config PERF_DIC_ARCH_COUNTER_REDIRECT_MRET
        bool "mret/sret 重定向（perf_redirect_mret）"
        default y
    endmenu

    menu "MMU/TLB：单计数器"
      depends on PERF_DIC_ARCH_COUNTER_MMU

      config PERF_DIC_ARCH_COUNTER_ITLB_HIT
        bool "ITLB命中（perf_itlb_hit）"
        default y

      config PERF_DIC_ARCH_COUNTER_ITLB_MISS
        bool "ITLB缺失（perf_itlb_miss）"
        default y

      config PERF_DIC_ARCH_COUNTER_DTLB_HIT
        bool "DTLB命中（perf_dtlb_hit）"
        default y

      config PERF_DIC_ARCH_COUNTER_DTLB_MISS
        bool "DTLB缺失（perf_dtlb_miss）"
        default y

      config PERF_DIC_ARCH_COUNTER_TLB_REFILL
        bool "TLB回填（perf_tlb_refill）"
        default y

      config PERF_DIC_ARCH_COUNTER_TLB_FLUSH
        bool "TLB冲刷/SFENCE.VMA（perf_tlb_flush）"
        default y

      config PERF_DIC_ARCH_COUNTER_PTW_WALK
        bool "PTW walk 启动（perf_ptw_walk）"
        default y

      config PERF_DIC_ARCH_COUNTER_PTW_WALK_CYCLE
        bool "PTW walk 活跃周期（perf_ptw_walk_cycle）"
        default y

      config PERF_DIC_ARCH_COUNTER_PAGE_FAULT
        bool "page fault 提交（perf_page_fault）"
        default y

      config PERF_DIC_ARCH_COUNTER_TLB_SUPERPAGE_HIT
        bool "TLB 超级页命中（perf_tlb_superpage_hit）"
        default y

      config PERF_DIC_ARCH_COUNTER_TLB_ASID_HIT
        bool "TLB ASID 命中（perf_tlb_asid_hit）"
        default y
    endmenu

    menu "FPU：单计数器"
      depends on PERF_DIC_ARCH_COUNTER_FPU

      config PERF_DIC_ARCH_COUNTER_FPU_REQ
        bool "FPU请求（perf_fpu_req）"
        default y

      config PERF_DIC_ARCH_COUNTER_FPU_DONE
        bool "FPU完成（perf_fpu_done）"
        default y

      config PERF_DIC_ARCH_COUNTER_FPU_ACTIVE
        bool "FPU忙碌周期（perf_fpu_active）"
        default y

      config PERF_DIC_ARCH_COUNTER_FPU_STALL
        bool "FPU等待结果周期（perf_fpu_stall）"
        default y

      config PERF_DIC_ARCH_COUNTER_FPU_DIVSQRT
        bool "FPU DIV/SQRT 指令（perf_fpu_divsqrt）"
        default y

      config PERF_DIC_ARCH_COUNTER_FPU_FMA
        bool "FPU FMA 类指令（perf_fpu_fma）"
        default y

      config PERF_DIC_ARCH_COUNTER_FPU_EXCEPTION
        bool "FPU fflags 异常提交（perf_fpu_exception）"
        default y
    endmenu

    menu "AXI：单计数器"
      depends on PERF_DIC_ARCH_COUNTER_AXI

      config PERF_DIC_ARCH_COUNTER_AXI_AR
        bool "AR握手（perf_axi_ar）"
        default y

      config PERF_DIC_ARCH_COUNTER_AXI_AW
        bool "AW握手（perf_axi_aw）"
        default y

      config PERF_DIC_ARCH_COUNTER_AXI_R
        bool "R握手（perf_axi_r）"
        default y

      config PERF_DIC_ARCH_COUNTER_AXI_W
        bool "W握手（perf_axi_w）"
        default y

      config PERF_DIC_ARCH_COUNTER_AXI_B
        bool "B握手（perf_axi_b）"
        default y

      config PERF_DIC_ARCH_COUNTER_AXI_STALL
        bool "AXI通道 valid&&!ready 周期（perf_axi_stall）"
        default y

      config PERF_DIC_ARCH_COUNTER_AXI_ERROR
        bool "AXI R/B 错误响应（perf_axi_error）"
        default y
    endmenu

    menu "指令细分：单计数器"
      depends on PERF_DIC_ARCH_COUNTER_INST_MIX

      config PERF_DIC_ARCH_COUNTER_LOAD_OP
        bool "load指令（perf_load_op）"
        default y

      config PERF_DIC_ARCH_COUNTER_STORE_OP
        bool "store指令（perf_store_op）"
        default y

      config PERF_DIC_ARCH_COUNTER_AMO_OP
        bool "AMO/LR/SC指令（perf_amo_op）"
        default y

      config PERF_DIC_ARCH_COUNTER_FENCE_OP
        bool "fence/fence.i 指令（perf_fence_op）"
        default y

      config PERF_DIC_ARCH_COUNTER_RVC_INST
        bool "压缩指令（perf_rvc_inst）"
        default y

      config PERF_DIC_ARCH_COUNTER_SYSTEM_OP
        bool "ecall/ebreak/mret/sret/sfence.vma（perf_system_op）"
        default y

      config PERF_DIC_ARCH_COUNTER_ILLEGAL_INST
        bool "非法指令提交（perf_illegal_inst）"
        default y

      config PERF_DIC_ARCH_COUNTER_FLUSH_CYCLE
        bool "流水线冲刷周期（perf_flush_cycle）"
        default y

      config PERF_DIC_ARCH_COUNTER_WFI_INST
        bool "WFI 指令数（perf_wfi_inst，本核按 NOP 执行）"
        default y
    endmenu

    menu "缓存细节：单计数器"
      depends on PERF_DIC_ARCH_COUNTER_CACHE_DETAIL

      config PERF_DIC_ARCH_COUNTER_ICACHE_REFILL
        bool "ICache实际回填次数（perf_icache_refill）"
        default y

      config PERF_DIC_ARCH_COUNTER_DCACHE_REFILL
        bool "DCache实际回填次数（perf_dcache_refill）"
        default y

      config PERF_DIC_ARCH_COUNTER_UNCACHED_ACCESS
        bool "非缓存/MMIO完成访问（perf_uncached_access）"
        default y

      config PERF_DIC_ARCH_COUNTER_ICACHE_LINE_FILL
        bool "ICache 行填充完成（perf_icache_line_fill）"
        default y

      config PERF_DIC_ARCH_COUNTER_DCACHE_LINE_FILL
        bool "DCache 行填充完成（perf_dcache_line_fill）"
        default y

      config PERF_DIC_ARCH_COUNTER_DCACHE_WRITEBACK
        bool "DCache 写直达/store 行更新（perf_dcache_writeback）"
        default y
    endmenu

    menu "中断：单计数器"
      depends on PERF_DIC_ARCH_COUNTER_INTERRUPT

      config PERF_DIC_ARCH_COUNTER_TIMER_IRQ
        bool "定时器中断（perf_timer_irq）"
        default y

      config PERF_DIC_ARCH_COUNTER_EXTERNAL_IRQ
        bool "外部中断（perf_external_irq）"
        default y

      config PERF_DIC_ARCH_COUNTER_INTERRUPT_TAKEN
        bool "实际进入中断（perf_interrupt_taken）"
        default y

      config PERF_DIC_ARCH_COUNTER_PLIC_CLAIM
        bool "PLIC claim（perf_plic_claim）"
        default y

      config PERF_DIC_ARCH_COUNTER_PLIC_COMPLETE
        bool "PLIC complete（perf_plic_complete）"
        default y

      config PERF_DIC_ARCH_COUNTER_INTERRUPT_PENDING_CYCLE
        bool "中断 pending 周期数（perf_irq_pending）"
        default y

      config PERF_DIC_ARCH_COUNTER_INTERRUPT_LATENCY
        bool "中断 pending 到 trap 入口的延迟统计（perf_irq_pending）"
        default y
    endmenu

    menu "写缓冲：单计数器"
      depends on PERF_DIC_ARCH_COUNTER_WBUF

      config PERF_DIC_ARCH_COUNTER_WBUF_FULL
        bool "写缓冲无空位（perf_wbuf_full）"
        default y

      config PERF_DIC_ARCH_COUNTER_WBUF_DRAIN
        bool "写响应在途/排空（perf_wbuf_drain）"
        default y

      config PERF_DIC_ARCH_COUNTER_WBUF_OCCUPANCY
        bool "写缓冲占用周期和（perf_wbuf_count）"
        default y
    endmenu

    menu "CSR：单计数器"
      depends on PERF_DIC_ARCH_COUNTER_CSR

      config PERF_DIC_ARCH_COUNTER_CSR_READ
        bool "CSR读（perf_csr_read）"
        default y

      config PERF_DIC_ARCH_COUNTER_CSR_WRITE
        bool "CSR写（perf_csr_write）"
        default y

      config PERF_DIC_ARCH_COUNTER_CSR_ILLEGAL
        bool "非法 CSR 指令（perf_csr_illegal）"
        default y
    endmenu

    menu "MDU 细节：单计数器"
      depends on PERF_DIC_ARCH_COUNTER_MDU_DETAIL

      config PERF_DIC_ARCH_COUNTER_MUL_ACTIVE
        bool "乘法活跃周期（perf_mul_active）"
        default y

      config PERF_DIC_ARCH_COUNTER_DIV_ACTIVE
        bool "除法活跃周期（perf_div_active）"
        default y

      config PERF_DIC_ARCH_COUNTER_DIV_ITERATIONS
        bool "除法实际迭代位数（perf_div_iterations）"
        default y

      config PERF_DIC_ARCH_COUNTER_DIV_EARLY_OUT
        bool "除法提前结束次数（perf_div_early_out）"
        default y
    endmenu

    menu "队列/气泡：单计数器"
      depends on PERF_DIC_ARCH_COUNTER_QUEUE

      config PERF_DIC_ARCH_COUNTER_ISSUE_OCCUPANCY
        bool "EXU输入槽占用周期（perf_issue_occupancy）"
        default y

      config PERF_DIC_ARCH_COUNTER_RETIRE_OCCUPANCY
        bool "EXU输出/退休槽占用周期（perf_retire_occupancy）"
        default y

      config PERF_DIC_ARCH_COUNTER_BUBBLE_CYCLE
        bool "EXU输入气泡周期（perf_bubble_cycle）"
        default y
    endmenu

  endmenu

  config PERF_RISCV_ARCH_PMU
    bool "第五代精简指令集标准架构性能监测单元"
    default n
    help
      RISC-V 标准架构性能监测单元（PMU）。打开后生成 Zihpm
      可编程计数器、mhpmevent 事件选择器，并按子选项生成
      Sscofpmf 溢出/模式过滤逻辑。

  menu "第五代精简指令集标准架构性能监测单元：细分"
    depends on PERF_RISCV_ARCH_PMU

    config PERF_RISCV_ARCH_PMU_ZIHPM
      bool "Zihpm：mhpmcounter3..31 / mhpmevent3..31"
      default y
      help
        29 个 64 位可编程硬件性能计数器及对应事件选择器。

    config PERF_RISCV_ARCH_PMU_SSCOFPMF
      bool "Sscofpmf：计数溢出与模式过滤"
      default y
      depends on PERF_RISCV_ARCH_PMU_ZIHPM
      help
        标准可选扩展 Sscofpmf，包括 scountovf、LCOFI 以及
        mhpmevent 的 OF/MINH/SINH/UINH 过滤位。
  endmenu

  config PERF_SAVE
    bool "启用性能数据自动存档（CSV文件）"
    default y
    depends on PERF_DIC_ARCH_COUNTER
    help
      仿真结束后把本次性能数据写入单独的 CSV 文件。
      默认保存到 NPCSimResult/YYYYMMDD-HHMMSS/ 目录；同一秒
      内的多次运行会加数字后缀，不会覆盖已有结果。命令行
      --result-dir 可指定其他目录；未启用本选项时传入该参数
      会明确报错，不会静默忽略。
      CSV 同时记录工作区 dirty 状态、有效硬件配置摘要/哈希和
      当前目标 RTL 哈希。只有 target、PDK、配置及 RTL 哈希都匹配
      时才采用 synth.txt 的频率和面积，避免普通运行误用旧综合结果。

  config TRACE
    bool "启用追踪功能（总开关）"
    default n

  config ITRACE
    bool "启用指令追踪itrace"
    default n
    depends on TRACE

  config ITRACE_WRITE_FILE
    bool "itrace 输出到文件 (itrace.txt)"
    default n
    depends on ITRACE

  config MTRACE
    bool "启用内存追踪mtrace"
    default n
    depends on TRACE

  config FTRACE
    bool "启用函数调用追踪ftrace"
    default n
    depends on TRACE

  config IRINGBUF
    bool "启用指令环形缓冲区iringbuf"
    default n
    depends on TRACE
    help
      在环形缓冲区中记录最近执行的指令，并在NPC异常终止时输出

  config IRINGBUF_SIZE
    int "指令环形缓冲区大小"
    default 16
    depends on IRINGBUF
    range 1 65536

  config WATCHPOINT
    bool "启用监视点"
    default n
    depends on SDB
    help
      启用监视点功能，用于监控表达式值的变化

  config WATCHPOINT_NUM
    int "监视点数量上限"
    default 32
    depends on WATCHPOINT
    range 1 65536
    help
      监视点编号池的大小上限，修改后需重新编译

  config DIFFTEST
    bool "启用差分测试difftest"
    default n
    help
      启用差分测试，并使用NEMU作为参考模型
      需要将NEMU编译为.so共享库
      使用make run diff=/path/to/nemu-so指定参考模型

endmenu
```
