## npc/kconfig/Kconfig.linux
```kconfig
menu "Linux 启动镜像"

  config LINUX_BOOT_ENABLE
    bool "启用 Linux 启动镜像打包"
    depends on SBI_ENABLE
    default n
    help
      启用后，可使用 `make linux-image` 把以下内容打包成一个 NPC
      可直接加载的 binary：
        - M 模式 SBI 固件（OpenSBI/RustSBI，按 SBI_IMPL 选择）
        - 用户提供的 Linux Image
        - 可选的 initramfs
        - 按本菜单和 MMU/ISA 配置生成的 DTB

      本选项只负责打包用户已经准备好的文件；不会下载、编译或运行
      Linux kernel/rootfs。Image 必须位于 SBI_NEXT_ADDR（SBI 的
      S 模式入口），DTB 复用 SBI_FDT_ADDR，不再提供第二套镜像地址。

      启用本选项要求 SBI_ENABLE=y、SBI_FDT_ENABLE=y、HAS_S=y、
      HAS_MMU=y，并且 MMU 必须是标准 Sv32/Sv39/Sv48；CUSTOM 非标准
      几何无法用标准 DTB 描述，会在配置契约和 DTB 生成阶段明确拒绝。

  config LINUX_IMAGE_PATH
    string "Linux Image 路径"
    depends on LINUX_BOOT_ENABLE
    default "Image"
    help
      用户提供的 RISC-V Linux Image（不是 vmlinux ELF）。相对路径按
      ysyx-workbench 根目录解析，也支持绝对路径和 ~/ 开头路径。

      Image 必须带标准 RISC-V Linux image header（偏移 0x38 的
      "RISCV\0\0\0" 与偏移 0x40 的 "RSC\x05"），其 text_offset
      （若不为 0）必须与 SBI_NEXT_ADDR - 0x80000000 一致。
      地址固定复用 SBI_NEXT_ADDR，不单独配置 Image 地址。

  config LINUX_BOOTARGS
    string "Linux 内核命令行"
    depends on LINUX_BOOT_ENABLE
    default "console=ttyS0,115200 earlycon=sbi"
    help
      写入 DTB /chosen/bootargs。由 build_dtb.sh 展开到 DTS，不在
      DTS 中硬编码。

  config LINUX_INITRAMFS_ENABLE
    bool "使用独立 initramfs"
    depends on LINUX_BOOT_ENABLE
    default y
    help
      打开后，DTB 会在 /chosen 写入标准 linux,initrd-start 和
      linux,initrd-end，地址取 LINUX_INITRAMFS_ADDR，结束地址按
      initramfs 文件实际大小计算。关闭时不生成这两个属性。

      启用时 initramfs 文件必须存在；构建脚本不会截断或忽略缺失文件。

  config LINUX_INITRAMFS_PATH
    string "initramfs 路径"
    depends on LINUX_INITRAMFS_ENABLE
    default "initramfs.cpio"
    help
      initramfs/rootfs 文件路径。相对路径按 ysyx-workbench 根目录解析，
      也支持绝对路径和 ~/ 开头路径。

      脚本接受未压缩 newc/crc cpio，以及 gzip/xz/zstd/lz4/bzip2/lzma
      压缩的 initramfs；其他格式会明确报错。

  config LINUX_INITRAMFS_ADDR
    hex "initramfs 加载地址"
    depends on LINUX_INITRAMFS_ENABLE
    default 0x82000000
    help
      initramfs 在物理内存中的起始地址，必须 4 KiB 对齐，位于 NPC RAM
      内，并且不能与 SBI 固件、Linux Image、DTB 保留区重叠。

      默认标准布局为 Image 0x80200000、initramfs 0x82000000、
      DTB 0x83f00000、RAM 结束 0x84000000；修改地址后 make dtb /
      make linux-image 会自动使用新值并重新校验。

endmenu

menu "U-Boot EFI 启动镜像"

  config NPC_UBOOT_ENABLE
    bool "启用 NPC U-Boot EFI 打包"
    depends on SBI_ENABLE && SBI_FDT_ENABLE
    default n
    help
      启用后可使用 `make uboot-image` 把 OpenSBI FW_JUMP、U-Boot、
      可选的 EFI 应用/initramfs/EFI 内核拼成一个 direct-NPC 可直接
      加载的 raw binary。该路径与 NEMU 的 U-Boot 板级共用同一套
      S-mode 设备地址（UART 0x10000000、CLINT 0x02000000、
      PLIC 0x0c000000），因此复用 vendor/u-boot 的
      nemu_riscv64_smode_defconfig；DTB 由 NPC 的 450 MHz 配置生成。

      本菜单不会下载/编译 Linux，也不使用 `make linux-image` 的 raw
      Image 布局；kernel/initrd 由调用者提供并放在下面配置的固定地址。

  config NPC_UBOOT_INITRAMFS_PATH
    string "initramfs 路径"
    depends on NPC_UBOOT_ENABLE
    default ""
    help
      BusyBox initramfs 路径，相对 ysyx-workbench 根目录或绝对路径。
      留空表示不打包 initramfs，仅验证 U-Boot。

  config NPC_UBOOT_KERNEL_PATH
    string "EFI 内核路径"
    depends on NPC_UBOOT_ENABLE
    default ""
    help
      Debian EFI PE 内核（install/vmlinux）路径。留空表示只启动
      U-Boot，不执行 bootefi。

  config NPC_UBOOT_EFI_APP_PATH
    string "EFI 测试应用路径"
    depends on NPC_UBOOT_ENABLE
    default ""
    help
      可选 EFI 应用（如 U-Boot 的 initrddump.efi）。留空时若有
      initramfs，脚本会自动使用 U-Boot 构建目录中的 initrddump.efi。

  config NPC_UBOOT_EFI_APP_ADDR
    hex "EFI 测试应用加载地址"
    depends on NPC_UBOOT_ENABLE
    default 0x80600000
    help
      EFI 应用在 RAM 中的物理地址，必须 4 KiB 对齐且位于 U-Boot
      映像之后、initramfs 之前。

  config NPC_UBOOT_INITRAMFS_ADDR
    hex "initramfs 加载地址"
    depends on NPC_UBOOT_ENABLE
    default 0x80800000
    help
      initramfs 在 RAM 中的物理地址。U-Boot 通过 EFI_LOAD_FILE2
      把它交给内核，因此 DTB 不写 linux,initrd-start/end。

  config NPC_UBOOT_KERNEL_ADDR
    hex "EFI 内核加载地址"
    depends on NPC_UBOOT_ENABLE
    default 0x81000000
    help
      EFI PE 内核在 RAM 中的物理地址。U-Boot 的 efi_load_pe() 会
      再分配一份目标页，所以该地址只放源文件，不会原地执行。

  config NPC_UBOOT_BOOTARGS
    string "U-Boot 传给 Linux 的 bootargs"
    depends on NPC_UBOOT_ENABLE
    default "console=ttyS0,115200 earlycon=sbi no5lvl cpuidle.off=1 loglevel=7"
    help
      写入 DTB /chosen/bootargs，U-Boot 的 bootefi 也会把它作为
      load options。no5lvl 是必需的：Debian 6.12 默认选择 Sv57，
      而 NPC 只实现 Bare/Sv39/Sv48。

endmenu
```

## npc/kconfig/Kconfig.log
```kconfig
menu "日志"

choice
  prompt "日志级别"
  default LOG_INFO
  help
    控制哪些日志会输出，从严重到琐碎排列
    设定某级别后，低于该级别的日志代码直接不编译（零开销）
    silent：什么都不输出
    error：只输出错误（程序要崩了）
    warn：输出警告+错误（有问题但能继续跑）
    info：输出信息+警告+错误（正常运行状态）
    debug：全部输出（开发调试用的细节）
config LOG_SILENT
  bool "silent（关闭）"
config LOG_ERROR
  bool "error"
config LOG_WARN
  bool "warn"
config LOG_INFO
  bool "info"
config LOG_DEBUG
  bool "debug"
endchoice

config LOG_LEVEL
  int
  default 0 if LOG_SILENT
  default 1 if LOG_ERROR
  default 2 if LOG_WARN
  default 3 if LOG_INFO
  default 4 if LOG_DEBUG
  default 3

config LOG_TO_FILE
  bool "日志输出到文件"
  default y
  depends on !LOG_SILENT
  help
    文件名为启动时间戳，格式：YYYYMMDD-HHMMSS.log

config LOG_DIR
  string "日志输出目录"
  default "log"
  depends on LOG_TO_FILE
  help
    日志文件存放的目录路径，相对于npc目录

config LOG_TIMESTAMP
  bool "日志每行带时间戳"
  default n
  depends on !LOG_SILENT
  help
    每条日志前加上 [HH:MM:SS.mmm] 时间前缀

config LOG_SOURCE_LOCATION
  bool "日志带源文件位置"
  default n
  depends on !LOG_SILENT
  help
    每条日志显示调用处的文件名和行号

endmenu
```
