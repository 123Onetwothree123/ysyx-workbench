## npc/kconfig/Kconfig.mmu
```kconfig
menu "MMU/TLB"

  config HAS_MMU
    bool "启用 MMU"
    default y if HAS_S
    depends on HAS_S
    help
      MMU 总开关。关闭时 IFU/LSU 直接使用物理地址，PTW/页表/页错误
      相关逻辑不实例化。开启时 RTL 支持标准 Sv32（XLEN=32）以及
      标准 Sv39/Sv48（XLEN=64）、split/unified TLB 和独立只读 PTW
      AXI 通道。MMU 需要 S 模式 satp/页错误入口，因此 HAS_MMU=y
      要求 HAS_S=y；违反时 elaboration 明确报错。

  config HAS_TLB
    bool "启用 TLB"
    default y if HAS_MMU
    help
      TLB 总开关。关闭时每次访问都由 PTW 查页表；TLB 阵列不实例化。
      当前支持 Reg-CAM 存储、RR/PLRU/LRU 替换和 ASID/Global。

  menu "MMU Profile"

    choice
      prompt "默认 profile"
      default MMU_PROFILE_BALANCED
      help
        默认 balanced profile 的参数见 help 和各子项默认值。
        所有值都可以在下面继续修改；非标准组合由 elaboration/生成器校验。
      config MMU_PROFILE_BALANCED
        bool "balanced (标准 Sv32 基线)"
      config MMU_PROFILE_MIN_AREA
        bool "min-area"
      config MMU_PROFILE_HIGH_PERF
        bool "high-performance"
      config MMU_PROFILE_CUSTOM
        bool "custom"
    endchoice

    config MMU_PROFILE
      string
      default "balanced" if MMU_PROFILE_BALANCED
      default "min_area" if MMU_PROFILE_MIN_AREA
      default "high_perf" if MMU_PROFILE_HIGH_PERF
      default "custom"
      help
        profile 名称。生成 JSON/C header 时原样记录。

    choice
      prompt "RV64 页表几何模式"
      default MMU_GEOMETRY_STANDARD
      help
        STANDARD 使用标准 Sv39/Sv48（4KiB 页、3/4 级、8B PTE、
        satp MODE=8/9）。CUSTOM 显式启用非标准页大小/级数/索引/PTE
        几何，并使用保留的 satp MODE 10..15 作为非标准扩展；它不能
        伪装成标准 Sv39/Sv48。RV32 的既有自定义 32 位几何不受该选项
        限制，仍使用 satp MODE=1。
      config MMU_GEOMETRY_STANDARD
        bool "STANDARD (标准 Sv39/Sv48)"
      config MMU_GEOMETRY_CUSTOM
        bool "CUSTOM (RV64 非标准页几何，EXPERIMENTAL)"
    endchoice

    config MMU_GEOMETRY_MODE
      string
      default "standard" if MMU_GEOMETRY_STANDARD
      default "custom"
      help
        RTL 侧几何模式名称；CUSTOM 会出现在 elaboration 日志和
        npc_config.typed.json 的 soc/mmu 配置中，明确标记 non-standard。

    config MMU_CUSTOM_SATP_MODE
      int "CUSTOM 模式的 satp MODE"
      depends on MMU_GEOMETRY_CUSTOM
      default 10
      range 10 15
      help
        CUSTOM 几何专用的 satp.MODE 保留编码（10..15）。标准 8/9 是
        Sv39/Sv48，1 是 Sv32，不能复用于非标准页表；CSR 对其他编码
        按 WARL 收敛到 Bare(0)。软件必须显式使用这里配置的扩展模式。

    config MMU_PAGE_SIZE_BYTES
      int "基础页大小 (Byte)"
      default 4096
      # 不做 range 限制：页大小与级数/页表项数共同决定几何，Kconfig
      # 的连续 range 无法表达这些组合。RTL 只要求 2 的幂；非标准值由
      # tools/KconfigContract/ 检查几何，必要时再由 elaboration
      # 按实际 RTL 能力明确拒绝。
      help
        默认 4096，即标准 Sv32/Sv39/Sv48 的 4KiB 页。
        该值是自由输入的非负整数，RTL 要求它是 2 的幂；当前实现可
        表示到 1GiB（pageSizeBytes 为 32 位有符号 Int），但具体页大小
        还必须满足 pageBits + levels * indexBits 的 VA 位宽不超过 64，
        以及 PTE/satp.PPN 至少保留 1 位可寻址位。
        常用值：4, 8, 16, 32, 64, 128, 256, 512, 1KiB, 2KiB, 4KiB,
        8KiB, 16KiB, 32KiB, 64KiB, 128KiB, 256KiB, 512KiB, 1MiB,
        2MiB, 4MiB, ...。RV64 STANDARD 只能使用 4096；其他 2 的幂
        必须显式启用 CUSTOM 几何并配套软件页表生成器。非 2 的幂、
        地址位宽溢出等不可表达的几何由 kconfig-contract-check 明确
        拒绝；超出当前 RTL 能力的组合由 elaboration/生成器报错。

    config MMU_LEVELS
      int "页表级数"
      default 3 if XLEN=64
      default 2
      help
        默认 RV32=2（Sv32）、RV64=3（Sv39）；RV64 STANDARD 还允许
        4（Sv48）。该值是自由输入整数，不做 Kconfig range 限制。
        当前大页实现把 fillLevel/层级字段扩展到 3 位，因此实际支持
        1..8 级；超出 1..8、pageBits + levels * indexBits 超过 64 位
        VA，或 STANDARD 下选择了非 3/4 的值，会由配置校验/elaboration
        明确报错，而不是在 Kconfig 中静默夹值。
        CUSTOM 模式支持 1..8 级，并允许非标准页大小/索引位宽；需要
        更深层级时应先扩展 RTL 的 fillLevel 位宽。

    config MMU_PTE_SIZE_BYTES
      int "PTE 大小 (Byte)"
      default 8 if XLEN=64
      default 4
      help
        默认 RV32=4（Sv32）、RV64=8（Sv39/Sv48）。
        该值是自由输入整数，Kconfig 不做 4/8 锁定；可以使用 4/8/16
        等 2 的幂试验私有几何（字段位置必须能放下 flags 与 PPN）。
        当前 RTL 的 PTE 存储/写端口实际只支持 4B 与 8B；其他值会在
        MMU profile 生成或 elaboration 阶段明确报错。标准 Sv32 必须
        为 4，标准 Sv39/Sv48 必须为 8。
        CUSTOM 模式允许 4/8，PTE 字段位置由下面各项配置；非 2 的幂、
        字段越界/重叠、PPN 位宽溢出由 kconfig-contract-check 拒绝。

    config MMU_PAGE_TABLE_SIZE_BYTES
      int "单级页表页大小 (Byte)"
      default 4096
      help
        默认 4096。页表页中可容纳的 PTE 数 =
        MMU_PAGE_TABLE_SIZE_BYTES / MMU_PTE_SIZE_BYTES。
        该值必须是 2 的幂、能被 PTE 大小整除，且每级至少 2 个 PTE；
        非 4096 的页表页只应与 CUSTOM 几何/软件页表生成器一起使用。
        违反这些约束时 kconfig-contract-check 或 elaboration 会明确报错。

    choice
      prompt "PTE 编码"
      default MMU_PTE_RISCV64 if XLEN=64
      default MMU_PTE_RISCV32
      config MMU_PTE_RISCV32
        bool "标准 RISC-V 32-bit PTE (Sv32)"
      config MMU_PTE_RISCV64
        bool "标准 RISC-V 64-bit PTE (Sv39/Sv48)"
      config MMU_PTE_CUSTOM
        bool "自定义 PTE (EXPERIMENTAL)"
    endchoice

    config MMU_PTE_FORMAT
      string
      default "riscv32" if MMU_PTE_RISCV32
      default "riscv64" if MMU_PTE_RISCV64
      default "custom"
      help
        PTE 编码名称。自定义编码通过下面的字段位置配置，PTW 会先
        归一化到内部标准 PTE 再交给 TLB。RV64 CUSTOM 下，若字段位置
        与标准布局不同，必须选择 MMU_PTE_FORMAT=custom，避免把私有
        编码标成 riscv32/riscv64。

    config MMU_PTE_VALID_BIT
      int "PTE valid 位"
      default 0
      range 0 31
    config MMU_PTE_READ_BIT
      int "PTE read 位"
      default 1
      range 0 31
    config MMU_PTE_WRITE_BIT
      int "PTE write 位"
      default 2
      range 0 31
    config MMU_PTE_EXEC_BIT
      int "PTE execute 位"
      default 3
      range 0 31
    config MMU_PTE_USER_BIT
      int "PTE user 位"
      default 4
      range 0 31
    config MMU_PTE_GLOBAL_BIT
      int "PTE global 位"
      default 5
      range 0 31
    config MMU_PTE_A_BIT
      int "PTE A 位"
      default 6
      range 0 31
      help
        A/D 位只允许落在 0..31；8B PTE 的高 32 位字不能被当前 32 位
        页表写端口更新。MMU_AD_HARDWARE + 8B PTE 时若 A/D 位 >=32，
        配置校验和 elaboration 都会明确拒绝；这种私有布局只能用
        MMU_AD_FAULT/IGNORE，或把 A/D 移到低 32 位。
    config MMU_PTE_D_BIT
      int "PTE D 位"
      default 7
      range 0 31
      help
        同 MMU_PTE_A_BIT：8B PTE 的硬件 A/D 更新要求 D 位 <32。
    config MMU_PTE_PPN_LOW
      int "PTE PPN 低位位置"
      default 10
      range 0 31
    config MMU_PTE_PPN_HIGH
      int "PTE PPN 高位位置"
      default 53 if MMU_PTE_RISCV64
      default 31
      range 0 63
      help
        Sv32 为 31；Sv39/Sv48 的 64 位 PTE 为 53（44 位 PPN）。

    config MMU_SUPERPAGE
      bool "支持超级页"
      default y if HAS_MMU
      help
        打开后 PTW 接受非末级叶子 PTE，并按对应页大小生成物理地址。
        TLB 是否缓存超级页由 TLB_SUPERPAGE 单独控制。

    choice
      prompt "A/D 位策略"
      default MMU_AD_FAULT
      config MMU_AD_FAULT
        bool "缺 A/D 产生 page fault"
      config MMU_AD_HARDWARE
        bool "PTW 自动写回 A/D"
      config MMU_AD_IGNORE
        bool "忽略 A/D (仅 bring-up)"
    endchoice

    config MMU_AD_MODE
      string
      default "fault" if MMU_AD_FAULT
      default "hardware" if MMU_AD_HARDWARE
      default "ignore"

    choice
      prompt "Cache 与 MMU 的关系"
      default MMU_CACHE_VIPT if MMU_PROFILE_HIGH_PERF
      default MMU_CACHE_PIPT
      config MMU_CACHE_PIPT
        bool "PIPT：MMU 在 Cache 前"
      config MMU_CACHE_VIPT
        bool "VIPT：TLB 与 Cache 并行"
        help
          使用虚拟地址提前选择 Cache index，同时并行翻译物理地址。
          Cache 的 index 位宽与块内偏移之和默认不得超过页内偏移位数
          （log2(MMU_PAGE_SIZE_BYTES)），否则不同虚拟页可能把同一物理
          行放进不同 set，elaboration 会明确报错。若确需该几何，可打开
          MMU_CACHE_VIPT_ALIAS_SAFE，由 Cache 在 refill/store 时按物理
          tag 失效其他 set 的 alias 副本。
          VIPT 下 cache line 不得大于页，否则一行会跨越两个虚拟页；
          elaboration 会明确报错并提示改用 MMU_CACHE_MODE=pipt。
          PIPT 用物理地址索引和回填，允许 line > page，不存在该限制。
    endchoice

    config MMU_CACHE_MODE
      string
      default "pipt" if MMU_CACHE_PIPT
      default "vipt"

    config MMU_CACHE_VIPT_ALIAS_SAFE
      bool "VIPT alias 安全：允许 index 越过页内偏移"
      depends on MMU_CACHE_VIPT
      default n
      help
        允许 Cache index 位与块内偏移之和超过页内偏移位数。此时同一物理
        行可能通过不同虚拟地址落在不同 set；Cache 在 refill 安装和写直达
        store 完成时扫描 tag 阵列，失效其他 set 中同物理行的副本，保证
        别名读写一致。该选项会增加 tag 比较/valid 写口逻辑，默认关闭。
        关闭时非法几何仍会在 elaboration 期报错，不会静默退化为 PIPT。
        也可直接选择 MMU_CACHE_PIPT，用物理索引避免 alias。

    choice
      prompt "VIPT alias 失效扫描方式"
      depends on MMU_CACHE_VIPT_ALIAS_SAFE
      default MMU_CACHE_VIPT_ALIAS_SCAN_ALL_SETS
      help
        控制 alias 维护硬件如何搜索同一物理行的其它 set 副本。
        ALL_SETS：单拍并行比较所有 set，refill/store 不增加额外等待，
          但 tag 比较器和 valid 写译码面积随 set 数线性增长（默认）。
        SERIAL：每个周期只扫描一个 set，只有一套比较器/写译码，面积小；
          扫描期间反压新的 Cache 请求，refill 完成后可能多等 1..set 数拍。
        PARALLEL_N：每周期扫描 N 个 set（N 由下面的
          MMU_CACHE_VIPT_ALIAS_SCAN_WIDTH 配置），面积/等待介于
          SERIAL 与 ALL_SETS 之间；N=sets 时等价于单拍全扫描。
        DIRECTORY：不扫描 tag 阵列，维护“物理行 -> set”目录；refill 安装、
          写直达 store 和 ICache store snoop 只查目录。目录项默认等于
          set 数（每个 set 独占一项，无冲突）；也可配置更少目录项，
          此时多个 set 共享目录桶，冲突会显式失效被挤出的 Cache 行，
          不会留下无法追踪的有效 alias 副本。
        所有模式都保证旧副本清理完成前不接受可能命中它的请求。

      config MMU_CACHE_VIPT_ALIAS_SCAN_ALL_SETS
        bool "ALL_SETS：单拍扫描全部 set"
      config MMU_CACHE_VIPT_ALIAS_SCAN_SERIAL
        bool "SERIAL：每周期扫描一个 set"
      config MMU_CACHE_VIPT_ALIAS_SCAN_PARALLEL_N
        bool "PARALLEL_N：每周期扫描 N 个 set"
      config MMU_CACHE_VIPT_ALIAS_SCAN_DIRECTORY
        bool "DIRECTORY：物理行 -> set 目录"
    endchoice

    config MMU_CACHE_VIPT_ALIAS_SCAN_MODE
      string
      default "all_sets" if MMU_CACHE_VIPT_ALIAS_SCAN_ALL_SETS
      default "serial" if MMU_CACHE_VIPT_ALIAS_SCAN_SERIAL
      default "parallel_n" if MMU_CACHE_VIPT_ALIAS_SCAN_PARALLEL_N
      default "directory" if MMU_CACHE_VIPT_ALIAS_SCAN_DIRECTORY
      default "all_sets"

    config MMU_CACHE_VIPT_ALIAS_SCAN_WIDTH
      int "PARALLEL_N 每周期扫描的 set 数 N（0=自动）"
      depends on MMU_CACHE_VIPT_ALIAS_SAFE && MMU_CACHE_VIPT_ALIAS_SCAN_PARALLEL_N
      range 0 1024
      default 4
      help
        PARALLEL_N 每周期并行比较/失效的 set 数；0 表示自动取
        min(默认值 4, sets)。实际 RTL 宽度会在每个 Cache 内按 set 数
        截断（N>sets 等价于单拍全扫描），因此 8/16/32 set 的默认值 4
        分别对应 2/4/8 拍完成一轮扫描。N 越大，比较器/valid 写译码
        越多、扫描等待越短。大于 0 时必须是 >=2 的值。

    config MMU_CACHE_VIPT_ALIAS_DIRECTORY_ENTRIES
      int "DIRECTORY 目录项数（0=跟随 set 数）"
      depends on MMU_CACHE_VIPT_ALIAS_SAFE && MMU_CACHE_VIPT_ALIAS_SCAN_DIRECTORY
      range 0 1024
      default 0
      help
        DIRECTORY 模式的物理行 -> set 目录项数，必须是 2 的幂。
        0 表示跟随每个 Cache 的 set 数（每个 set 独占一个目录桶，
        目录完整、无冲突）。显式配置更小的值可以观察目录容量对
        命中率的影响：多个 set 共享目录桶时，安装新行会失效被挤出
        的 Cache 行，正确性不受影响，只是可能多一次 refill。

    config MMU_CACHE_VIPT_ALIAS_EVENT_QUEUE_DEPTH
      int "DCache VIPT alias 事件队列深度"
      depends on MMU_CACHE_VIPT_ALIAS_SAFE && DCACHE
      range 2 16
      default 4
      help
        DCache 写直达 store/refill 的 alias 失效事件队列深度，必须是
        2 的幂（2/4/8/16）。队列满时会清空整个 DCache 以保证正确性；
        更大的深度减少 overflow 概率，但增加寄存器/面积。仅 DCache 使用。

    choice
      prompt "PTW 内存通路"
      default MMU_PTW_DEDICATED
      config MMU_PTW_DEDICATED
        bool "独立 PTW 物理读端口 (经 AXI 仲裁)"
      config MMU_PTW_REUSE_DCACHE
        bool "复用 DCache/CPU 数据通路"
    endchoice

    config MMU_PTW_PATH
      string
      default "dedicated" if MMU_PTW_DEDICATED
      default "reuse_dcache"

    choice
      prompt "PTW 内部结构"
      default MMU_PTW_PIPELINED if MMU_PROFILE_HIGH_PERF
      default MMU_PTW_INDEPENDENT
      config MMU_PTW_INDEPENDENT
        bool "多个独立 walk，各自串行逐级"
      config MMU_PTW_PIPELINED
        bool "流水化 PTW"
    endchoice

    config MMU_PTW_ARCH
      string
      default "independent" if MMU_PTW_INDEPENDENT
      default "pipelined"

    config MMU_PTW_OUTSTANDING
      int "PTW 最大在途 walk 数"
      default 1 if MMU_PROFILE_MIN_AREA
      default 4 if MMU_PROFILE_HIGH_PERF
      default 2
      range 1 16
      help
        balanced 默认 2。多笔在途需要 walk ID、响应队列和
        TLB refill 仲裁；具体数据结构由 MMU_PTW_ARCH 决定。

    config MMU_PTW_BUS_OUTSTANDING
      int "PTW 页表总线最大在途事务数"
      default 1 if MMU_PROFILE_MIN_AREA
      default 4 if MMU_PROFILE_HIGH_PERF
      default 1
      range 0 16
      help
        控制 PTW 与页表总线之间可同时保持的读/写事务数，0 表示跟随
        MMU_PTW_OUTSTANDING。independent 结构按 walker 固定事务 ID，
        pipelined 结构按 B 级槽位分配事务 ID，响应均按 ID 回收。
        共享 IFU/LSU AXI 读端口按 3..15 分配页表读 ID，最多 13 笔
        AXI 读同时在途；超出的请求在适配器队列中等待，不会丢失。

    choice
      prompt "PTW 返回顺序"
      default MMU_PTW_IN_ORDER
      config MMU_PTW_IN_ORDER
        bool "in-order"
      config MMU_PTW_OUT_OF_ORDER
        bool "out-of-order"
    endchoice

    config MMU_PTW_ORDER
      string
      default "in_order" if MMU_PTW_IN_ORDER
      default "out_of_order"

    config MMU_PTW_CACHE
      bool "启用 PTW 专用页表缓存"
      default y if MMU_PROFILE_HIGH_PERF
      default n
      help
        也叫 walk cache/PTE cache。默认关闭，避免额外面积；
        打开后需要与 sfence、PTE 写回和 A/D 更新保持一致。
        支持 4B 与 8B PTE：8B 表项保存低/高两个字，命中后不再
        产生两次页表读。

    config MMU_PTW_CACHE_ENTRIES
      int "PTW cache 项数"
      default 16
      depends on MMU_PTW_CACHE
      help
        必须是 2 的幂。

    config MMU_PTW_CACHE_WAYS
      int "PTW cache 组相联度"
      default 2
      depends on MMU_PTW_CACHE
      help
        1 表示直接映射；必须整除项数。

  endmenu

  menu "TLB"

    choice
      prompt "TLB 组织"
      default TLB_SPLIT
      config TLB_SPLIT
        bool "ITLB + DTLB (共享 PTW)"
      config TLB_UNIFIED
        bool "统一 TLB (共享 PTW)"
    endchoice

    config TLB_ORGANIZATION
      string
      default "split" if TLB_SPLIT
      default "unified"

    choice
      prompt "TLB 存储介质"
      default TLB_STORAGE_SRAM if MMU_PROFILE_HIGH_PERF
      default TLB_STORAGE_REG
      config TLB_STORAGE_REG
        bool "Reg-CAM"
      config TLB_STORAGE_SRAM
        bool "同步读 SRAM"
    endchoice

    config TLB_STORAGE
      string
      default "reg" if TLB_STORAGE_REG
      default "sram"

    choice
      prompt "TLB 替换策略"
      default TLB_REPLACE_RR if MMU_PROFILE_MIN_AREA
      default TLB_REPLACE_PLRU
      config TLB_REPLACE_RR
        bool "round-robin"
      config TLB_REPLACE_PLRU
        bool "PLRU"
      config TLB_REPLACE_LRU
        bool "LRU"
    endchoice

    config TLB_REPLACEMENT
      string
      default "rr" if TLB_REPLACE_RR
      default "plru" if TLB_REPLACE_PLRU
      default "lru"

    config TLB_ASID_BITS
      int "TLB ASID 位数"
      default 16 if XLEN=64
      default 9
      range 0 16
      help
        0 表示无 ASID，satp.ASID 变化必须全冲刷；Sv32 通常为 9，
        Sv39/Sv48 的 satp.ASID 为 16 位。

    config TLB_GLOBAL
      bool "支持 Global 位"
      default y

    config ITLB_ENTRIES
      int "ITLB 项数"
      default 4 if MMU_PROFILE_MIN_AREA
      default 32 if MMU_PROFILE_HIGH_PERF
      default 16
      depends on TLB_SPLIT
      help
        必须是 2 的幂。ITLB_WAYS=1 表示直接映射。

    config ITLB_WAYS
      int "ITLB 组相联度"
      default 1 if MMU_PROFILE_MIN_AREA
      default 4 if MMU_PROFILE_HIGH_PERF
      default 2
      depends on TLB_SPLIT

    config DTLB_ENTRIES
      int "DTLB 项数"
      default 8 if MMU_PROFILE_MIN_AREA
      default 64 if MMU_PROFILE_HIGH_PERF
      default 32
      depends on TLB_SPLIT

    config DTLB_WAYS
      int "DTLB 组相联度"
      default 1 if MMU_PROFILE_MIN_AREA
      default 4 if MMU_PROFILE_HIGH_PERF
      default 4
      depends on TLB_SPLIT

    config UTLB_ENTRIES
      int "统一 TLB 项数"
      default 8 if MMU_PROFILE_MIN_AREA
      default 64 if MMU_PROFILE_HIGH_PERF
      default 32
      depends on TLB_UNIFIED

    config UTLB_WAYS
      int "统一 TLB 组相联度"
      default 1 if MMU_PROFILE_MIN_AREA
      default 8 if MMU_PROFILE_HIGH_PERF
      default 4
      depends on TLB_UNIFIED

    config TLB_SUPERPAGE
      bool "TLB 缓存超级页"
      default y if HAS_TLB
      help
        打开后 TLB 增加超级页 CAM，按 pageBits/levels/indexBits
        计算超级页大小。
    config TLB_SUPERPAGE_ENTRIES
      int "TLB 超级页 CAM 项数"
      default 4
      range 1 16
      depends on TLB_SUPERPAGE

    choice
      prompt "TLB miss queue 组织"
      default TLB_MISS_QUEUE_FOLLOW
      config TLB_MISS_QUEUE_FOLLOW
        bool "跟随 TLB 组织"
        help
          split TLB 使用独立的 ITLB/DTLB miss queue；unified TLB
          使用一条 UTLB miss queue。TLB 缺失请求先进入对应队列，
          再由队列调度到 PTW walk 槽。
      config TLB_MISS_QUEUE_GLOBAL
        bool "全局共享队列"
        help
          fetch/load/store 的 TLB 缺失请求共用一条全局 miss queue，
          深度由 GLOBAL_MISS_QUEUE_ENTRIES 控制。
    endchoice

    config TLB_MISS_QUEUE_MODE
      string
      default "follow_tlb" if TLB_MISS_QUEUE_FOLLOW
      default "global"

    config ITLB_MISS_QUEUE_ENTRIES
      int "ITLB miss queue 深度"
      default 4
      depends on TLB_SPLIT
    config DTLB_MISS_QUEUE_ENTRIES
      int "DTLB miss queue 深度"
      default 4
      depends on TLB_SPLIT
    config UTLB_MISS_QUEUE_ENTRIES
      int "统一 TLB miss queue 深度"
      default 8
      depends on TLB_UNIFIED
    config GLOBAL_MISS_QUEUE_ENTRIES
      int "全局 miss queue 深度"
      default 8
      depends on TLB_MISS_QUEUE_GLOBAL

    config UTLB_LOOKUP_PORTS
      int "统一 TLB 查找端口数"
      default 2
      range 1 2
      depends on TLB_UNIFIED
    config TLB_REFILL_PORTS
      int "TLB refill 写端口数"
      default 1
      range 1 4

  endmenu



endmenu
```
