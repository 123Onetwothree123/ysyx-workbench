## npc/kconfig/Kconfig.rootfs
```kconfig
menu "根文件系统 (rootfs)"

  config ROOTFS_ENABLE
    bool "启用 rootfs"
    default n
    help
      启用后，make rootfs 会使用下面选择的 rootfs 实现生成
      initramfs 镜像；关闭时 make rootfs 会明确报错。该开关只
      负责 rootfs 前道工序，Linux kernel 仍由用户自行下载、
      编译和启动，本构建不会联网或构建内核。

  choice
    prompt "rootfs 实现"
    depends on ROOTFS_ENABLE
    default ROOTFS_BUSYBOX

    config ROOTFS_BUSYBOX
      bool "BusyBox"
      help
        使用 vendor/busybox 中的 BusyBox 源码构建最小 rootfs。
        当前只提供这一种实现；后续新增实现必须在此 choice 中
        显式增加，不能静默回退到 BusyBox。
  endchoice

  config ROOTFS_TYPE
    string
    default "busybox" if ROOTFS_BUSYBOX
    default "none"
    help
      当前生效的 rootfs 类型。ROOTFS_ENABLE=n 时为 none；
      启用后只能选择已实现的 BusyBox。

  config ROOTFS_BUSYBOX_PATH
    string "BusyBox 源码路径"
    depends on ROOTFS_BUSYBOX
    default "vendor/busybox"
    help
      BusyBox 源码目录，相对路径按 ysyx-workbench 根目录解析。
      当前树内版本为 BusyBox 1.36.1，源码随仓库跟踪，不使用
      git submodule，也不在构建时联网下载。

  config ROOTFS_BUSYBOX_VERSION
    string "BusyBox 版本"
    depends on ROOTFS_BUSYBOX
    default "1.36.1"
    help
      仅用于记录和检查树内 BusyBox 源码版本。版本变化时必须
      同时更新 vendor/busybox 源码和校验信息。

  config ROOTFS_BUSYBOX_TOOLCHAIN_PREFIX
    string "BusyBox 交叉工具链前缀"
    depends on ROOTFS_BUSYBOX
    default "riscv64-linux-gnu-"
    help
      编译 BusyBox 使用的工具链前缀。构建脚本要求
      <前缀>gcc 存在，且 -dumpmachine 的目标为 riscv64；
      不满足时明确报错。可用同名环境变量覆盖。

  config ROOTFS_BUSYBOX_MARCH
    string "BusyBox -march"
    depends on ROOTFS_BUSYBOX
    default "rv64gc"
    help
      传给 BusyBox 编译器的 -march。默认 rv64gc，覆盖
      RV64GC（含 F/D 与压缩指令）。可用同名环境变量覆盖。

  config ROOTFS_BUSYBOX_MABI
    string "BusyBox -mabi"
    depends on ROOTFS_BUSYBOX
    default "lp64d"
    help
      传给 BusyBox 编译器的 -mabi。默认 lp64d，与 rv64gc
      的硬件浮点调用约定一致。可用同名环境变量覆盖。

  config ROOTFS_BUSYBOX_STATIC
    bool "静态链接 BusyBox"
    depends on ROOTFS_BUSYBOX
    default y
    help
      最小 initramfs 只包含 BusyBox 本身，因此必须静态链接。
      当前构建脚本只支持 y；设为 n 会明确报错，而不会生成
      缺少动态加载器和 libc 的不可启动镜像。

  config ROOTFS_FASTFETCH
    bool "安装 fastfetch"
    depends on ROOTFS_BUSYBOX
    default y
    help
      将静态链接的 RV64GC/lp64d fastfetch 安装到 rootfs 的
      /usr/bin/fastfetch。目标二进制不存在时，构建脚本会调用
      npc/scripts/build_fastfetch.sh 自动交叉编译。

  config ROOTFS_FASTFETCH_PATH
    string "fastfetch 二进制路径"
    depends on ROOTFS_FASTFETCH
    default "build/fastfetch/fastfetch"
    help
      fastfetch 二进制路径。相对路径按 npc/ 解析；默认使用
      npc/scripts/build_fastfetch.sh 的输出。也可指向预先构建
      好的静态 RV64GC/lp64d 二进制。构建脚本会校验 ELF64
      RISC-V、RVC、double-float ABI 和静态链接。

  config ROOTFS_BUSYBOX_INIT_SCRIPT
    bool "生成 BusyBox sh /init 脚本"
    depends on ROOTFS_BUSYBOX
    default y
    help
      启用时生成 /init：用 BusyBox sh 挂载 proc/sys（失败不
      致命）、创建 /dev/console，最后 exec /bin/sh。
      关闭时不生成 /init，改为 /sbin/init -> BusyBox init 和
      最小 /etc/inittab，由内核回退到 /sbin/init。

  config ROOTFS_BUSYBOX_APPLETS
    string "BusyBox applet 符号链接"
    depends on ROOTFS_BUSYBOX
    default "sh ls cat echo mount umount mkdir mknod ps kill sleep dmesg ifconfig ip vi grep sed awk find cp mv rm ln chmod chown df du free uname hostname reboot poweroff halt switch_root mdev insmod lsmod rmmod modprobe tar gzip gunzip wc head tail sort uniq tr cut printf test true false date id whoami env pwd touch sync init"
    help
      以空格分隔的 applet 名称，构建脚本在 rootfs 的 /bin 下
      为它们创建指向 busybox 的相对符号链接。每个名称必须是
      当前 BusyBox 配置实际启用的 applet，否则构建明确失败。
      至少需要包含 sh（/init 的交互 shell）。

  config ROOTFS_BUSYBOX_JOBS
    int "BusyBox 并行任务数"
    depends on ROOTFS_BUSYBOX
    default 0
    range 0 256
    help
      BusyBox 的 make -j 数量。0 表示使用 nproc（上限 256）。
      可用同名环境变量覆盖。

  config ROOTFS_OUT_DIR
    string "rootfs 输出目录"
    depends on ROOTFS_ENABLE
    default "build/rootfs"
    help
      相对路径按 npc/ 解析；默认在 npc/build/rootfs 下存放
      BusyBox out-of-tree 构建目录、rootfs 树和 initramfs。
      可用同名环境变量覆盖。

endmenu
```

## npc/kconfig/Kconfig.sbi
```kconfig
menu "SBI 固件"

  config SBI_ENABLE
    bool "启用 SBI 固件"
    default n
    help
      启用后，NPC 可加载 M 模式 SBI 固件，再跳转到 S 模式
      next-stage（例如 Linux）。默认关闭，xv6 仍按 M 模式直接启动。

      当前提供 OpenSBI 与 RustSBI 两个实现选项；未构建对应固件时，
      构建脚本会明确报错，不会静默使用其他实现。

  choice
    prompt "SBI 实现"
    depends on SBI_ENABLE
    default SBI_IMPL_OPENSBI

    config SBI_IMPL_OPENSBI
      bool "OpenSBI"
      help
        使用 vendor/opensbi 中的 OpenSBI 固件。

    config SBI_IMPL_RUSTSBI
      bool "RustSBI"
      help
        使用 vendor/rustsbi 中的 RustSBI 固件。
        需要 rustup 的 RISC-V bare-metal target；构建脚本会在缺失时明确报错。
  endchoice

  config SBI_IMPL
    string
    default "opensbi" if SBI_IMPL_OPENSBI
    default "rustsbi" if SBI_IMPL_RUSTSBI
    default "none"

  config SBI_FW_BASE
    hex "SBI 固件加载地址"
    default 0x80000000
    help
      SBI 固件的 M 模式入口/加载地址。必须与 NPC reset PC 和
      next-stage 布局一致。

  config SBI_FW_SIZE
    hex "SBI 固件最大大小"
    default 0x00200000
    help
      为 SBI 固件预留的地址空间大小。next-stage 必须位于
      SBI_FW_BASE + SBI_FW_SIZE 之后，除非显式覆盖 SBI_NEXT_ADDR。

  config SBI_NEXT_ADDR
    hex "SBI 跳转的 next-stage 地址"
    default 0x80200000
    help
      OpenSBI/RustSBI 启动完成后跳转到的 S 模式入口。
      Linux 通常放在 0x80200000 附近；具体以镜像链接地址为准。

  config SBI_PLATFORM
    string "SBI 平台名"
    default "npc"
    help
      SBI 固件的平台适配名。当前为 NPC 最小平台：
      UART 0x10000000、CLINT 0x02000000、PLIC 0x0c000000、RAM 0x80000000。

  config SBI_BUILD_JOBS
    int "SBI 构建并行度"
    default 0
    help
      传给 SBI 构建脚本的并行任务数；0 表示使用当前 CPU 核数。

  config SBI_FDT_ENABLE
    bool "向 next-stage 传递设备树 (DTB)"
    depends on SBI_ENABLE
    default n
    help
      打开后，SBI 固件会内嵌 npc/dts/npc.dts 生成的 DTB，并在进入
      S 模式时把它放到 SBI_FDT_ADDR，通过 a1 传给 next-stage
      （Linux 约定 a1=DTB 物理地址）。

      默认关闭：SBI 仍按编译期固定的平台设备初始化，进入 S 模式时
      a1=0，和之前的 OpenSBI/RustSBI 行为完全一致。

  config SBI_FDT_PATH
    string "设备树源文件/二进制路径"
    depends on SBI_FDT_ENABLE
    default "dts/npc.dts"
    help
      DTS 或 DTB 文件。相对路径按 npc/ 目录解析；也可以写绝对路径。
      .dts 会先经 cpp 展开布局宏，再由 dtc 编译；.dtb 直接使用。

      默认的 npc/dts/npc.dts 会读取 SBI_FW_BASE/SBI_FW_SIZE/
      SBI_NEXT_ADDR/SBI_FDT_ADDR，使 reserved-memory 与实际 SBI
      布局一致。

  config SBI_FDT_ADDR
    hex "DTB 加载/传递地址"
    depends on SBI_FDT_ENABLE
    default 0x80f00000
    help
      DTB 在物理内存中的最终地址。OpenSBI 通过 FW_JUMP_FDT_ADDR/
      FW_PAYLOAD_FDT_ADDR 把内嵌 DTB 复制到这里；RustSBI 也会把
      内嵌 DTB 复制到这里，再以 a1 传给 S 模式。

      该地址必须 8 字节对齐，位于 NPC RAM 内，且不能与 SBI 固件区
      重叠。默认 0x80f00000 位于 next-stage 0x80200000 之后，给
      Linux Image 预留约 13 MiB；如果内核更大，请同时上移
      SBI_FDT_ADDR 或下移 SBI_NEXT_ADDR。

endmenu
```

## npc/kconfig/Kconfig.soc
```kconfig
menu "SoC 与外设"

  menu "中断控制器 (PLIC)"
    config PLIC_SOURCES
      int "PLIC 中断源数量"
      default 32
      range 2 1024
      depends on HAS_S_EXTERNAL_IRQ
      help
        source 0 保留，实际可用 source 1..PLIC_SOURCES-1。
        DTB 的 riscv,ndev 和 OpenSBI 的 num_src 会自动取
        PLIC_SOURCES-1，不需要另外配置。
    config PLIC_PRIORITY_BITS
      int "PLIC 优先级位宽"
      default 3
      range 1 8
      depends on HAS_S_EXTERNAL_IRQ
    config PLIC_MAX_PRIORITY
      int "PLIC 最大优先级"
      default 7
      depends on HAS_S_EXTERNAL_IRQ
    config PLIC_BASE
      hex "PLIC MMIO 基地址"
      default 0x0c000000
      depends on HAS_S_EXTERNAL_IRQ
    config PLIC_SIZE
      hex "PLIC MMIO 窗口大小"
      default 0x00300000
      depends on HAS_S_EXTERNAL_IRQ
      help
        PLIC 地址窗口大小。必须覆盖实际使用的 context 寄存器：
          0x200000 + 0x1000 * context 数
        当前实现使用 M context 0 和 S context 1，最小 0x202000。
        ysyxSoC 的片上 SRAM 从 0x0f000000 开始，因此默认 3MiB
        （0x00300000）正好止于 SRAM 之前。该值会同步到 CPU Xbar、
        PMA、DTB 和 OpenSBI 平台。

  endmenu

  menu "ysyxSoC 接口"

    config CHIPLINK
      bool "启用 ChipLink 外部存储/中断接口"
      default n
      help
        打开 ysyxSoC 的 ChipLink master/slave 与 DMA 代理。
        该值写入 typed JSON 的 soc.chiplink，由 SoC elaboration 消费；
        CPU 侧 PMA/DMA 一致性设置仍由 Makefile 从同一值派生。

    config SDRAM_USE_AXI
      bool "SDRAM 使用 AXI 数据通路"
      default y
      help
        选择 ysyxSoC 的 SDRAM 控制器接在 32 位 AXI xbar 上；关闭时
        使用 APB SDRAM 路径。该值写入 typed JSON 的
        soc.sdram_use_axi，由 SoC 拓扑选择直接消费。

    config SOC_XLEN_FOLLOW_CPU
      bool "SoC CPU 侧接口位宽跟随 CPU XLEN"
      default n
      help
        控制 ysyxSoC CPU 侧接口的 XLEN/数据宽度是否跟随 CPU 的 XLEN。
        n（默认）: 使用 SOC_XLEN，CPU 与 SoC 位宽相互独立。
        y: EffectiveSocXLEN = XLEN。
        注意 follow 只是让 SoC 接口跟随 CPU，并不是强制 CPU 与 SoC
        同宽；关闭后仍可自由组合 32/64，例如 64 位 CPU 搭配 32 位
        SoC，或 32 位 CPU 搭配 64 位 SoC。

    config SOC_XLEN
      int "ysyxSoC CPU 侧接口 XLEN"
      depends on !SOC_XLEN_FOLLOW_CPU
      default 64 if XLEN=64
      default 32
      # Kconfig 的 int/range 不能表达离散集合；32/64 由配置契约校验
      # 在配置阶段检查，elaboration 也会再次校验。
      range 32 64
      help
        ysyxSoC CPU 侧接口的 XLEN/数据宽度，仅当
        SOC_XLEN_FOLLOW_CPU=n 时可见并生效，只允许 32 或 64；
        XLEN=64 时默认 64，XLEN=32 时默认 32。
        33..63 会在 make defconfig/menuconfig 后的配置契约检查阶段
        被明确拒绝，不会静默生成。
        32 位 ysyxSoC 可以搭配 64 位 CPU：CPU 内部仍使用 64 位地址，
        但经 SoC 边界的访问必须位于低 4GiB，更高地址在 Xbar 内返回
        DECERR。64 位 SoC 接口已经由 AXI4Downsizer 接入 32 位
        xbar/外设，配置会写入 typed JSON 的 soc.soc_xlen，由
        ysyxSoC elaboration 直接消费。
        注意：direct-NPC 顶层（riscv32e_npc_SimTop/AXIRAM）的 AXI
        固定为 32 位；make build/.../ysyx_26030103_npc 会强制把
        EffectiveSocXLEN 投影为 32（命令行 SOC_XLEN=64 也会被覆盖）。
        64 位 SoC 接口只适用于 SIM_TOP=soc 的完整 SoC 构建。
        修改后需重新 make verilog 或 make build/ysyx_26030103。

  endmenu

  menu "SoC 总线延迟模型"

    config SYNTH_FREQ
      int "综合目标频率 (MHz)"
      default 450
      range 1 10000
      help
        综合器尝试达到的目标频率。设置越高，综合器可能使用更多
        面积换取更低的逻辑延迟。受限于工艺库和寄存器堆/加法器/SRAM等
        关键部件的最大工作频率。
        该值同时作为 APB/AXI 延迟模型的 CPU 频率传入 RTL，
        修改后需重新 make verilog。

    config APB_DEVICE_FREQ
      int "APB设备频率 (MHz)"
      default 100
      range 1 10000
      help
        APB总线上外设（如SDRAM控制器）的运行频率。
        用于APB延迟模块计算频率比校准访存延迟；该值进入 typed JSON
        的 soc.apb.device_freq_mhz，由 ysyxSoC 统一读取。

    config APB_DELAY_SCALE
      int "APB延迟缩放因子 S"
      default 64
      range 1 1048576
      help
        APB延迟模块中频率比累加的放大系数。

    config AXI_DEVICE_FREQ
      int "AXI设备频率 (MHz)"
      default 100
      range 1 10000
      help
        AXI总线上外设（如SDRAM控制器）的运行频率。
        用于AXI延迟模块计算频率比校准访存延迟。

    config AXI_DELAY_SCALE
      int "AXI延迟缩放因子 S"
      default 64
      range 1 1048576
      help
        AXI延迟模块中频率比累加的放大系数。

  endmenu

  menu "外设 / NVBoard"

    config NVBOARD
      bool "启用 NVBoard (LED/数码管/拨码开关可视化)"
      default n
      help
        链接 NVBoard，把 ysyxSoCFull 的 GPIO 引脚绑定到虚拟板卡的
        LED/数码管/拨码开关。需要 SDL2 (libsdl2-dev libsdl2-image-dev
        libsdl2-ttf-dev)，且 nvboard.a 要与本工程的 C++ 标准库 ABI 一致。
        仅支持 SIM_TOP=soc；direct-NPC 顶层没有这些外设引脚，构建时会
        明确拒绝该组合。

    config NVBOARD_NXDC
      string "NVBoard 约束文件(.nxdc)路径"
      depends on NVBOARD
      default "csrc/nvboard/gpio.nxdc"
      help
        描述 RTL 引脚到 NVBoard 组件的绑定关系

    config NVBOARD_UPDATE_INTERVAL
      int "每多少周期刷新一次 NVBoard GUI"
      depends on NVBOARD
      default 100
      range 1 1000000
      help
        每周期都刷新太慢，隔 N 个周期调用一次 nvboard_update 折中

  endmenu

endmenu
```

## npc/kconfig/Kconfig.synth
```kconfig
menu "综合 (Synthesis)"

choice
  prompt "综合工艺库 (PDK)"
  default PDK_ICSPROUT55
config PDK_ICSPROUT55
  bool "icsprout55"
config PDK_NANGATE45
  bool "nangate45"
endchoice

config PDK
  string
  default "icsprout55" if PDK_ICSPROUT55
  default "nangate45" if PDK_NANGATE45

choice
  prompt "综合策略"
  default SYNTH_STRATEGY_DELAY
config SYNTH_STRATEGY_AREA
  bool "AREA 0 (面积优先，不做retiming，反映真实面积)"
config SYNTH_STRATEGY_DELAY
  bool "DELAY 4 (yosys-sta默认，时序优先，ABC会做retiming)"
endchoice

config SYNTH_STRATEGY_TYPE
  string
  default "AREA" if SYNTH_STRATEGY_AREA
  default "DELAY" if SYNTH_STRATEGY_DELAY

config SYNTH_STRATEGY_IDX
  int
  default 0 if SYNTH_STRATEGY_AREA
  default 4 if SYNTH_STRATEGY_DELAY

config SYNTH_NOMAP
  bool "禁用 memory inference（保留寄存器阵列的真实面积）"
  default y
  help
    禁止yosys将寄存器阵列推断为memory块。
    开启后ICache等寄存器阵列的面积变化能正确反映在综合结果中。

config SYNTH_NOABC
  bool "禁用 ABC 优化（保留真实DFF面积）"
  default y
  help
    跳过ABC技术映射，仅做dfflibmap+简单组合逻辑映射。
    开启后综合面积能正确反映不同ICache大小的差异。
    关闭则ABC会做全局优化，面积可能被归一化。

endmenu
```

## vendor/u-boot/board/nemu/riscv64/Kconfig
```kconfig
# SPDX-License-Identifier: GPL-2.0+
#
# ysyx-workbench NEMU RV64 S-mode board

if TARGET_NEMU_RISCV64

config SYS_BOARD
	default "riscv64"

config SYS_VENDOR
	default "nemu"

config SYS_CPU
	default "generic"

config SYS_CONFIG_NAME
	default "nemu-riscv"

config TEXT_BASE
	default 0x80200000

config BOARD_SPECIFIC_OPTIONS
	def_bool y
	select GENERIC_RISCV
	select LMB
	select OF_HAS_PRIOR_STAGE
	imply DM_SERIAL
	imply RISCV_TIMER
	imply SYSRESET
	imply SYSRESET_SBI
	imply SYS_NS16550
	imply CMD_POWEROFF
	imply CMD_SBI

endif
```
