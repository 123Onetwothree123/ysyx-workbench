## npc/kconfig/Kconfig.hardware
```kconfig
menu "硬件配置"

  menu "指令集扩展"

    config XLEN
      int "当前 XLEN"
      default 32
      # Kconfig 的 int/range 只能表达连续区间，无法直接写成 {32,64}；
      # 33..63 由 tools/KconfigContract/ 在配置阶段拒绝，
      # elaboration 也会再次校验。保持 int 是为了让现有
      # CONFIG_XLEN=32/64 的 defconfig 和脚本继续可用。
      range 32 64
      help
        指令位宽，只允许 32（RV32）或 64（RV64）。Kconfig 的 range
        无法表达离散集合，33..63 虽然能填入，但会在 make defconfig/
        menuconfig 后的配置契约检查阶段被明确拒绝，不会进入 elaboration。
        RV64 已接通 GPR/PC/ALU/EXU/IDU/WBU/CSR 与 RV64I/RV64M 语义，
        且 PC/分支目标/LSU/IFU/AXI/PMA/Xbar/ICache/DCache/BTB/RAS
        全部使用 64 位地址，LD/SD 以两拍 32 位 AXI 窄传输覆盖 8 字节。
        外部 ysyxSoC CPU AXI 目前实际仍为 32 位地址/数据，SoC 侧
        位宽由 SOC_XLEN_FOLLOW_CPU/SOC_XLEN 独立配置。32 位 SoC
        可以搭配 64 位 CPU：顶层 PMA 必须位于低 4GiB，Xbar 对更高
        地址返回 DECERR，绝不静默截断。
        XLEN=64 时 MMU 支持标准 Sv39（默认）与可配置 Sv48；页表必须
        使用 8B PTE、4096B 页表页，详见 MMU Profile。
        Sv39/Sv48 基线分别见 configs/rv64_mmu_defconfig 与
        configs/rv64_sv48_defconfig。

    config RISCV_M
      bool "M 扩展（乘/除/取余）"
      default n
      help
        启用后生成MDU(乘法器+除法器)并在译码表加入M类指令;
        关闭时M类指令按非法指令处理(cause=2)。
        修改后需重新 make verilog。
        difftest时NEMU必须使用相同ISA(如riscv32im)。

    config RISCV_A
      bool "A 扩展（原子访存）"
      default n
      help
        启用 LR/SC 与全部 AMO 指令。RV32 支持 .W；RV64 支持 .W 和 .D。
        原子访存绕过 DCache，走 LSU 串行 uncached 事务，完成写后失效
        对应 DCache/ICache 行；aq/rl 首版保守地按完整 fence 处理。
        打开后 misa.A 置位。difftest 时 NEMU 必须使用相同 ISA
        （如 riscv32ima / riscv64ima）。

    config RISCV_C
      bool "C 扩展（压缩指令）"
      default n
      help
        启用 RV32C/RV64C：IFU 改为 IALIGN=16，可 2 字节步进并拼装
        16/32 位指令；IDU 完整展开整数 RVC 指令，保留的非法编码
        明确按非法指令陷入；misa.C 置位，mepc/sepc 只清 bit0。
        RV32 的 C.JAL 与 RV64 的 C.ADDIW 按 XLEN 区分；C.FLD/C.FSD/
        C.FLDSP/C.FSDSP 需要 D 扩展，RV32 的 C.FLW/C.FSW/C.FLWSP/
        C.FSWSP 需要 F 扩展，扩展关闭时这些编码按非法指令处理。
        RV32/RV64 的同编码位差异（C.FLW 对 C.LD、C.FSW 对 C.SD）
        由 XLEN 精确选择，不会把浮点压缩编码误当成整数访存。
        关闭时压缩编码不会被当作 32 位指令执行，而是明确触发
        illegal instruction(cause=2)。
        difftest 时 NEMU 必须使用相同 ISA（如 rv32gc / rv64gc）。
        修改后需重新 make verilog。

    config RISCV_F
      bool "F 扩展（单精度浮点）"
      default n
      help
        启用 RISC-V F 扩展：32 个浮点寄存器、fcsr/fflags/frm 以及
        单精度浮点指令。F 必须选择一个具体的 FPU 后端（见下面的
        “FPU 后端”菜单）；FPU_IMPL=none 时会在配置契约和
        elaboration 阶段明确报错，不会生成只有 ISA 标志、没有浮点
        数据通路的半成品。
        Berkeley HardFloat 与 Fudian 均已通过 vendor 源码接入，可真正
        执行 RV32F/RV32D/RV64F/RV64D；具体后端由 FPU 后端菜单选择。
        修改后需重新 make verilog。

    config RISCV_D
      bool "D 扩展（双精度浮点）"
      depends on RISCV_F && FPU_FLEN=64
      default n
      help
        D 依赖 F，并要求 FPU_FLEN=64：D 的 64 位格式和浮点寄存器
        需要 64 位数据通路。只启用 D 而不启用 F、或 FLEN=32 时，
        配置契约和 elaboration 会明确拒绝。
        RV32D 与 RV64D 都已接入：XLEN=32 时 LSU/DCache 仍以 32 位
        AXI 数据 beat 完成 FLD/FSD 的 8 字节访问（两拍窄传输），
        无 MMU 的 RV32 配置可直接使用；RV32D 需要 DCache 时 cache
        line 必须至少 8 字节。

    menu "FPU 后端"
      depends on RISCV_F

      choice
        prompt "FPU 实现后端"
        default FPU_IMPL_NONE
        help
          选择浮点数据通路的来源。所有后端都通过统一的
          ysyx_26030103_FPUInterface（Decoupled 请求/响应）接入，
          上层只依赖该接口，不直接引用 vendor 内部信号或内部变量。
          none: 不生成 FPU；RISCV_F=y 时非法。
          hardfloat: Berkeley HardFloat，vendor 接入后可用。
          fudian: OpenXiangShan Fudian，vendor 接入后可用。
          external: 预留给未来外部实现；当前明确拒绝。
        config FPU_IMPL_NONE
          bool "none（不启用 FPU）"
        config FPU_IMPL_HARDFLOAT
          bool "Berkeley HardFloat"
        config FPU_IMPL_FUDIAN
          bool "Fudian"
        config FPU_IMPL_EXTERNAL
          bool "external（预留，未实现）"
      endchoice

      config FPU_IMPL
        string
        default "none" if FPU_IMPL_NONE
        default "hardfloat" if FPU_IMPL_HARDFLOAT
        default "fudian" if FPU_IMPL_FUDIAN
        default "external" if FPU_IMPL_EXTERNAL
        default "none"
        help
          FPU 后端名称的字符串派生项，供 Makefile 和 Scala
          elaboration 读取。savedefconfig 可能只保留 choice 布尔项，
          配置契约会从 FPU_IMPL_* 反推；两者不一致时明确报错。

      config FPU_FLEN
        int "浮点寄存器/数据通路宽度 FLEN"
        depends on RISCV_F
        range 32 64
        default 64
        help
          FLEN 只允许 32 或 64。仅 F 可使用 32 或 64；启用 D 时必须
          为 64。Kconfig 的 range 不能表达离散集合，33..63 会由
          tools/KconfigContract/ 明确拒绝。
          默认 64，便于后续同时支持 F/D，并让 F 的 NaN-boxing 与
          D 共用同一套 64 位浮点寄存器。

      config FPU_PIPELINE
        int "FPU 流水级数"
        depends on RISCV_F
        range 0 8
        default 0
        help
          响应边界的公开流水深度：0 表示后端的组合/单拍路径，不增加
          额外寄存器；N>0 时在 FpuResponse 与顶层端口之间插入 N 级
          valid/ready 寄存器。每级只在整条下游 ready 链允许前进时移动，
          因此反压会正确传回后端；flush 会清空全部在途级。该参数不改变
          F/D 指令语义，也不暴露 vendor 内部状态机或迭代计数器。上层
          必须按 Decoupled 处理可变延迟。

      config FPU_FMA
        bool "融合乘加（FMA）数据通路"
        depends on RISCV_F
        default y
        help
          开启时后端实例化 vendor 融合乘加单元（HardFloat 的
          MulAddRecFN 或 Fudian 的 FCMA）。关闭时不得继续使用同一个
          融合单元：后端改用基于 vendor 基础模块（Multiplier、
          ShiftRightJam、RoundingUnit）实现的“精确乘积 + 定点对齐
          加法 + 单次舍入”数据通路，仍按 RISC-V 语义实现
          FMADD/FMSUB/FNMADD/FNMSUB 并产生正确的 NV/OF/UF/NX。
          两种结构在配置摘要（fma=fused/exact）和生成 RTL 的模块名
          中可以区分。

      config FPU_DIVSQRT
        bool "硬件除法/开方单元"
        depends on RISCV_F
        default y
        help
          是否实例化 FDIV/FSQRT 所需的除法/开方单元。RISC-V F/D 把
          FDIV/FSQRT 列为必备指令；启用 F/D 时本项必须为 y，关闭会在
          配置契约和 elaboration 明确拒绝，避免生成缺指令的假 F/D 核。
          后端可自行选择迭代或流水实现，但不得把内部迭代变量暴露成
          Kconfig 参数。

      config FPU_ROUNDING
        bool "完整 RISC-V 舍入模式"
        depends on RISCV_F
        default y
        help
          支持 RNE/RTZ/RDN/RUP/RMM 以及 frm 动态舍入。F/D 合规要求
          完整舍入模式；启用 F/D 时本项必须为 y。该开关只用于明确
          拒绝不合规配置，不用于裁剪指令语义。

      config FPU_FLAGS
        bool "fflags 异常标志"
        depends on RISCV_F
        default y
        help
          生成 NV/DZ/OF/UF/NX 五个浮点异常标志并接入 fcsr。F/D 合规
          要求 fflags；启用 F/D 时本项必须为 y。

      menu "Berkeley HardFloat 公开参数"
        depends on FPU_IMPL_HARDFLOAT

        config FPU_HARDFLOAT_RECODE
          bool "内部使用 recoded 浮点格式"
          default y
          help
            HardFloat 的算术模块只提供 recoded 内部格式；后端在
            IEEE 754 输入/输出与 RecFN 之间转换。该参数保留为公开
            契约的一部分，但当前只接受 y；设为 n 会在 elaboration
            明确拒绝，不会静默选择 IEEE 直通实现。

        config FPU_HARDFLOAT_TININESS_BEFORE_ROUNDING
          bool "舍入前检测 tininess"
          default n
          help
            对应 HardFloat 的公开参数 detectTininessBeforeRounding。
            RISC-V/IEEE 754 默认在舍入后检测下溢（n）；只有明确需要
            非标准行为时才设为 y，配置摘要会记录实际选择。
      endmenu

      menu "Fudian 公开参数"
        depends on FPU_IMPL_FUDIAN

        config FPU_FUDIAN_SHARED_DIVSQRT
          bool "F/D 共享除法/开方迭代单元"
          default y
          help
            Fudian FDIV 同时支持除法与开方。开启且启用 D 时，F/D 共用
            同一套 D 精度 FDIV 迭代硬件：F 操作数精确提升到 D，迭代与
            第一次舍入在 D 精度完成，再按原舍入模式回舍到 S，并按 S
            结果重算 UF/NX/OF。53 位中间精度满足 2*24+2 的双舍入安全
            条件，边界/随机回归会与独立 F 引擎及 NEMU 比对。关闭时 F
            与 D 各实例化一个独立 FDIV（每个格式内部仍共享 FDIV/FSQRT）。
            该参数是集成层公开选择，不暴露 Fudian 内部的迭代状态/CSA
            细节。
      endmenu
    endmenu

    choice
      prompt "MDU 实现"
      depends on RISCV_M
      default MDU_IMPL_STANDARD
      help
        所有 MDU 实现都必须提供统一的 ysyx_26030103_MDUInterface。
        standard：内置 MUL+DIV 路由和 NPC 自研乘除法核心。
        rocket：移植 Rocket Chip 的 MulDiv 引擎，作为独立 MDU 后端。
        nutshell：移植 NutShell 的 MDU 乘除法引擎，支持 RV32/RV64。
        external：预留接口，当前没有外部实现。
      config MDU_IMPL_STANDARD
        bool "standard（内置 MUL+DIV）"
      config MDU_IMPL_ROCKET
        bool "Rocket Chip MulDiv"
      config MDU_IMPL_NUTSHELL
        bool "NutShell MDU"
      config MDU_IMPL_IBEX
        bool "Ibex multdiv (RV32)"
        depends on XLEN = 32
      config MDU_IMPL_CVE2
        bool "CVE2 multdiv (RV32)"
        depends on XLEN = 32
      config MDU_IMPL_CV32E40P
        bool "CV32E40P mult/div (RV32)"
        depends on XLEN = 32
      config MDU_IMPL_PICORV32
        bool "PicoRV32 PCPI mul/div (RV32)"
        depends on XLEN = 32
      config MDU_IMPL_EXTERNAL
        bool "external（预留，未实现）"
    endchoice

    config MDU_IMPL
      string
      default "standard" if MDU_IMPL_STANDARD
      default "rocket" if MDU_IMPL_ROCKET
      default "nutshell" if MDU_IMPL_NUTSHELL
      default "ibex" if MDU_IMPL_IBEX && XLEN = 32
      default "cve2" if MDU_IMPL_CVE2 && XLEN = 32
      default "cv32e40p" if MDU_IMPL_CV32E40P && XLEN = 32
      default "picorv32" if MDU_IMPL_PICORV32 && XLEN = 32
      default "external" if MDU_IMPL_EXTERNAL
      default "standard"

    menu "Rocket MDU 参数"
      depends on MDU_IMPL_ROCKET

      config ROCKET_MUL_UNROLL
        int "Rocket 乘法展开因子"
        range 1 8
        default 1
        help
          传给 Rocket Chip MulDiv 的 mulUnroll；越大组合路径越宽、拍数越少。

      config ROCKET_DIV_UNROLL
        int "Rocket 除法展开因子"
        range 1 8
        default 1
        help
          传给 Rocket Chip MulDiv 的 divUnroll；越大组合路径越宽、拍数越少。

      config ROCKET_MUL_EARLY_OUT
        bool "Rocket 乘法提前结束"
        default n
        help
          传给 Rocket Chip MulDiv 的 mulEarlyOut。

      config ROCKET_DIV_EARLY_OUT
        bool "Rocket 除法提前结束"
        default n
        help
          传给 Rocket Chip MulDiv 的 divEarlyOut。

      config ROCKET_DIV_EARLY_OUT_GRANULARITY
        int "Rocket 除法提前结束粒度"
        range 1 8
        default 1
        depends on ROCKET_DIV_EARLY_OUT
        help
          传给 Rocket Chip MulDiv 的 divEarlyOutGranularity。
    endmenu
    menu "乘法器配置"
      depends on RISCV_M

      choice
        prompt "乘法器实现"
        default MUL_SHIFT_ADD
        help
          多种实现共用同一个乘法接口, 通过 elaboration 期条件例化选出一种,
          未选中的实现不会进入生成的RTL。
          移位乘法器: 多周期移位累加, 内部单个加法器, 面积最小;
          Wallace: 部分积压缩树+末级加法, 面积/时延较均衡;
          Dadda: 压缩器更少但布线更复杂。
      config MUL_SHIFT_ADD
        bool "移位乘法器"
      config MUL_WALLACE
        bool "Wallace"
      config MUL_DADDA
        bool "Dadda"
      endchoice

      config MUL_IMPL
        string
        default "shift_add" if MUL_SHIFT_ADD
        default "wallace" if MUL_WALLACE
        default "dadda" if MUL_DADDA
        default "shift_add"

      choice
        prompt "乘法部分积编码方式"
        default MUL_ENCODING_PLAIN
        help
          编码方式是独立于乘法器结构的维度。
          Booth编码可用于移位累加器、Wallace或Dadda压缩树。
      config MUL_ENCODING_PLAIN
        bool "普通部分积（非Booth）"
      config MUL_ENCODING_BOOTH
        bool "Booth编码"
      endchoice

      config MUL_ENCODING
        string
        default "plain" if MUL_ENCODING_PLAIN
        default "booth" if MUL_ENCODING_BOOTH
        default "plain"

      config MUL_RADIX
        int "乘法Booth基数"
        default 4
        depends on MUL_ENCODING_BOOTH
        help
          输入2、4、8、16等2的幂；elaboration会拒绝其他数值。

    config MUL_WIDTH
      int "乘法器后端操作数位宽"
      default 32
      range 32 128
      help
        控制乘法器后端的操作数位宽，必须是不小于32的2的幂(32/64/128);
        RV32指令接口保持32位。小于32会截断ISA操作数，因此明确禁止。

      config MUL_COMPRESSOR_INPUTS
        int "压缩树通用GPC输入数K"
        default 3
        range 3 64
        depends on MUL_WALLACE || MUL_DADDA
        help
          所有K使用同一生成路径；默认3仅用于保持现有配置行为。

      config MUL_COMPRESSOR_OUTPUTS
        int "压缩树通用GPC输出数R"
        default 2
        range 1 64
        depends on MUL_WALLACE || MUL_DADDA

      config MUL_COMPRESSOR_OUTPUT_OFFSETS
        string "GPC每个主输出的目标列偏移(逗号分隔)"
        default "0,1"
        depends on MUL_WALLACE || MUL_DADDA

      config MUL_COMPRESSOR_HAS_CIN
        bool "GPC包含Cin输入"
        default n
        depends on MUL_WALLACE || MUL_DADDA

      config MUL_COMPRESSOR_HAS_COUT
        bool "GPC包含Cout输出"
        default n
        depends on MUL_WALLACE || MUL_DADDA

      config MUL_COMPRESSOR_COUT_OFFSET
        int "GPC Cout目标列偏移"
        default 1
        range 0 128
        depends on MUL_COMPRESSOR_HAS_COUT

      config MUL_COMPRESSOR_ALLOW_REDUNDANT
        bool "允许GPC输出存在冗余表示"
        default n
        depends on MUL_WALLACE || MUL_DADDA

      config MUL_SPLIT
        int "移位乘法器复用因子（1=不拆分，2/4=减少每拍处理量）"
        default 1
        range 1 4
        depends on MUL_SHIFT_ADD
        help
          拆成多个小块乘法器分时复用: 面积下降, 拍数上升。

      config MUL_PIPELINE
        int "压缩树内部流水级数（0=不插入内部流水）"
        default 0
        range 0 4
        depends on MUL_WALLACE || MUL_DADDA
        help
          压缩网络按级数插流水寄存器;主要对Wallace/Dadda有效，
          影响吞吐/延迟/面积, 接口需延迟无关。

      config MUL_ITER_BITS
        int "移位乘法器每拍处理的位数"
        default 2 if MUL_ENCODING_BOOTH
        default 1
        range 1 8
        depends on MUL_SHIFT_ADD
        help
          1位/拍面积最小, 4或8位/拍减少拍数; 仅对移位乘法器实现有效。

      config MUL_EARLY_OUT
        bool "高位为零时提前结束"
        default n
        depends on MUL_SHIFT_ADD
        help
          迭代乘法高位已全零时提前完成, 仅对移位乘法器实现有效。

    endmenu

    menu "除法器配置"
      depends on RISCV_M

      choice
        prompt "除法器实现"
        default DIV_RESTORING
        help
          恢复余数法最直观; 不恢复余数法每拍少一次加减;
          SRT基数越高每拍出更多商位, 但商数字选择逻辑更大。
      config DIV_RESTORING
        bool "恢复余数法"
      config DIV_NONRESTORING
        bool "不恢复余数法"
      config DIV_SRT
        bool "SRT除法"
      endchoice

      config DIV_IMPL
        string
        default "restoring" if DIV_RESTORING
        default "nonrestoring" if DIV_NONRESTORING
        default "srt" if DIV_SRT
        default "restoring"

    config DIV_RADIX
      int
      default 2
      help
        旧版通用除法参数，仅作为各后端参数的兼容默认值。

    config DIV_ITER_BITS
      int
      default 1
      help
        旧版通用除法参数，仅作为各后端参数的兼容默认值。

    config DIV_EARLY_OUT
      bool
      default n
      help
        旧版通用除法参数，仅作为各后端参数的兼容默认值。

      menu "恢复余数法参数"
        depends on DIV_RESTORING

        config DIV_RESTORING_RADIX
          int "除法基数"
          default DIV_RADIX
          range 2 16
          help
            恢复余数法每次试减的基数；必须是 2 的幂。

        config DIV_RESTORING_ITER_BITS
          int "每拍展开的基数数字数"
          default DIV_ITER_BITS
          range 1 4
          help
            每拍处理的基数数字数。

        config DIV_RESTORING_EARLY_OUT
          bool "提前结束"
          default DIV_EARLY_OUT
          help
            余数已为零或商已确定时提前完成。
      endmenu

      menu "不恢复余数法参数"
        depends on DIV_NONRESTORING

        config DIV_NONRESTORING_RADIX
          int "除法基数"
          default DIV_RADIX
          range 2 16
          help
            不恢复余数法每次试减的基数；必须是 2 的幂。

        config DIV_NONRESTORING_ITER_BITS
          int "每拍展开的基数数字数"
          default DIV_ITER_BITS
          range 1 4
          help
            每拍处理的基数数字数。

        config DIV_NONRESTORING_EARLY_OUT
          bool "提前结束"
          default DIV_EARLY_OUT
          help
            余数已为零或商已确定时提前完成。
      endmenu

      menu "SRT 除法参数"
        depends on DIV_SRT

        config DIV_SRT_RADIX
          int "除法基数"
          default DIV_RADIX
          range 2 16
          help
            SRT 每拍产生的冗余商数字基数；必须是 2 的幂。

        config DIV_SRT_ITER_BITS
          int "每拍展开的基数数字数"
          default DIV_ITER_BITS
          range 1 4
          help
            每拍处理的基数数字数。

        config DIV_SRT_EARLY_OUT
          bool "提前结束"
          default DIV_EARLY_OUT
          help
            余数已为零或商已确定时提前完成。
      endmenu
    endmenu

    menu "ALU 实现"

      choice
        prompt "ALU 实现后端"
        default ALU_IMPL_STANDARD
        help
          所有 ALU 后端共享统一的 ysyx_26030103_ALUInterface，上层只依赖
          A/B/ALUCtrl/result，不直接引用子模块实现。
          standard：加法、减法、移位、位逻辑并行计算，结果浅 mux。
          compact：复用一个算术单元完成加减，减少一个宽加法器，面积更小，
            代价是算术选择路径更深。
          external：预留接口，当前没有外部 ALU 实现。
      config ALU_IMPL_STANDARD
        bool "standard（并行子模块）"
      config ALU_IMPL_COMPACT
        bool "compact（共享加减法器）"
      config ALU_IMPL_EXTERNAL
        bool "external（预留，未实现）"
      endchoice

      config ALU_IMPL
        string
        default "standard" if ALU_IMPL_STANDARD
        default "compact" if ALU_IMPL_COMPACT
        default "external" if ALU_IMPL_EXTERNAL
        default "standard"
        help
          ALU 后端名称的字符串派生项，供 elaborator 构造工厂。配置契约
          会从 ALU_IMPL_* 反推；两者不一致时明确报错。

      choice
        prompt "ALU 加法器实现"
        default ALU_ADDER_NATIVE
        help
          加法器是 ALU 的关键组合路径。所有实现都提供相同的
          A/B/Cin -> sum/carryOut 语义，只改变结构与面积/时延。
          native：使用 Chisel 加法并由综合工具映射到工艺库。
          ripple：逐位全加器，面积最小，进位链最长。
          carry_select：分组双路加法器，用进位选择，面积和时延折中。
          carry_lookahead：块内超前进位，块间 ripple，时延更短。
      config ALU_ADDER_NATIVE
        bool "native（工艺库加法）"
      config ALU_ADDER_RIPPLE
        bool "ripple carry"
      config ALU_ADDER_CARRY_SELECT
        bool "carry select"
      config ALU_ADDER_CARRY_LOOKAHEAD
        bool "carry lookahead"
      endchoice

      config ALU_ADDER_IMPL
        string
        default "native" if ALU_ADDER_NATIVE
        default "ripple" if ALU_ADDER_RIPPLE
        default "carry_select" if ALU_ADDER_CARRY_SELECT
        default "carry_lookahead" if ALU_ADDER_CARRY_LOOKAHEAD
        default "native"

      config ALU_CARRY_SELECT_GROUP
        int "carry-select 分组宽度"
        depends on ALU_ADDER_CARRY_SELECT
        range 2 64
        default 8
        help
          carry-select 每组处理的位数，必须是能整除 XLEN 的 2 的幂。
          RV32 可选 2/4/8/16/32，RV64 还可选 64；非法值会在
          Kconfig 契约和 elaboration 阶段明确拒绝。
    endmenu

  endmenu

  menu "ysyxSoC 接口"

    config CHIPLINK
      bool "启用 ChipLink 外部存储/中断接口"
      default n
      help
        打开 ysyxSoC 的 ChipLink master/slave 与 DMA 代理。
        该值写入 typed JSON 的 soc.chiplink，由 SoC elaboration 消费；
        CPU 侧 PMA/DMA 一致性设置仍由 Makefile 从同一值派生。

    config SDRAM_USE_AXI
      bool "SDRAM 使用 AXI 数据通路"
      default y
      help
        选择 ysyxSoC 的 SDRAM 控制器接在 32 位 AXI xbar 上；关闭时
        使用 APB SDRAM 路径。该值写入 typed JSON 的
        soc.sdram_use_axi，由 SoC 拓扑选择直接消费。

    config SOC_XLEN_FOLLOW_CPU
      bool "SoC CPU 侧接口位宽跟随 CPU XLEN"
      default n
      help
        控制 ysyxSoC CPU 侧接口的 XLEN/数据宽度是否跟随 CPU 的 XLEN。
        n（默认）: 使用 SOC_XLEN，CPU 与 SoC 位宽相互独立。
        y: EffectiveSocXLEN = XLEN。
        注意 follow 只是让 SoC 接口跟随 CPU，并不是强制 CPU 与 SoC
        同宽；关闭后仍可自由组合 32/64，例如 64 位 CPU 搭配 32 位
        SoC，或 32 位 CPU 搭配 64 位 SoC。

    config SOC_XLEN
      int "ysyxSoC CPU 侧接口 XLEN"
      depends on !SOC_XLEN_FOLLOW_CPU
      default 32
      # Kconfig 的 int/range 不能表达离散集合；32/64 由配置契约校验
      # 在配置阶段检查，elaboration 也会再次校验。
      range 32 64
      help
        ysyxSoC CPU 侧接口的 XLEN/数据宽度，仅当
        SOC_XLEN_FOLLOW_CPU=n 时可见并生效，只允许 32 或 64；
        33..63 会在 make defconfig/menuconfig 后的配置契约检查阶段
        被明确拒绝，不会静默生成。
        32 位 ysyxSoC 可以搭配 64 位 CPU：CPU 内部仍使用 64 位地址，
        但经 SoC 边界的访问必须位于低 4GiB，更高地址在 Xbar 内返回
        DECERR。64 位 SoC 接口已经由 AXI4Downsizer 接入 32 位
        xbar/外设，配置会写入 typed JSON 的 soc.soc_xlen，由
        ysyxSoC elaboration 直接消费。
        修改后需重新 make verilog 或 make build/ysyx_26030103。

  endmenu

  menu "缓存"

    config ICACHE
      bool "开启指令缓存(ICache)"
      default y
      help
        开启: 取指经过ICache(直接映射, 参数见下)。
        关闭: 取指不做任何缓存, 每次取指直接发单拍AXI读(和数据通路一样),
              ICache的存储阵列/标签/回填逻辑不会生成, 这部分面积消失。
        修改后需重新 make verilog 以重新生成RTL。

    config DCACHE
      bool "开启数据缓存(DCache)"
      default n
      help
        开启: 普通RAM的读操作经过直映射DCache(参数见下)，写操作采用
              写直达且不写分配，并复用LSU写缓冲。
              MMIO和其它非缓存地址始终直通AXI，不进入DCache。
        关闭: LSU保持当前直连AXI访存路径，不生成DCache存储阵列/回填逻辑。
        修改后需重新 make verilog 以重新生成RTL。

    config CACHE_BLOCK_SIZE_LOG2
      int "Cache块大小的log2（2^N字节）"
      depends on ICACHE || DCACHE
      default 4
      range 2 13
      help
        2=4字节, 3=8字节, 4=16字节, 5=32字节, 6=64字节，
        7..13=128B..8192B。
        PIPT（MMU_CACHE_MODE=pipt）允许块大于页，索引和回填都使用物理
        地址；VIPT 下层大小不得超过页，否则 elaboration 明确报错并提示
        改用 PIPT。大块会显著增加数据阵列面积/仿真内存，请按需使用。
        修改后需重新 make verilog 以重新生成RTL。

    config CACHE_INDEX_BITS
      int "Cache索引位宽（2^N个块）"
      depends on ICACHE || DCACHE
      default 5
      range 1 10
      help
        1=2块, 5=32块, 10=1024块。
        未单独设置 ICACHE_INDEX_BITS/DCACHE_INDEX_BITS 时，两者都跟随本值。
        修改后需重新 make verilog 以重新生成RTL。

    config ICACHE_BLOCK_SIZE_LOG2
      int "ICache块大小的log2（2^N字节）"
      depends on ICACHE
      default CACHE_BLOCK_SIZE_LOG2
      range 2 13
      help
        单独配置 ICache 行大小；未设置时跟随 CACHE_BLOCK_SIZE_LOG2。
        PIPT 允许行大于页；VIPT 拒绝行大于页（请改用 MMU_CACHE_MODE=pipt）。
        修改后需重新 make verilog 以重新生成RTL。

    config ICACHE_INDEX_BITS
      int "ICache索引位宽（2^N个块）"
      depends on ICACHE
      default CACHE_INDEX_BITS
      range 1 10
      help
        单独配置 ICache 组数；未设置时跟随 CACHE_INDEX_BITS。
        修改后需重新 make verilog 以重新生成RTL。

    config DCACHE_BLOCK_SIZE_LOG2
      int "DCache块大小的log2（2^N字节）"
      depends on DCACHE
      default CACHE_BLOCK_SIZE_LOG2
      range 2 13
      help
        单独配置 DCache 行大小；未设置时跟随 CACHE_BLOCK_SIZE_LOG2。
        PIPT 允许行大于页；VIPT 拒绝行大于页（请改用 MMU_CACHE_MODE=pipt）。
        修改后需重新 make verilog 以重新生成RTL。

    config DCACHE_INDEX_BITS
      int "DCache索引位宽（2^N个块）"
      depends on DCACHE
      default CACHE_INDEX_BITS
      range 1 10
      help
        单独配置 DCache 组数；未设置时跟随 CACHE_INDEX_BITS。
        修改后需重新 make verilog 以重新生成RTL。

    choice
      prompt "ICache数据阵列存储介质"
      depends on ICACHE
      default ICACHE_STORAGE_REG
      help
        寄存器阵列: 数据阵列用触发器(Reg(Vec)), 组合读, 无额外时序(默认);
        同步读SRAM: 数据阵列用SyncReadMem/SRAM黑盒, 命中响应通过"第一拍旁路+
          锁存"保持1拍延迟与吞吐(综合面积略小, 便于后续替换物理SRAM宏);
        SRAM不旁路: 命中响应晚一拍, 仅用于量化旁路的性能代价, 正常构建不建议选。
        修改后需重新 make verilog 以重新生成RTL。

    config ICACHE_STORAGE_REG
      bool "寄存器阵列"
    config ICACHE_STORAGE_SRAM
      bool "同步读SRAM（旁路，保持1拍命中）"
    config ICACHE_STORAGE_SRAM_NOBYPASS
      bool "同步读SRAM（不旁路，命中晚1拍）"
    endchoice

    config ICACHE_STORAGE
      string
      default "reg" if ICACHE_STORAGE_REG
      default "sram" if ICACHE_STORAGE_SRAM
      default "sram_nobypass" if ICACHE_STORAGE_SRAM_NOBYPASS
      default "reg"

    choice
      prompt "DCache数据阵列存储介质"
      depends on DCACHE
      default DCACHE_STORAGE_REG
      help
        寄存器阵列: 数据阵列用触发器(Reg(Vec)), 组合读, 无额外时序(默认);
        同步读SRAM: 数据阵列用单块SRAM黑盒(1读口+2写口, 字节掩码), 命中响应
          通过"第一拍旁路+锁存"保持1拍延迟与吞吐;
        SRAM不旁路: 命中响应晚一拍, 仅用于量化旁路的性能代价, 正常构建不建议选。
        修改后需重新 make verilog 以重新生成RTL。

    config DCACHE_STORAGE_REG
      bool "寄存器阵列"
    config DCACHE_STORAGE_SRAM
      bool "同步读SRAM（旁路，保持1拍命中）"
    config DCACHE_STORAGE_SRAM_NOBYPASS
      bool "同步读SRAM（不旁路，命中晚1拍）"
    endchoice

    config DCACHE_STORAGE
      string
      default "reg" if DCACHE_STORAGE_REG
      default "sram" if DCACHE_STORAGE_SRAM
      default "sram_nobypass" if DCACHE_STORAGE_SRAM_NOBYPASS
      default "reg"

    choice
      prompt "ICache 自修改代码一致性"
      depends on ICACHE
      default ICACHE_COHERENCE_FENCE_I
      help
        RISC-V 标准语义要求软件在写指令后执行 fence.i；本选项只决定
        fence.i 之外是否再提供硬件 store snoop，不能把“无需 fence.i”
        当成标准行为。
      config ICACHE_COHERENCE_FENCE_I
        bool "仅 fence.i（标准语义，默认）"
        help
          只有软件执行 fence.i 才失效 ICache 和取指流水。默认保持既有行为。
      config ICACHE_COHERENCE_HARDWARE_SNOOP
        bool "硬件 store snoop（仍保留 fence.i）"
        help
          CPU store 的 B 响应完成时，按物理地址失效 ICache 对应行；
          正在回填该行的取指会丢弃旧数据并重新发起。该模式只缩短
          “store 已完成、尚未 fence.i”的可见性窗口，不能替代 fence.i：
          已经取入流水线的旧指令仍必须由 fence.i 冲刷。
    endchoice

    config ICACHE_COHERENCE
      string
      default "fence_i" if ICACHE_COHERENCE_FENCE_I
      default "hardware_snoop" if ICACHE_COHERENCE_HARDWARE_SNOOP
      default "fence_i"

    choice
      prompt "DMA 数据一致性"
      default DMA_COHERENCE_SOFTWARE_FLUSH
      help
        入站 DMA 经 ysyxSoC CPU slave 口直接访问内存，不经过 DCache。
        software_flush: 保持现有行为——写直达 DCache 无脏数据，DMA 写 B
          完成时失效 DCache；软件必须在 DMA 完成后才访问目标区域，修改
          可执行内存后执行 fence.i。
        uncached: 把 ChipLink DMA 窗口（0xc0000000--0xffffffff）在 CPU
          侧标记为不可缓存，load/store/取指绕过 Cache 直接访问内存，
          不再依赖 DMA 写 B 触发的 DCache 失效。DMA 传输在途时软件仍
          不得消费目标区域。
        hardware_snoop: DMA 写的 B 响应到达后，按本次 burst 覆盖的物理
          字节范围失效 ICache/DCache 中所有匹配行；B 会保持到失效完成，
          因此软件看到 DMA 完成时旧缓存副本已经消失。DMA 读不生成额外
          动作。CPU 流水线里已经取入的旧指令仍需 fence.i 冲刷。
      config DMA_COHERENCE_SOFTWARE_FLUSH
        bool "软件维护 + DMA 写 B 失效（现有行为，默认）"
      config DMA_COHERENCE_UNCACHED
        bool "DMA 窗口按不可缓存访问"
      config DMA_COHERENCE_HARDWARE_SNOOP
        bool "DMA 地址级硬件 snoop（失效 ICache/DCache 对应行）"
    endchoice

    config DMA_COHERENCE
      string
      default "software_flush" if DMA_COHERENCE_SOFTWARE_FLUSH
      default "uncached" if DMA_COHERENCE_UNCACHED
      default "hardware_snoop" if DMA_COHERENCE_HARDWARE_SNOOP
      default "software_flush"

  endmenu

  menu "写缓冲 (LSU)"

    config WBUF_DEPTH
      int "写缓冲项数（必须是2的幂）"
      default 4
      range 1 16
      help
        写操作先入队、由后台异步写内存, 项数越多越能吸收连续写(栈/结构体/内存填充),
        但触发器和组合逻辑面积也越大。
        必须是2的幂: 1/2/4/8/16(环形队列按位回绕)。
        修改后需重新 make verilog 以重新生成RTL。

  endmenu

  menu "分支预测 (BTB / RAS)"

    config BTB_BITS
      int "BTB索引位宽（2^N组）"
      default 4
      range 0 10
      help
        BTB组数=2^N。0=1组, 1=2组, 4=16组, 10=1024组。
        修改后需重新 make verilog 以重新生成RTL。
        建议与branchsim(csrc/tools/branchsim/Kconfig)的CONFIG_BTB_BITS保持一致, 以便用branchsim校准RTL。

    config BTB_WAYS
      int "BTB相联度（1=直接映射）"
      default 1
      range 1 8
      help
        每组表项数, 1=直接映射, 2=2路组相联, 以此类推。
        修改后需重新 make verilog 以重新生成RTL。
        建议与branchsim(csrc/tools/branchsim/Kconfig)的CONFIG_BTB_WAYS保持一致, 以便用branchsim校准RTL。

    config JAL_BTB_BITS
      int "jal BTB索引位宽（2^N组）"
      default 4
      range 0 10
      help
        jal专用BTB组数=2^N(方案B: 独立小表, 与分支BTB零干扰)。
        0=1组, 4=16组。
        修改后需重新 make verilog 以重新生成RTL。
        建议与branchsim(csrc/tools/branchsim/Kconfig)的CONFIG_JAL_BTB_BITS保持一致, 以便用branchsim校准RTL。

    config JAL_BTB_WAYS
      int "jal BTB相联度（1=直接映射）"
      default 1
      range 1 8
      help
        每组表项数, 1=直接映射, 2=2路组相联, 以此类推。
        修改后需重新 make verilog 以重新生成RTL。
        建议与branchsim(csrc/tools/branchsim/Kconfig)的CONFIG_JAL_BTB_WAYS保持一致, 以便用branchsim校准RTL。

    config RAS_BITS
      int "返回地址栈(RAS)深度位宽（深度=2^N）"
      default 4
      range 0 8
      help
        RAS深度=2^N, 用于ret的跳转目标预测。0=1项, 4=16项,
        branchsim评估显示8项即够用。
        修改后需重新 make verilog 以重新生成RTL。
        建议与branchsim(csrc/tools/branchsim/Kconfig)的CONFIG_RAS_BITS保持一致, 以便用branchsim校准RTL。

  endmenu

  menu "目标体系结构"

    config NPC_RAM_SIZE
      hex "direct-NPC 仿真 RAM 大小（字节）"
      default 0x04000000
      help
        direct-NPC 从 0x80000000 起的 RAM 窗口大小，必须为 2 的幂且
        至少 4 KiB。该值同时决定 AXIRAM 深度、CPU PMA、C++ CONFIG_MSIZE、
        DTB /memory 与 reserved-memory 边界，以及 SBI/U-Boot/Linux
        打包脚本的 RAM 上限，不要在其它位置另写一份。

        默认 0x04000000（64 MiB），保持 xv6/Nanos-lite 现有布局不变。
        Debian EFI vmlinux（约 31 MB EFI PE）经 U-Boot efi_load_pe()
        需要再分配一份目标页，64 MiB 不足；rv64_linux_uboot_128m_defconfig
        使用 0x08000000（128 MiB）。修改后必须重新 make verilog 和
        重新构建仿真器，否则 RTL PMA/AXIRAM 与 C++ 加载器会不一致。

    config CACHE_PADDING
      int "ICache字节填充（用于对齐热点循环到cache块边界）"
      default 0
      range 0 15
      help
        在.text段前插入的空白字节数，用于调整代码在内存中的位置
        使热点循环对齐到ICache块边界，以减少cache块的占用。
        默认0表示不填充。需要结合性能计数器分析热点循环地址后设置。
        仅对 npc 独立仿真路径（SIM_TOP=npc）生效：镜像整体后移N字节，
        复位PC同步加N。SoC路径启动地址由RTL固定，不受此选项影响。

  endmenu

  menu "SoC 总线延迟模型"

    config SYNTH_FREQ
      int "综合目标频率 (MHz)"
      default 450
      range 1 10000
      help
        综合器尝试达到的目标频率。设置越高，综合器可能使用更多
        面积换取更低的逻辑延迟。受限于工艺库和寄存器堆/加法器/SRAM等
        关键部件的最大工作频率。
        该值同时作为 APB/AXI 延迟模型的 CPU 频率传入 RTL，
        修改后需重新 make verilog。

    config APB_DEVICE_FREQ
      int "APB设备频率 (MHz)"
      default 100
      range 1 10000
      help
        APB总线上外设（如SDRAM控制器）的运行频率。
        用于APB延迟模块计算频率比校准访存延迟；该值进入 typed JSON
        的 soc.apb.device_freq_mhz，由 ysyxSoC 统一读取。

    config APB_DELAY_SCALE
      int "APB延迟缩放因子 S"
      default 64
      range 1 1048576
      help
        APB延迟模块中频率比累加的放大系数。

    config AXI_DEVICE_FREQ
      int "AXI设备频率 (MHz)"
      default 100
      range 1 10000
      help
        AXI总线上外设（如SDRAM控制器）的运行频率。
        用于AXI延迟模块计算频率比校准访存延迟。

    config AXI_DELAY_SCALE
      int "AXI延迟缩放因子 S"
      default 64
      range 1 1048576
      help
        AXI延迟模块中频率比累加的放大系数。

  endmenu

  menu "外设 / NVBoard"

    config NVBOARD
      bool "启用 NVBoard (LED/数码管/拨码开关可视化)"
      default n
      help
        链接 NVBoard，把 ysyxSoCFull 的 GPIO 引脚绑定到虚拟板卡的
        LED/数码管/拨码开关。需要 SDL2 (libsdl2-dev libsdl2-image-dev
        libsdl2-ttf-dev)，且 nvboard.a 要与本工程的 C++ 标准库 ABI 一致。
        仅支持 SIM_TOP=soc；direct-NPC 顶层没有这些外设引脚，构建时会
        明确拒绝该组合。

    config NVBOARD_NXDC
      string "NVBoard 约束文件(.nxdc)路径"
      depends on NVBOARD
      default "csrc/nvboard/gpio.nxdc"
      help
        描述 RTL 引脚到 NVBoard 组件的绑定关系

    config NVBOARD_UPDATE_INTERVAL
      int "每多少周期刷新一次 NVBoard GUI"
      depends on NVBOARD
      default 100
      range 1 1000000
      help
        每周期都刷新太慢，隔 N 个周期调用一次 nvboard_update 折中

  endmenu

endmenu
```
